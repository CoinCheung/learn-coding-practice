AUTOSAR XML (schema 4-0-3)
package /IF
  246 x sender receiver interface:
    VBmm_BmsBasicStat
      data Enum: sw-calibration-access=READ-ONLY, type=UInt8
    VBmm_BmsReady
      data Flg: sw-calibration-access=READ-ONLY, type=Boolean
    VBmm_CanCtrl
      data Enum: sw-calibration-access=READ-ONLY, type=UInt8
    VBmm_ExtPwrEn
      data Flg: sw-calibration-access=READ-ONLY, type=Boolean
    VIpm_AcpFsHi
      data V: sw-calibration-access=READ-ONLY, type=Signal_Float
    VIpm_CabCur
      data A: sw-calibration-access=READ-ONLY, type=Signal_Float
    VIpm_CabDiagInfo
      data Enum: sw-calibration-access=READ-ONLY, type=Signal_Uint
    VIpm_CellTemMax
      data C: sw-calibration-access=READ-ONLY, type=Signal_Float
    VIpm_CellTemMin
      data C: sw-calibration-access=READ-ONLY, type=Signal_Float
    VIpm_CellVoltMax
      data V: sw-calibration-access=READ-ONLY, type=Signal_Float
    VIpm_CellVoltMin
      data V: sw-calibration-access=READ-ONLY, type=Signal_Float
    VIpm_ClsMainRlyReq
      data Enum: sw-calibration-access=READ-ONLY, type=Signal_Uint
    VIpm_Cmu01Stat
      data Enum: sw-calibration-access=READ-ONLY, type=Signal_Uint
    VIpm_Cmu02Stat
      data Enum: sw-calibration-access=READ-ONLY, type=Signal_Uint
    VIpm_Cmu03Stat
      data Enum: sw-calibration-access=READ-ONLY, type=Signal_Uint
    VIpm_Cmu04Stat
      data Enum: sw-calibration-access=READ-ONLY, type=Signal_Uint
    VIpm_Cmu05Stat
      data Enum: sw-calibration-access=READ-ONLY, type=Signal_Uint
    VIpm_Cmu06Stat
      data Enum: sw-calibration-access=READ-ONLY, type=Signal_Uint
    VIpm_Cmu07Stat
      data Enum: sw-calibration-access=READ-ONLY, type=Signal_Uint
    VIpm_Cmu08Stat
      data Enum: sw-calibration-access=READ-ONLY, type=Signal_Uint
    VIpm_CoolTem
      data C: sw-calibration-access=READ-ONLY, type=Signal_AI
    VIpm_CrashStat
      data Flg: sw-calibration-access=READ-ONLY, type=Signal_Uint
    VIpm_EpoReq
      data Flg: sw-calibration-access=READ-ONLY, type=Signal_Uint
    VIpm_FgdCyc
      data Sec: sw-calibration-access=READ-ONLY, type=Float
    VIpm_FgdDuty
      data Pct: sw-calibration-access=READ-ONLY, type=Float
    VIpm_HbCyc
      data Sec: sw-calibration-access=READ-ONLY, type=Float
    VIpm_HbDuty
      data Pct: sw-calibration-access=READ-ONLY, type=Float
    VIpm_HbEn
      data Flg: sw-calibration-access=READ-ONLY, type=Boolean
    VIpm_HvBatPos
      data V: sw-calibration-access=READ-ONLY, type=Signal_Float
    VIpm_HvBusNeg
      data V: sw-calibration-access=READ-ONLY, type=Signal_Float
    VIpm_HvBusPos
      data V: sw-calibration-access=READ-ONLY, type=Signal_Float
    VIpm_HvilSrcMonCyc
      data Sec: sw-calibration-access=READ-ONLY, type=Float
    VIpm_HvilSrcMonDuty
      data Pct: sw-calibration-access=READ-ONLY, type=Float
    VIpm_HvmDtcDetail
      data Enum: sw-calibration-access=READ-ONLY, type=Signal_Uint
    VIpm_HvmDtcSet
      data Flg: sw-calibration-access=READ-ONLY, type=Signal_Uint
    VIpm_HvmSwVerBuild
      data Cnt: sw-calibration-access=READ-ONLY, type=Signal_Uint
    VIpm_HvmSwVerMajor
      data Cnt: sw-calibration-access=READ-ONLY, type=Signal_Uint
    VIpm_HvmSwVerMinor
      data Cnt: sw-calibration-access=READ-ONLY, type=Signal_Uint
    VIpm_HvOffChgNeg
      data V: sw-calibration-access=READ-ONLY, type=Signal_Float
    VIpm_HvOnChgNeg
      data V: sw-calibration-access=READ-ONLY, type=Signal_Float
    VIpm_Kot
      data Sec: sw-calibration-access=READ-ONLY, type=Signal_Float
    VIpm_LemCur
      data A: sw-calibration-access=READ-ONLY, type=Signal_AI
    VIpm_LlsVolt
      data V: sw-calibration-access=READ-ONLY, type=Signal_AI
    VIpm_Lv12V
      data V: sw-calibration-access=READ-ONLY, type=Signal_AI
    VIpm_MainFsHi
      data V: sw-calibration-access=READ-ONLY, type=Signal_Float
    VIpm_MainFsLo
      data V: sw-calibration-access=READ-ONLY, type=Signal_Float
    VIpm_MainHvilCyc
      data Sec: sw-calibration-access=READ-ONLY, type=Float
    VIpm_MainHvilDuty
      data Pct: sw-calibration-access=READ-ONLY, type=Float
    VIpm_OffChrgrStat
      data Enum: sw-calibration-access=READ-ONLY, type=Signal_Uint
    VIpm_OffChgPlug
      data Flg: sw-calibration-access=READ-ONLY, type=Boolean
    VIpm_OffChgWake
      data Flg: sw-calibration-access=READ-ONLY, type=Boolean
    VIpm_OnChgHvilCyc
      data Sec: sw-calibration-access=READ-ONLY, type=Float
    VIpm_OnChgHvilDuty
      data Pct: sw-calibration-access=READ-ONLY, type=Float
    VIpm_OnChgWake
      data Flg: sw-calibration-access=READ-ONLY, type=Boolean
    VIpm_PtIsoDiagInfo
      data Enum: sw-calibration-access=READ-ONLY, type=Signal_Uint
    VIpm_Rcv0x81
      data Flg: sw-calibration-access=READ-ONLY, type=Boolean
    VIpm_Rcv0x8A
      data Flg: sw-calibration-access=READ-ONLY, type=Boolean
    VIpm_Sen5V
      data V: sw-calibration-access=READ-ONLY, type=Signal_AI
    VIpm_VehWake
      data Flg: sw-calibration-access=READ-ONLY, type=Boolean
    VOfc_OffChgCurMis
      data Flg: sw-calibration-access=READ-ONLY, type=Boolean
    VRcm_NegRlyStat
      data Enum: sw-calibration-access=READ-ONLY, type=UInt8
    VRcm_OffChgRlyStat
      data Enum: sw-calibration-access=READ-ONLY, type=UInt8
    VRcm_OnChgRlyStat
      data Enum: sw-calibration-access=READ-ONLY, type=UInt8
    VRcm_PosRlyStat
      data Enum: sw-calibration-access=READ-ONLY, type=UInt8
    VRcm_PreRlyStat
      data Enum: sw-calibration-access=READ-ONLY, type=UInt8
    VSoc_PackSocAvail
      data Pct: sw-calibration-access=READ-ONLY, type=Signal_Float
    VSof_ChgCurLmt
      data A: sw-calibration-access=READ-ONLY, type=Signal_Float
    VSof_DisCurLmt
      data A: sw-calibration-access=READ-ONLY, type=Signal_Float
    VSoh_PackSoh
      data Pct: sw-calibration-access=READ-ONLY, type=Signal_Float
    VBal_BalDone
      data Flg: sw-calibration-access=READ-ONLY, type=Boolean
    VBal_BalReq
      data Flg: sw-calibration-access=READ-ONLY, type=Boolean
    VBal_BalStat
      data Enum: sw-calibration-access=READ-ONLY, type=UInt8
    VBal_BalTgtVolt
      data V: sw-calibration-access=READ-ONLY, type=Signal_Float
    VBal_CellBalCnt
      data Cnt: sw-calibration-access=READ-ONLY, type=UInt8
    VBal_CmuDrawCurMax
      data A: sw-calibration-access=READ-ONLY, type=Signal_Float
    VBal_CmuDrawCurMin
      data A: sw-calibration-access=READ-ONLY, type=Signal_Float
    VBal_BalTime
      data Sec: sw-calibration-access=READ-ONLY, type=Float
    VBal_NvmCtrl
      data Enum: sw-calibration-access=READ-ONLY, type=UInt8
    VBmm_BalCtrl
      data Enum: sw-calibration-access=READ-ONLY, type=UInt8
    VBmm_HvilSrcCyc
      data Sec: sw-calibration-access=READ-ONLY, type=Float
    VBmm_HvilSrcDuty
      data Pct: sw-calibration-access=READ-ONLY, type=Float
    VBmm_Lv12VEn
      data Flg: sw-calibration-access=READ-ONLY, type=Boolean
    VBmm_Lv12VMonEn
      data Flg: sw-calibration-access=READ-ONLY, type=Boolean
    VBmm_McuModeCtrl
      data Enum: sw-calibration-access=READ-ONLY, type=UInt8
    VBmm_OncCtrl
      data Enum: sw-calibration-access=READ-ONLY, type=UInt8
    VRcm_PtIsoCmd
      data Enum: sw-calibration-access=READ-ONLY, type=UInt8
    VBmm_RcmCtrl
      data Enum: sw-calibration-access=READ-ONLY, type=UInt8
    VBmm_RlyCtrPwrEn
      data Flg: sw-calibration-access=READ-ONLY, type=Boolean
    VBmm_SocCtrl
      data Enum: sw-calibration-access=READ-ONLY, type=UInt8
    VBmm_SofCtrl
      data Enum: sw-calibration-access=READ-ONLY, type=UInt8
    VBmm_SohCtrl
      data Enum: sw-calibration-access=READ-ONLY, type=UInt8
    VBmm_ThmCtrl
      data Enum: sw-calibration-access=READ-ONLY, type=UInt8
    VBmm_HvOnReq
      data Flg: sw-calibration-access=READ-ONLY, type=Boolean
    VBmm_HvOffReq
      data Flg: sw-calibration-access=READ-ONLY, type=Boolean
    VDsm_AccumAhLowerOvrd
      data Ah: sw-calibration-access=READ-ONLY, type=Signal_Float
    VDsm_AccumAhUpperOvrd
      data Ah: sw-calibration-access=READ-ONLY, type=Signal_Float
    VDsm_AccumEngyOvrd
      data Kwh: sw-calibration-access=READ-ONLY, type=Signal_Float
    VDsm_AccumTimeOvrd
      data Sec: sw-calibration-access=READ-ONLY, type=Signal_Float
    VDsm_CldCapFadeOvrd
      data Pct: sw-calibration-access=READ-ONLY, type=Signal_Float
    VDsm_CldResiGrwOvrd
      data Pct: sw-calibration-access=READ-ONLY, type=Signal_Float
    VDsm_ClsMainRlyReqRCtrl
      data Enum: sw-calibration-access=READ-ONLY, type=Signal_Uint
    VDsm_ClsOnChgRlyReqRCtrl
      data Flg: sw-calibration-access=READ-ONLY, type=Signal_Uint
    VDsm_BalTimeOvrd
      data Sec: sw-calibration-access=READ-ONLY, type=Signal_Float
    VDsm_CycCapFadeOvrd
      data Pct: sw-calibration-access=READ-ONLY, type=Signal_Float
    VDsm_CycResiGrwOvrd
      data Pct: sw-calibration-access=READ-ONLY, type=Signal_Float
    VDsm_OnChgAccumTimeOvrd
      data Sec: sw-calibration-access=READ-ONLY, type=Signal_Float
    VDsm_OnChgCntOvrd
      data Cnt: sw-calibration-access=READ-ONLY, type=Signal_Uint
    VDsm_OnChgConIndCtrl
      data Flg: sw-calibration-access=READ-ONLY, type=Signal_Uint
    VDsm_OnChgingIndCtrl
      data Flg: sw-calibration-access=READ-ONLY, type=Signal_Uint
    VDsm_PtIsoCmdCtrl
      data Enum: sw-calibration-access=READ-ONLY, type=Signal_Uint
    VDsm_PumpDrvCtrl
      data Flg: sw-calibration-access=READ-ONLY, type=Signal_Uint
    VFpm_ActList
      data Enum: sw-calibration-access=READ-ONLY, type=UInt8
    VFpm_DtcInd
      data Array: sw-calibration-access=READ-ONLY, type=rt_Array_UInt8_8
    VFpm_FlamGasStat
      data Enum: sw-calibration-access=READ-ONLY, type=UInt8
    VFpm_FltInd
      data Array: sw-calibration-access=READ-ONLY, type=rt_Array_UInt8_400
    VFpm_FltLvl
      data Enum: sw-calibration-access=READ-ONLY, type=UInt8
    VFpm_LqdLvlStat
      data Enum: sw-calibration-access=READ-ONLY, type=UInt8
    VFpm_MainHvilStat
      data Flg: sw-calibration-access=READ-ONLY, type=Boolean
    VFpm_OnChgHvilStat
      data Flg: sw-calibration-access=READ-ONLY, type=Boolean
    VFpm_PtIsoLvl
      data Enum: sw-calibration-access=READ-ONLY, type=UInt8
    VFpm_FailureInd
      data Enum: sw-calibration-access=READ-ONLY, type=UInt8
    VFpm_VehEpo
      data Enum: sw-calibration-access=READ-ONLY, type=UInt8
    VOnc_ClsOnChgRlyReq
      data Flg: sw-calibration-access=READ-ONLY, type=Boolean
    VOnc_CpltOnChgDone
      data Flg: sw-calibration-access=READ-ONLY, type=Boolean
    VOnc_CpS2En
      data Flg: sw-calibration-access=READ-ONLY, type=Boolean
    VOnc_NvmCtrl
      data Enum: sw-calibration-access=READ-ONLY, type=UInt8
    VOnc_OnChgAccumTime
      data Sec: sw-calibration-access=READ-ONLY, type=Signal_Float
    VOnc_OnChgCnt
      data Cnt: sw-calibration-access=READ-ONLY, type=Signal_Uint
    VOnc_OnChgConIndDrv
      data Enum: sw-calibration-access=READ-ONLY, type=UInt8
    VOnc_OnChgDone
      data Flg: sw-calibration-access=READ-ONLY, type=Boolean
    VOnc_OnChgingIndDrv
      data Enum: sw-calibration-access=READ-ONLY, type=UInt8
    VOnc_OnChgReadyReq
      data Flg: sw-calibration-access=READ-ONLY, type=Boolean
    VRcm_RlyStep
      data Enum: sw-calibration-access=READ-ONLY, type=UInt8
    VSoc_AccumAhLower
      data Ah: sw-calibration-access=READ-ONLY, type=Signal_Float
    VSoc_AccumAhUpper
      data Ah: sw-calibration-access=READ-ONLY, type=Signal_Float
    VSoc_CellSocMax
      data Pct: sw-calibration-access=READ-ONLY, type=Signal_Float
    VSoc_CellSocMin
      data Pct: sw-calibration-access=READ-ONLY, type=Signal_Float
    VSoc_EngyAvail
      data Kwh: sw-calibration-access=READ-ONLY, type=Signal_Float
    VSoc_NvmCtrl
      data Enum: sw-calibration-access=READ-ONLY, type=UInt8
    VSoc_OdoFactor
      data Pct: sw-calibration-access=READ-ONLY, type=Signal_Float
    VSoc_PackSocActual
      data Pct: sw-calibration-access=READ-ONLY, type=Signal_Float
    VSoc_PackSocDsp
      data Pct: sw-calibration-access=READ-ONLY, type=Signal_Float
    VSof_ChgBuf
      data Pct: sw-calibration-access=READ-ONLY, type=Signal_Float
    VSof_ChgPkPwrLmt
      data Kw: sw-calibration-access=READ-ONLY, type=Signal_Float
    VSof_ChgPwrLmt
      data kw: sw-calibration-access=READ-ONLY, type=Signal_Float
    VSof_CrankCnt
      data Cnt: sw-calibration-access=READ-ONLY, type=Signal_Uint
    VSof_DisBuf
      data Pct: sw-calibration-access=READ-ONLY, type=Signal_Float
    VSof_DisPkPwrLmt
      data Kw: sw-calibration-access=READ-ONLY, type=Signal_Float
    VSof_DisPwrLmt
      data Kw: sw-calibration-access=READ-ONLY, type=Signal_Float
    VSoh_AccumEngy
      data Wh: sw-calibration-access=READ-ONLY, type=Signal_Float
    VSoh_AccumTime
      data Sec: sw-calibration-access=READ-ONLY, type=Signal_Float
    VSoh_CldCapFade
      data Pct: sw-calibration-access=READ-ONLY, type=Signal_Float
    VSoh_CldResiGrw
      data Pct: sw-calibration-access=READ-ONLY, type=Signal_Float
    VSoh_CycCapFade
      data Pct: sw-calibration-access=READ-ONLY, type=Signal_Float
    VSoh_CycResiGrw
      data Pct: sw-calibration-access=READ-ONLY, type=Signal_Float
    VSoh_NvmCtrl
      data Enum: sw-calibration-access=READ-ONLY, type=UInt8
    VSoh_PackCapFade
      data Pct: sw-calibration-access=READ-ONLY, type=Signal_Float
    VSoh_PackResiGrw
      data Pct: sw-calibration-access=READ-ONLY, type=Signal_Float
    VThm_ChillOffReq
      data Flg: sw-calibration-access=READ-ONLY, type=Boolean
    VThm_PumpDrv
      data Flg: sw-calibration-access=READ-ONLY, type=Boolean
    VThm_PumpPwrCur
      data A: sw-calibration-access=READ-ONLY, type=Signal_Float
    VThm_PumpStat
      data Enum: sw-calibration-access=READ-ONLY, type=UInt8
    VFpm_PumpDiagEn
      data Flg: sw-calibration-access=READ-ONLY, type=Boolean
    VNvm_NvmAccumAhLower
      data Ah: sw-calibration-access=READ-ONLY, type=Float
    VNvm_NvmAccumAhLowerBkp
      data Ah: sw-calibration-access=READ-ONLY, type=Float
    VNvm_NvmAccumAhUpper
      data Ah: sw-calibration-access=READ-ONLY, type=Float
    VNvm_NvmAccumAhUpperBkp
      data Ah: sw-calibration-access=READ-ONLY, type=Float
    VNvm_NvmAccumEngy
      data Kwh: sw-calibration-access=READ-ONLY, type=Float
    VNvm_NvmAccumTime
      data Sec: sw-calibration-access=READ-ONLY, type=Float
    VNvm_NvmCldCapFade
      data Pct: sw-calibration-access=READ-ONLY, type=Float
    VNvm_NvmCldResiGrw
      data Pct: sw-calibration-access=READ-ONLY, type=Float
    VNvm_NvmBalTime
      data Sec: sw-calibration-access=READ-ONLY, type=Float
    VNvm_NvmCrankCnt
      data Cnt: sw-calibration-access=READ-ONLY, type=UInt8
    VNvm_NvmCycCapFade
      data Pct: sw-calibration-access=READ-ONLY, type=Float
    VNvm_NvmCycResiGrw
      data Pct: sw-calibration-access=READ-ONLY, type=Float
    VNvm_NvmDtcInfoV
      data Flg: sw-calibration-access=READ-ONLY, type=Boolean
    VNvm_NvmOnChgAccumTime
      data Sec: sw-calibration-access=READ-ONLY, type=Float
    VNvm_NvmOnChgCnt
      data Cnt: sw-calibration-access=READ-ONLY, type=UInt16
    VNvm_NvmPresentTime
      data Array: sw-calibration-access=READ-ONLY, type=rt_Array_UInt16_6
    VIpm_BusbarTemMax
      data C: sw-calibration-access=READ-ONLY, type=Signal_Float
    VIpm_BusbarTemMin
      data C: sw-calibration-access=READ-ONLY, type=Signal_Float
    VIpm_CellVoltAvg
      data V: sw-calibration-access=READ-ONLY, type=Signal_Float
    VIpm_CpPwmCyc
      data Sec: sw-calibration-access=READ-ONLY, type=Float
    VIpm_CpPwmDuty
      data Pct: sw-calibration-access=READ-ONLY, type=Float
    VIpm_CpVolt
      data V: sw-calibration-access=READ-ONLY, type=Signal_AI
    VIpm_EngStartCplt
      data Flg: sw-calibration-access=READ-ONLY, type=Signal_Uint
    VIpm_EssCoolReady
      data Flg: sw-calibration-access=READ-ONLY, type=Signal_Uint
    VIpm_ExtPwrFb
      data Flg: sw-calibration-access=READ-ONLY, type=Boolean
    VIpm_ExtPwrMon
      data V: sw-calibration-access=READ-ONLY, type=Signal_AI
    VIpm_GwNetMode
      data Enum: sw-calibration-access=READ-ONLY, type=Signal_Uint
    VIpm_LvBat
      data V: sw-calibration-access=READ-ONLY, type=Signal_AI
    VIpm_ModBalCnt
      data Cnt: sw-calibration-access=READ-ONLY, type=Signal_Uint
    VIpm_NegRlyMon
      data V: sw-calibration-access=READ-ONLY, type=Signal_AI
    VIpm_NvmAccumAhLower
      data Ah: sw-calibration-access=READ-ONLY, type=Signal_Float
    VIpm_NvmAccumAhLowerBkp
      data Ah: sw-calibration-access=READ-ONLY, type=Signal_Float
    VIpm_NvmAccumAhUpper
      data Ah: sw-calibration-access=READ-ONLY, type=Signal_Float
    VIpm_NvmAccumAhUpperBkp
      data Ah: sw-calibration-access=READ-ONLY, type=Signal_Float
    VIpm_NvmAccumEngy
      data Kwh: sw-calibration-access=READ-ONLY, type=Signal_Float
    VIpm_NvmAccumTime
      data Sec: sw-calibration-access=READ-ONLY, type=Signal_Float
    VIpm_NvmCldCapFade
      data Pct: sw-calibration-access=READ-ONLY, type=Signal_Float
    VIpm_NvmCldResiGrw
      data Pct: sw-calibration-access=READ-ONLY, type=Signal_Float
    VIpm_NvmBalTime
      data Sec: sw-calibration-access=READ-ONLY, type=Signal_Float
    VIpm_NvmCrankCnt
      data Cnt: sw-calibration-access=READ-ONLY, type=Signal_Uint
    VIpm_NvmCycCapFade
      data Pct: sw-calibration-access=READ-ONLY, type=Signal_Float
    VIpm_NvmCycResiGrw
      data Pct: sw-calibration-access=READ-ONLY, type=Signal_Float
    VIpm_NvmDtcInfo
      data Array: sw-calibration-access=READ-ONLY, type=rt_Array_UInt8_400
    VIpm_NvmDtcInfoV
      data Flg: sw-calibration-access=READ-ONLY, type=Boolean
    VIpm_NvmOnChgAccumTime
      data Sec: sw-calibration-access=READ-ONLY, type=Signal_Float
    VIpm_NvmOnChgCnt
      data Cnt: sw-calibration-access=READ-ONLY, type=Signal_Uint
    VIpm_OffChgRlyMon
      data V: sw-calibration-access=READ-ONLY, type=Signal_AI
    VIpm_OnChgConIndDrvMon
      data V: sw-calibration-access=READ-ONLY, type=Signal_AI
    VIpm_OnChgingIndDrvMon
      data V: sw-calibration-access=READ-ONLY, type=Signal_AI
    VIpm_OnChgPlug
      data Enum: sw-calibration-access=READ-ONLY, type=UInt8
    VIpm_OnChgPlugResi
      data Ohm: sw-calibration-access=READ-ONLY, type=Signal_AI
    VIpm_OnChgRlyMon
      data V: sw-calibration-access=READ-ONLY, type=Signal_AI
    VIpm_PackCur
      data A: sw-calibration-access=READ-ONLY, type=Signal_Float
    VIpm_PosRlyMon
      data V: sw-calibration-access=READ-ONLY, type=Signal_AI
    VIpm_PreRlyMon
      data V: sw-calibration-access=READ-ONLY, type=Signal_AI
    VIpm_PtIso
      data Kohm: sw-calibration-access=READ-ONLY, type=Signal_Float
    VIpm_PumpDrvMon
      data V: sw-calibration-access=READ-ONLY, type=Signal_AI
    VIpm_PumpPwrCur
      data A: sw-calibration-access=READ-ONLY, type=Signal_AI
    VIpm_RlyCtrlCur
      data A: sw-calibration-access=READ-ONLY, type=Signal_AI
    VIpm_RtcWake
      data Flg: sw-calibration-access=READ-ONLY, type=Boolean
    VIpm_VehSpd
      data Kph: sw-calibration-access=READ-ONLY, type=Signal_Float
    VRcm_PosRlyLsdEn
      data Flg: sw-calibration-access=READ-ONLY, type=Boolean
    VRcm_NegRlyLsdEn
      data Flg: sw-calibration-access=READ-ONLY, type=Boolean
    VRcm_PreRlyLsdEn
      data Flg: sw-calibration-access=READ-ONLY, type=Boolean
    VRcm_OnChgRlyLsdEn
      data Flg: sw-calibration-access=READ-ONLY, type=Boolean
    VRcm_OffChgRlyLsdEn
      data Flg: sw-calibration-access=READ-ONLY, type=Boolean
    VBmm_EepWip
      data Flg: sw-calibration-access=READ-ONLY, type=Boolean
    VIpm_PcbTemMax
      data C: sw-calibration-access=READ-ONLY, type=Signal_Float
    VIpm_PresentTime
      data Array: sw-calibration-access=READ-ONLY, type=rt_Array_UInt16_6
    VNvm_NvmEepWipFb
      data Flg: sw-calibration-access=READ-ONLY, type=Boolean
    VDsm_CrankCntOvrd
      data Cnt: sw-calibration-access=READ-ONLY, type=Signal_Uint
    VRcm_HvOnDone
      data Flg: sw-calibration-access=READ-ONLY, type=Boolean
    VRcm_HvOffDone
      data Flg: sw-calibration-access=READ-ONLY, type=Boolean
    VIpm_PwrMode
      data Enum: sw-calibration-access=READ-ONLY, type=Signal_Uint
    VIpm_BkpPwrMode
      data Enum: sw-calibration-access=READ-ONLY, type=Signal_Uint
    VRcm_ClsMainRlyReqSInfo
      data Enum: sw-calibration-access=READ-ONLY, type=UInt8
    VRcm_ClsMainRlyReqSRspd
      data Enum: sw-calibration-access=READ-ONLY, type=UInt8
    VRcm_ClsOnChgRlyReqSInfo
      data Enum: sw-calibration-access=READ-ONLY, type=UInt8
    VRcm_ClsOnChgRlyReqSRspd
      data Enum: sw-calibration-access=READ-ONLY, type=UInt8
    VIpm_GwNetModeV
      data Enum: sw-calibration-access=READ-ONLY, type=Signal_Uint
    VSof_SofMode
      data Enum: sw-calibration-access=READ-ONLY, type=UInt8
    VIpm_Odo
      data Km: sw-calibration-access=READ-ONLY, type=Signal_Float
    VRcm_MainRlyStat
      data Enum: sw-calibration-access=READ-ONLY, type=UInt8
  client server interface VOpm_NvmCriticalDataReq
    operation NvmCriticalDataReq
      arg NvmCriticalDataReq_Enum: type=UInt8, direction=IN
  298 x sender receiver interface:
    VBal_RtcTime
      data Structure: sw-calibration-access=READ-ONLY, type=RTC_ClockType
    VIpm_NvmPackSocDsp
      data Pct: sw-calibration-access=READ-ONLY, type=Signal_Float
    VIpm_OnChrgrEfficiency
      data Pct: sw-calibration-access=READ-ONLY, type=Signal_Float
    VIpm_OnChrgrAcVolt
      data V: sw-calibration-access=READ-ONLY, type=Signal_Float
    VIpm_OnChrgrAcCur
      data A: sw-calibration-access=READ-ONLY, type=Signal_Float
    VIpm_OnChrgrLvCur
      data A: sw-calibration-access=READ-ONLY, type=Signal_Float
    VIpm_OnChrgrLvVolt
      data V: sw-calibration-access=READ-ONLY, type=Signal_Float
    VIpm_Chrgr12VHdwrOverCur
      data Flg: sw-calibration-access=READ-ONLY, type=Signal_Uint
    VIpm_ChrgrIntnlLvUnderVolt
      data Flg: sw-calibration-access=READ-ONLY, type=Signal_Uint
    VIpm_ChrgrIntnlLvOverVolt
      data Flg: sw-calibration-access=READ-ONLY, type=Signal_Uint
    VIpm_CabErrInd
      data Flg: sw-calibration-access=READ-ONLY, type=Signal_Uint
    VIpm_CellOverVolt
      data Flg: sw-calibration-access=READ-ONLY, type=Signal_Uint
    VIpm_CellUnderVolt
      data Flg: sw-calibration-access=READ-ONLY, type=Signal_Uint
    VIpm_CellTemAvg
      data C: sw-calibration-access=READ-ONLY, type=Signal_Float
    VIpm_HvmFaultOut
      data Flg: sw-calibration-access=READ-ONLY, type=Signal_Uint
    VIpm_HvmLeakUpdata
      data Flg: sw-calibration-access=READ-ONLY, type=Signal_Uint
    VIpm_HvmLeakRawH
      data Kohm: sw-calibration-access=READ-ONLY, type=Signal_Uint
    VIpm_HvmLeakRawL
      data Kohm: sw-calibration-access=READ-ONLY, type=Signal_Uint
    VIpm_HvmLeakMultiPr
      data Enum: sw-calibration-access=READ-ONLY, type=Signal_Uint
    VIpm_OnChgFs
      data V: sw-calibration-access=READ-ONLY, type=Signal_Float
    VIpm_Mod01TemBusbar
      data C: sw-calibration-access=READ-ONLY, type=Signal_Float
    VIpm_Mod01Volt
      data V: sw-calibration-access=READ-ONLY, type=Signal_Float
    VIpm_EngCoolTem
      data C: sw-calibration-access=READ-ONLY, type=Signal_Float
    VIpm_BkpPwrModeEnbd
      data Flg: sw-calibration-access=READ-ONLY, type=Signal_Uint
    VIpm_PtIsoDiagInfoUpdate
      data Flg: sw-calibration-access=READ-ONLY, type=Signal_Uint
    VIpm_Mod02TemBusbar
      data C: sw-calibration-access=READ-ONLY, type=Signal_Float
    VIpm_Mod02Volt
      data V: sw-calibration-access=READ-ONLY, type=Signal_Float
    VIpm_Mod03TemBusbar
      data C: sw-calibration-access=READ-ONLY, type=Signal_Float
    VIpm_Mod03Volt
      data V: sw-calibration-access=READ-ONLY, type=Signal_Float
    VIpm_Mod04TemBusbar
      data C: sw-calibration-access=READ-ONLY, type=Signal_Float
    VIpm_Mod04Volt
      data V: sw-calibration-access=READ-ONLY, type=Signal_Float
    VIpm_Mod05TemBusbar
      data C: sw-calibration-access=READ-ONLY, type=Signal_Float
    VIpm_Mod05Volt
      data V: sw-calibration-access=READ-ONLY, type=Signal_Float
    VIpm_Mod06TemBusbar
      data C: sw-calibration-access=READ-ONLY, type=Signal_Float
    VIpm_Mod06Volt
      data V: sw-calibration-access=READ-ONLY, type=Signal_Float
    VIpm_SysVolt
      data V: sw-calibration-access=READ-ONLY, type=Signal_Float
    VIpm_SysVoltMode
      data Enum: sw-calibration-access=READ-ONLY, type=Signal_Uint
    VIpm_SysOpnlMode
      data Enum: sw-calibration-access=READ-ONLY, type=Signal_Uint
    VIpm_PwrMdRunCrkStat
      data Flg: sw-calibration-access=READ-ONLY, type=Signal_Uint
    VIpm_PwrMdAccStat
      data Flg: sw-calibration-access=READ-ONLY, type=Signal_Uint
    VIpm_PwrRlsReq
      data Flg: sw-calibration-access=READ-ONLY, type=Signal_Uint
    VIpm_TrEstdGear
      data Enum: sw-calibration-access=READ-ONLY, type=Signal_Uint
    VIpm_HcuChecksum05
      data Cnt: sw-calibration-access=READ-ONLY, type=Signal_Uint
    VIpm_HcuCounter05
      data Cnt: sw-calibration-access=READ-ONLY, type=Signal_Uint
    VIpm_CldYear
      data Yr: sw-calibration-access=READ-ONLY, type=Signal_Uint
    VIpm_CldMonth
      data Mon: sw-calibration-access=READ-ONLY, type=Signal_Uint
    VIpm_CldDay
      data Day: sw-calibration-access=READ-ONLY, type=Signal_Uint
    VIpm_CldHourOfDay
      data Hr: sw-calibration-access=READ-ONLY, type=Signal_Uint
    VIpm_CldMinOfHour
      data Min: sw-calibration-access=READ-ONLY, type=Signal_Uint
    VIpm_CldSecOfMin
      data sec: sw-calibration-access=READ-ONLY, type=Signal_Uint
    VIpm_CanWake
      data Flg: sw-calibration-access=READ-ONLY, type=Boolean
    VIpm_CpStat
      data Flg: sw-calibration-access=READ-ONLY, type=Boolean
    VIpm_CrashEn
      data Flg: sw-calibration-access=READ-ONLY, type=Boolean
    VIpm_CrashNMon
      data Flg: sw-calibration-access=READ-ONLY, type=Boolean
    VIpm_INT
      data Flg: sw-calibration-access=READ-ONLY, type=Boolean
    VIpm_Lv5VFb
      data Flg: sw-calibration-access=READ-ONLY, type=Boolean
    VIpm_Lv5V
      data V: sw-calibration-access=READ-ONLY, type=Signal_AI
    VIpm_Safe
      data Flg: sw-calibration-access=READ-ONLY, type=Boolean
    VNvm_NvmPackSocDsp
      data Pct: sw-calibration-access=READ-ONLY, type=Float
    VIpm_Rcv0x1F1
      data Flg: sw-calibration-access=READ-ONLY, type=Boolean
    VIpm_HvmLeakSwitch
      data Enum: sw-calibration-access=READ-ONLY, type=Signal_Uint
    VOnc_OnChgAcCurLmt
      data A: sw-calibration-access=READ-ONLY, type=Signal_Float
    VIpm_PackCur2
      data A: sw-calibration-access=READ-ONLY, type=Signal_Float
    VOpm_NvmAccumAhLower
      data Ah: sw-calibration-access=READ-ONLY, type=Float
    VOpm_NvmAccumAhUpper
      data Ah: sw-calibration-access=READ-ONLY, type=Float
    VOpm_NvmAccumEngy
      data Wh: sw-calibration-access=READ-ONLY, type=Float
    VOpm_NvmAccumTime
      data Sec: sw-calibration-access=READ-ONLY, type=Float
    VOpm_NvmBalTime
      data Sec: sw-calibration-access=READ-ONLY, type=Float
    VOpm_NvmEepWip: is-service=true
      data Enum: sw-calibration-access=READ-ONLY, type=UInt16
    VOpm_NvmCldCapFade
      data Pct: sw-calibration-access=READ-ONLY, type=Float
    VOpm_NvmCldResiGrw
      data Pct: sw-calibration-access=READ-ONLY, type=Float
    VOpm_NvmCycCapFade
      data Pct: sw-calibration-access=READ-ONLY, type=Float
    VOpm_NvmCycResiGrw
      data Pct: sw-calibration-access=READ-ONLY, type=Float
    VOpm_NvmCrankCnt
      data Cnt: sw-calibration-access=READ-ONLY, type=UInt8
    VOpm_NvmOnChgAccumTime
      data Sec: sw-calibration-access=READ-ONLY, type=Float
    VOpm_NvmOnChgCnt
      data Cnt: sw-calibration-access=READ-ONLY, type=UInt16
    VOpm_NvmPackSocDsp
      data Pct: sw-calibration-access=READ-ONLY, type=Float
    VOpm_NvmPresentTime
      data Array: sw-calibration-access=READ-ONLY, type=rt_Array_UInt16_6
    VIpm_Chrgr12VHdwrOverVolt
      data Flg: sw-calibration-access=READ-ONLY, type=Signal_Uint
    VIpm_Chrgr12VOptCirctBroken
      data Flg: sw-calibration-access=READ-ONLY, type=Signal_Uint
    VIpm_ChrgrAmbTempTooHigh
      data Flg: sw-calibration-access=READ-ONLY, type=Signal_Uint
    VIpm_ChrgrAmbTempTooLow
      data Flg: sw-calibration-access=READ-ONLY, type=Signal_Uint
    VIpm_ChrgrBatLvOverVolt
      data Flg: sw-calibration-access=READ-ONLY, type=Signal_Uint
    VIpm_ChrgrBatLvUnderVolt
      data Flg: sw-calibration-access=READ-ONLY, type=Signal_Uint
    VIpm_ChrgrEepromErr
      data Flg: sw-calibration-access=READ-ONLY, type=Signal_Uint
    VIpm_ChrgrEnTo
      data Flg: sw-calibration-access=READ-ONLY, type=Signal_Uint
    VIpm_ChrgrFlashErr
      data Flg: sw-calibration-access=READ-ONLY, type=Signal_Uint
    VIpm_ChrgrHvilFlr
      data Flg: sw-calibration-access=READ-ONLY, type=Signal_Uint
    VIpm_ChrgrLvSecCommErr
      data Flg: sw-calibration-access=READ-ONLY, type=Signal_Uint
    VIpm_ChrgrPriySideHdwrOverC
      data Flg: sw-calibration-access=READ-ONLY, type=Signal_Uint
    VIpm_ChrgrPriySideStwrOverC
      data Flg: sw-calibration-access=READ-ONLY, type=Signal_Uint
    VIpm_ChrgrRamErr
      data Flg: sw-calibration-access=READ-ONLY, type=Signal_Uint
    VIpm_ChrgrSecPriCommErr
      data Flg: sw-calibration-access=READ-ONLY, type=Signal_Uint
    VIpm_ChrgrSecSideHdwrOverC
      data Flg: sw-calibration-access=READ-ONLY, type=Signal_Uint
    VIpm_ChrgrSecStwrOverC
      data Flg: sw-calibration-access=READ-ONLY, type=Signal_Uint
    VIpm_ChrgrWakeuErr
      data Flg: sw-calibration-access=READ-ONLY, type=Signal_Uint
    VIpm_ChrgrYear
      data Yr: sw-calibration-access=READ-ONLY, type=Signal_Uint
    VIpm_ChrgrMonth
      data Mon: sw-calibration-access=READ-ONLY, type=Signal_Uint
    VIpm_ChrgrDay
      data Day: sw-calibration-access=READ-ONLY, type=Signal_Uint
    VIpm_ChrgrUniqueNum
      data Cnt: sw-calibration-access=READ-ONLY, type=Signal_Uint
    VIpm_PcbTemMin
      data C: sw-calibration-access=READ-ONLY, type=Signal_Float
    VIpm_RtcErr
      data Enum: sw-calibration-access=READ-ONLY, type=Signal_Uint
    VIpm_AcpVolt
      data V: sw-calibration-access=READ-ONLY, type=Signal_Float
    VIpm_EssPwmCoolPumpStat
      data Flg: sw-calibration-access=READ-ONLY, type=Signal_Uint
    VIpm_AcpPwr
      data Kw: sw-calibration-access=READ-ONLY, type=Signal_Float
    VIpm_ScsAvail
      data Flg: sw-calibration-access=READ-ONLY, type=Signal_Uint
    VIpm_IpkAvail
      data Flg: sw-calibration-access=READ-ONLY, type=Signal_Uint
    VIpm_BcmAvail
      data Flg: sw-calibration-access=READ-ONLY, type=Signal_Uint
    VIpm_AcAvail
      data Flg: sw-calibration-access=READ-ONLY, type=Signal_Uint
    VIpm_PackCurMisStat
      data Enum: sw-calibration-access=READ-ONLY, type=UInt8
    VOnc_OnChgSysKeepWake
      data Flg: sw-calibration-access=READ-ONLY, type=Signal_Uint
    VOnc_OnChgPwrEfncy
      data Pct: sw-calibration-access=READ-ONLY, type=Signal_Float
    VThm_EssPwmCoolPumpFlowReq
      data Enum: sw-calibration-access=READ-ONLY, type=UInt8
    VIpm_NvmPackSocDspBkp
      data Pct: sw-calibration-access=READ-ONLY, type=Signal_Float
    VIpm_NvmBmsSwFlashFlg
      data Flg: sw-calibration-access=READ-ONLY, type=Boolean
    VIpm_NvmSocSwVer
      data Enum: sw-calibration-access=READ-ONLY, type=Signal_Uint
    VDsm_PackSocDspOvrd
      data Pct: sw-calibration-access=READ-ONLY, type=Signal_Float
    VSoc_SocSwVer
      data Enum: sw-calibration-access=READ-ONLY, type=Signal_Uint
    VOpm_NvmSocSwVer
      data Enum: sw-calibration-access=READ-ONLY, type=UInt32
    VNvm_NvmPackSocDspBkp
      data Pct: sw-calibration-access=READ-ONLY, type=Float
    VNvm_NvmSocSwVer
      data Enum: sw-calibration-access=READ-ONLY, type=UInt32
    VDsm_BmsSwFlashFlg
      data Flg: sw-calibration-access=READ-ONLY, type=Boolean
    VSoe_PackSoeDsp
      data Pct: sw-calibration-access=READ-ONLY, type=Signal_Float
    VNvm_NvmPackSoeDsp
      data Pct: sw-calibration-access=READ-ONLY, type=Float
    VIpm_NvmPackSoeDsp
      data Pct: sw-calibration-access=READ-ONLY, type=Signal_Float
    VOpm_NvmPackSoeDsp
      data Pct: sw-calibration-access=READ-ONLY, type=Float
    VIpm_NvmCellSoeMax
      data Pct: sw-calibration-access=READ-ONLY, type=Signal_Float
    VIpm_NvmCellSoeMin
      data Pct: sw-calibration-access=READ-ONLY, type=Signal_Float
    VIpm_NvmPackSoeActual
      data Pct: sw-calibration-access=READ-ONLY, type=Signal_Float
    VIpm_NvmPackSoeAvail
      data Pct: sw-calibration-access=READ-ONLY, type=Signal_Float
    VNvm_NvmCellSoeMax
      data Pct: sw-calibration-access=READ-ONLY, type=Float
    VNvm_NvmCellSoeMin
      data Pct: sw-calibration-access=READ-ONLY, type=Float
    VNvm_NvmPackSoeActual
      data Pct: sw-calibration-access=READ-ONLY, type=Float
    VNvm_NvmPackSoeAvail
      data Pct: sw-calibration-access=READ-ONLY, type=Float
    VSoe_CellSoeMax
      data Pct: sw-calibration-access=READ-ONLY, type=Signal_Float
    VSoe_CellSoeMin
      data Pct: sw-calibration-access=READ-ONLY, type=Signal_Float
    VSoe_PackSoeActual
      data Pct: sw-calibration-access=READ-ONLY, type=Signal_Float
    VSoe_PackSoeAvail
      data Pct: sw-calibration-access=READ-ONLY, type=Signal_Float
    VOpm_NvmCellSoeMax
      data Pct: sw-calibration-access=READ-ONLY, type=Float
    VOpm_NvmCellSoeMin
      data Pct: sw-calibration-access=READ-ONLY, type=Float
    VOpm_NvmPackSoeActual
      data Pct: sw-calibration-access=READ-ONLY, type=Float
    VOpm_NvmPackSoeAvail
      data Pct: sw-calibration-access=READ-ONLY, type=Float
    VFpm_DtcOvCnt
      data Cnt: sw-calibration-access=READ-ONLY, type=UInt32
    VFpm_DtcUvCnt
      data Cnt: sw-calibration-access=READ-ONLY, type=UInt32
    VFpm_DtcInLeakgeCnt
      data Cnt: sw-calibration-access=READ-ONLY, type=UInt32
    VFpm_DtcExLeakgeCnt
      data Cnt: sw-calibration-access=READ-ONLY, type=UInt32
    VRcm_DtcRlyOpenCurLvl1Cnt
      data Cnt: sw-calibration-access=READ-ONLY, type=UInt32
    VRcm_DtcRlyOpenCurLvl2Cnt
      data Cnt: sw-calibration-access=READ-ONLY, type=UInt32
    VRcm_DtcRlyOpenCurLvl3Cnt
      data Cnt: sw-calibration-access=READ-ONLY, type=UInt32
    VFpm_CmuMissCnt
      data Cnt: sw-calibration-access=READ-ONLY, type=UInt32
    VFpm_DtcSocLoTime
      data Sec: sw-calibration-access=READ-ONLY, type=Float
    VFpm_CmuMissTime
      data Sec: sw-calibration-access=READ-ONLY, type=Float
    VOpm_NvmCmuMissCnt
      data Cnt: sw-calibration-access=READ-ONLY, type=UInt32
    VOpm_NvmCmuMissTime
      data Sec: sw-calibration-access=READ-ONLY, type=Float
    VOpm_NvmDtcExLeakgeCnt
      data Cnt: sw-calibration-access=READ-ONLY, type=UInt32
    VOpm_NvmDtcInLeakgeCnt
      data Cnt: sw-calibration-access=READ-ONLY, type=UInt32
    VOpm_NvmDtcOvCnt
      data Cnt: sw-calibration-access=READ-ONLY, type=UInt32
    VOpm_NvmDtcRlyOpenCurLvl1Cnt
      data Cnt: sw-calibration-access=READ-ONLY, type=UInt32
    VOpm_NvmDtcRlyOpenCurLvl2Cnt
      data Cnt: sw-calibration-access=READ-ONLY, type=UInt32
    VOpm_NvmDtcRlyOpenCurLvl3Cnt
      data Cnt: sw-calibration-access=READ-ONLY, type=UInt32
    VOpm_NvmDtcSocLoTime
      data Sec: sw-calibration-access=READ-ONLY, type=Float
    VOpm_NvmDtcUvCnt
      data Cnt: sw-calibration-access=READ-ONLY, type=UInt32
    VRcm_DtcRlyOpenCurCnt
      data Cnt: sw-calibration-access=READ-ONLY, type=UInt32
    VRcm_DtcPreChgEnyCnt
      data Cnt: sw-calibration-access=READ-ONLY, type=UInt32
    VRcm_DtcPreChgToCnt
      data Cnt: sw-calibration-access=READ-ONLY, type=UInt32
    VOpm_NvmDtcPreChgEnyCnt
      data Cnt: sw-calibration-access=READ-ONLY, type=UInt32
    VOpm_NvmDtcPreChgToCnt
      data Cnt: sw-calibration-access=READ-ONLY, type=UInt32
    VOpm_NvmDtcRlyOpenCurCnt
      data Cnt: sw-calibration-access=READ-ONLY, type=UInt32
    VOpm_NvmTempLvl1Cnt
      data Cnt: sw-calibration-access=READ-ONLY, type=UInt32
    VOpm_NvmTempLvl2Cnt
      data Cnt: sw-calibration-access=READ-ONLY, type=UInt32
    VOpm_NvmTempLvl3Cnt
      data Cnt: sw-calibration-access=READ-ONLY, type=UInt32
    VOpm_NvmTempLvl4Cnt
      data Cnt: sw-calibration-access=READ-ONLY, type=UInt32
    VOpm_NvmTempLvl5Cnt
      data Cnt: sw-calibration-access=READ-ONLY, type=UInt32
    VOpm_NvmTempLvl6Cnt
      data Cnt: sw-calibration-access=READ-ONLY, type=UInt32
    VOpm_NvmTempLvl7Cnt
      data Cnt: sw-calibration-access=READ-ONLY, type=UInt32
    VNvm_NvmCmuMissCnt
      data Cnt: sw-calibration-access=READ-ONLY, type=UInt32
    VNvm_NvmCmuMissTime
      data Sec: sw-calibration-access=READ-ONLY, type=Float
    VNvm_NvmDtcExLeakgeCnt
      data Cnt: sw-calibration-access=READ-ONLY, type=UInt32
    VNvm_NvmDtcInLeakgeCnt
      data Cnt: sw-calibration-access=READ-ONLY, type=UInt32
    VNvm_NvmDtcOvCnt
      data Cnt: sw-calibration-access=READ-ONLY, type=UInt32
    VNvm_NvmDtcPreChgEnyCnt
      data Cnt: sw-calibration-access=READ-ONLY, type=UInt32
    VNvm_NvmDtcPreChgToCnt
      data Cnt: sw-calibration-access=READ-ONLY, type=UInt32
    VNvm_NvmDtcRlyOpenCurCnt
      data Cnt: sw-calibration-access=READ-ONLY, type=UInt32
    VNvm_NvmDtcRlyOpenCurLvl1Cnt
      data Cnt: sw-calibration-access=READ-ONLY, type=UInt32
    VNvm_NvmDtcRlyOpenCurLvl2Cnt
      data Cnt: sw-calibration-access=READ-ONLY, type=UInt32
    VNvm_NvmDtcRlyOpenCurLvl3Cnt
      data Cnt: sw-calibration-access=READ-ONLY, type=UInt32
    VNvm_NvmDtcSocLoTime
      data Sec: sw-calibration-access=READ-ONLY, type=Float
    VNvm_NvmDtcUvCnt
      data Cnt: sw-calibration-access=READ-ONLY, type=UInt32
    VNvm_NvmTempLvl1Cnt
      data Cnt: sw-calibration-access=READ-ONLY, type=UInt32
    VNvm_NvmTempLvl2Cnt
      data Cnt: sw-calibration-access=READ-ONLY, type=UInt32
    VNvm_NvmTempLvl3Cnt
      data Cnt: sw-calibration-access=READ-ONLY, type=UInt32
    VNvm_NvmTempLvl4Cnt
      data Cnt: sw-calibration-access=READ-ONLY, type=UInt32
    VNvm_NvmTempLvl5Cnt
      data Cnt: sw-calibration-access=READ-ONLY, type=UInt32
    VNvm_NvmTempLvl6Cnt
      data Cnt: sw-calibration-access=READ-ONLY, type=UInt32
    VNvm_NvmTempLvl7Cnt
      data Cnt: sw-calibration-access=READ-ONLY, type=UInt32
    VNvm_NvmCmuMissCntBkp
      data Cnt: sw-calibration-access=READ-ONLY, type=UInt32
    VNvm_NvmCmuMissTimeBkp
      data Sec: sw-calibration-access=READ-ONLY, type=Float
    VNvm_NvmDtcExLeakgeCntBkp
      data Cnt: sw-calibration-access=READ-ONLY, type=UInt32
    VNvm_NvmDtcInLeakgeCntBkp
      data Cnt: sw-calibration-access=READ-ONLY, type=UInt32
    VNvm_NvmDtcOvCntBkp
      data Cnt: sw-calibration-access=READ-ONLY, type=UInt32
    VNvm_NvmDtcPreChgEnyCntBkp
      data Cnt: sw-calibration-access=READ-ONLY, type=UInt32
    VNvm_NvmDtcPreChgToCntBkp
      data Cnt: sw-calibration-access=READ-ONLY, type=UInt32
    VNvm_NvmDtcRlyOpenCurCntBkp
      data Cnt: sw-calibration-access=READ-ONLY, type=UInt32
    VNvm_NvmDtcRlyOpenCurLvl1CntBkp
      data Cnt: sw-calibration-access=READ-ONLY, type=UInt32
    VNvm_NvmDtcRlyOpenCurLvl2CntBkp
      data Cnt: sw-calibration-access=READ-ONLY, type=UInt32
    VNvm_NvmDtcRlyOpenCurLvl3CntBkp
      data Cnt: sw-calibration-access=READ-ONLY, type=UInt32
    VNvm_NvmDtcSocLoTimeBkp
      data Sec: sw-calibration-access=READ-ONLY, type=Float
    VNvm_NvmDtcUvCntBkp
      data Cnt: sw-calibration-access=READ-ONLY, type=UInt32
    VNvm_NvmTempLvl1CntBkp
      data Cnt: sw-calibration-access=READ-ONLY, type=UInt32
    VNvm_NvmTempLvl2CntBkp
      data Cnt: sw-calibration-access=READ-ONLY, type=UInt32
    VNvm_NvmTempLvl3CntBkp
      data Cnt: sw-calibration-access=READ-ONLY, type=UInt32
    VNvm_NvmTempLvl4CntBkp
      data Cnt: sw-calibration-access=READ-ONLY, type=UInt32
    VNvm_NvmTempLvl5CntBkp
      data Cnt: sw-calibration-access=READ-ONLY, type=UInt32
    VNvm_NvmTempLvl6CntBkp
      data Cnt: sw-calibration-access=READ-ONLY, type=UInt32
    VNvm_NvmTempLvl7CntBkp
      data Cnt: sw-calibration-access=READ-ONLY, type=UInt32
    VIpm_NvmCmuMissCnt
      data Cnt: sw-calibration-access=READ-ONLY, type=Signal_Uint
    VIpm_NvmCmuMissTime
      data Sec: sw-calibration-access=READ-ONLY, type=Signal_Float
    VIpm_NvmDtcExLeakgeCnt
      data Cnt: sw-calibration-access=READ-ONLY, type=Signal_Uint
    VIpm_NvmDtcInLeakgeCnt
      data Cnt: sw-calibration-access=READ-ONLY, type=Signal_Uint
    VIpm_NvmDtcOvCnt
      data Cnt: sw-calibration-access=READ-ONLY, type=Signal_Uint
    VIpm_NvmDtcPreChgEnyCnt
      data Cnt: sw-calibration-access=READ-ONLY, type=Signal_Uint
    VIpm_NvmDtcPreChgToCnt
      data Cnt: sw-calibration-access=READ-ONLY, type=Signal_Uint
    VIpm_NvmDtcRlyOpenCurCnt
      data Cnt: sw-calibration-access=READ-ONLY, type=Signal_Uint
    VIpm_NvmDtcRlyOpenCurLvl1Cnt
      data Cnt: sw-calibration-access=READ-ONLY, type=Signal_Uint
    VIpm_NvmDtcRlyOpenCurLvl2Cnt
      data Cnt: sw-calibration-access=READ-ONLY, type=Signal_Uint
    VIpm_NvmDtcRlyOpenCurLvl3Cnt
      data Cnt: sw-calibration-access=READ-ONLY, type=Signal_Uint
    VIpm_NvmDtcSocLoTime
      data Sec: sw-calibration-access=READ-ONLY, type=Signal_Float
    VIpm_NvmDtcUvCnt
      data Cnt: sw-calibration-access=READ-ONLY, type=Signal_Uint
    VIpm_NvmTempLvl1Cnt
      data Cnt: sw-calibration-access=READ-ONLY, type=Signal_Uint
    VIpm_NvmTempLvl2Cnt
      data Cnt: sw-calibration-access=READ-ONLY, type=Signal_Uint
    VIpm_NvmTempLvl3Cnt
      data Cnt: sw-calibration-access=READ-ONLY, type=Signal_Uint
    VIpm_NvmTempLvl4Cnt
      data Cnt: sw-calibration-access=READ-ONLY, type=Signal_Uint
    VIpm_NvmTempLvl5Cnt
      data Cnt: sw-calibration-access=READ-ONLY, type=Signal_Uint
    VIpm_NvmTempLvl6Cnt
      data Cnt: sw-calibration-access=READ-ONLY, type=Signal_Uint
    VIpm_NvmTempLvl7Cnt
      data Cnt: sw-calibration-access=READ-ONLY, type=Signal_Uint
    VIpm_NvmCmuMissCntBkp
      data Cnt: sw-calibration-access=READ-ONLY, type=Signal_Uint
    VIpm_NvmCmuMissTimeBkp
      data Sec: sw-calibration-access=READ-ONLY, type=Signal_Float
    VIpm_NvmDtcExLeakgeCntBkp
      data Cnt: sw-calibration-access=READ-ONLY, type=Signal_Uint
    VIpm_NvmDtcInLeakgeCntBkp
      data Cnt: sw-calibration-access=READ-ONLY, type=Signal_Uint
    VIpm_NvmDtcOvCntBkp
      data Cnt: sw-calibration-access=READ-ONLY, type=Signal_Uint
    VIpm_NvmDtcPreChgEnyCntBkp
      data Cnt: sw-calibration-access=READ-ONLY, type=Signal_Uint
    VIpm_NvmDtcPreChgToCntBkp
      data Cnt: sw-calibration-access=READ-ONLY, type=Signal_Uint
    VIpm_NvmDtcRlyOpenCurCntBkp
      data Cnt: sw-calibration-access=READ-ONLY, type=Signal_Uint
    VIpm_NvmDtcRlyOpenCurLvl1CntBkp
      data Cnt: sw-calibration-access=READ-ONLY, type=Signal_Uint
    VIpm_NvmDtcRlyOpenCurLvl2CntBkp
      data Cnt: sw-calibration-access=READ-ONLY, type=Signal_Uint
    VIpm_NvmDtcRlyOpenCurLvl3CntBkp
      data Cnt: sw-calibration-access=READ-ONLY, type=Signal_Uint
    VIpm_NvmDtcSocLoTimeBkp
      data Sec: sw-calibration-access=READ-ONLY, type=Signal_Float
    VIpm_NvmDtcUvCntBkp
      data Cnt: sw-calibration-access=READ-ONLY, type=Signal_Uint
    VIpm_NvmTempLvl1CntBkp
      data Cnt: sw-calibration-access=READ-ONLY, type=Signal_Uint
    VIpm_NvmTempLvl2CntBkp
      data Cnt: sw-calibration-access=READ-ONLY, type=Signal_Uint
    VIpm_NvmTempLvl3CntBkp
      data Cnt: sw-calibration-access=READ-ONLY, type=Signal_Uint
    VIpm_NvmTempLvl4CntBkp
      data Cnt: sw-calibration-access=READ-ONLY, type=Signal_Uint
    VIpm_NvmTempLvl5CntBkp
      data Cnt: sw-calibration-access=READ-ONLY, type=Signal_Uint
    VIpm_NvmTempLvl6CntBkp
      data Cnt: sw-calibration-access=READ-ONLY, type=Signal_Uint
    VIpm_NvmTempLvl7CntBkp
      data Cnt: sw-calibration-access=READ-ONLY, type=Signal_Uint
    VIpm_AppReserChgStDurtnTime
      data Hr: sw-calibration-access=READ-ONLY, type=Signal_Float
    VIpm_AppNetTimeV
      data Flg: sw-calibration-access=READ-ONLY, type=Boolean
    VIpm_AppReserChgReqEngy
      data Kwh: sw-calibration-access=READ-ONLY, type=Signal_Float
    VIpm_AppReserChgReqRange
      data Km: sw-calibration-access=READ-ONLY, type=Signal_Float
    VOnc_OnChgRemainTime
      data Hr: sw-calibration-access=READ-ONLY, type=Signal_Float
    VIpm_AppReserChgReqTime
      data Hr: sw-calibration-access=READ-ONLY, type=Signal_Float
    VNvm_NvmReserChgReqEngy
      data Kwh: sw-calibration-access=READ-ONLY, type=Float
    VNvm_NvmReserChgReqFreq
      data Enum: sw-calibration-access=READ-ONLY, type=UInt8
    VNvm_NvmReserChgReqRange
      data Km: sw-calibration-access=READ-ONLY, type=Float
    VNvm_NvmReserChgReqTime
      data Hr: sw-calibration-access=READ-ONLY, type=Float
    VOnc_OnChgCeaseReason
      data Enum: sw-calibration-access=READ-ONLY, type=UInt8
    VOpm_NvmReserChgEngy
      data Kwh: sw-calibration-access=READ-ONLY, type=Float
    VOpm_NvmReserChgFreq
      data Enum: sw-calibration-access=READ-ONLY, type=UInt8
    VOpm_NvmReserChgMode
      data Enum: sw-calibration-access=READ-ONLY, type=UInt8
    VOpm_NvmReserChgReq
      data Enum: sw-calibration-access=READ-ONLY, type=UInt8
    VOpm_NvmReserChgRng
      data Km: sw-calibration-access=READ-ONLY, type=Float
    VOpm_NvmReserChgStartTime
      data Array: sw-calibration-access=READ-ONLY, type=rt_Array_Float_6
    VOpm_NvmReserChgTime
      data Hr: sw-calibration-access=READ-ONLY, type=Float
    VSoc_KoCellVoltMax
      data V: sw-calibration-access=READ-ONLY, type=Signal_Float
    VSoc_KoCellVoltMin
      data V: sw-calibration-access=READ-ONLY, type=Signal_Float
    VSoc_KoPackCur
      data A: sw-calibration-access=READ-ONLY, type=Signal_Float
    VSoc_KoAvgPackCur
      data A: sw-calibration-access=READ-ONLY, type=Signal_Float
    VOpm_NvmKoAvgPackCur
      data A: sw-calibration-access=READ-ONLY, type=Float
    VOpm_NvmKoCellVoltMax
      data V: sw-calibration-access=READ-ONLY, type=Float
    VOpm_NvmKoCellVoltMin
      data V: sw-calibration-access=READ-ONLY, type=Float
    VOpm_NvmKoPackCur
      data A: sw-calibration-access=READ-ONLY, type=Float
    VNvm_NvmKoAvgPackCur
      data A: sw-calibration-access=READ-ONLY, type=Float
    VNvm_NvmKoCellVoltMax
      data V: sw-calibration-access=READ-ONLY, type=Float
    VNvm_NvmKoCellVoltMin
      data V: sw-calibration-access=READ-ONLY, type=Float
    VNvm_NvmKoPackCur
      data A: sw-calibration-access=READ-ONLY, type=Float
    VNvm_NvmKoAvgPackCurBkp
      data A: sw-calibration-access=READ-ONLY, type=Float
    VNvm_NvmKoCellVoltMaxBkp
      data V: sw-calibration-access=READ-ONLY, type=Float
    VNvm_NvmKoCellVoltMinBkp
      data V: sw-calibration-access=READ-ONLY, type=Float
    VNvm_NvmKoPackCurBkp
      data A: sw-calibration-access=READ-ONLY, type=Float
    VIpm_NvmKoAvgPackCur
      data A: sw-calibration-access=READ-ONLY, type=Signal_Float
    VIpm_NvmKoCellVoltMax
      data V: sw-calibration-access=READ-ONLY, type=Signal_Float
    VIpm_NvmKoCellVoltMin
      data V: sw-calibration-access=READ-ONLY, type=Signal_Float
    VIpm_NvmKoPackCur
      data A: sw-calibration-access=READ-ONLY, type=Signal_Float
    VIpm_NvmKoAvgPackCurBkp
      data A: sw-calibration-access=READ-ONLY, type=Signal_Float
    VIpm_NvmKoCellVoltMaxBkp
      data V: sw-calibration-access=READ-ONLY, type=Signal_Float
    VIpm_NvmKoCellVoltMinBkp
      data V: sw-calibration-access=READ-ONLY, type=Signal_Float
    VIpm_NvmKoPackCurBkp
      data A: sw-calibration-access=READ-ONLY, type=Signal_Float
    VIpm_Rcv0x3B8
      data Flg: sw-calibration-access=READ-ONLY, type=Boolean
  6 x client server interface:
    VOpm_NvmCoreDataReq
      operation NvmCoreDataReq
        arg NvmCoreDataReq_Enum: type=UInt8, direction=IN
    VOpm_NvmBlackBoxDataReq
      operation NvmBlackBoxDataReq
        arg NvmBlackBoxDataReq_Enum: type=UInt8, direction=IN
    VOpm_NvmBlackBoxMirrorDataReq
      operation NvmBlackBoxMirrorDataReq
        arg NvmBlackBoxMirrorDataReq_Enum: type=UInt8, direction=IN
    VDsm_NvmLogisticDataAppReq
      operation NvmLogisticDataAppReq
        arg NvmLogisticDataAppReq_Enum: type=UInt8, direction=IN
    VOpm_NvmCriticalMirrorDataReq
      operation NvmCriticalMirrorDataReq
        arg NvmCriticalMirrorDataReq_Enum: type=UInt8, direction=IN
    VDsm_NvmPIFDataReq
      operation NvmPIFDataReq
        arg NvmPIFDataReq_Enum: type=UInt8, direction=IN
  180 x sender receiver interface:
    VDsm_DidF190VIN
      data Array: type=Dcm_DataBuffer17FixedType
    VDsm_DidF18CECUSN
      data Array: type=Dcm_DataBuffer16FixedType
    VDsm_DidF120NIFfactory
      data Array: type=Dcm_DataBuffer16FixedType
    VDsm_DidF18BECUDate
      data Array: type=Dcm_DataBuffer3FixedType
    VDsm_DidF18ASupID
      data Array: type=Dcm_DataBuffer5FixedType
    VDsm_DidF191ECUHWNo
      data Array: type=Dcm_DataBuffer5FixedType
    VDsm_DidF198ConfigTF
      data Array: type=Dcm_DataBuffer11FixedType
    VDsm_DidF1A9ECUConfigFN
      data Array: type=Dcm_DataBuffer5FixedType
    VDsm_DidF1A8VehFeature
      data Array: type=Dcm_DataBuffer20FixedType
    VDsm_DidF192SupHWRN
      data Array: type=Dcm_DataBuffer10FixedType
    VNvm_DidF110PIFptr
      data Array: type=Dcm_DataBuffer16FixedType
    VNvm_DidF111PIF1
      data Array: type=Dcm_DataBuffer16FixedType
    VNvm_DidF112PIF2
      data Array: type=Dcm_DataBuffer16FixedType
    VNvm_DidF113PIF3
      data Array: type=Dcm_DataBuffer16FixedType
    VNvm_DidF114PIF4
      data Array: type=Dcm_DataBuffer16FixedType
    VNvm_DidF115PIF5
      data Array: type=Dcm_DataBuffer16FixedType
    VNvm_DidF116PIF6
      data Array: type=Dcm_DataBuffer16FixedType
    VNvm_DidF117PIF7
      data Array: type=Dcm_DataBuffer16FixedType
    VNvm_DidF118PIF8
      data Array: type=Dcm_DataBuffer16FixedType
    VNvm_DidF119PIF9
      data Array: type=Dcm_DataBuffer16FixedType
    VNvm_DidF11APIFA
      data Array: type=Dcm_DataBuffer16FixedType
    VNvm_DidF11BPIFB
      data Array: type=Dcm_DataBuffer16FixedType
    VNvm_DidF11CPIFC
      data Array: type=Dcm_DataBuffer16FixedType
    VNvm_DidF11DPIFD
      data Array: type=Dcm_DataBuffer16FixedType
    VNvm_DidF11EPIFE
      data Array: type=Dcm_DataBuffer16FixedType
    VNvm_DidF11FPIFF
      data Array: type=Dcm_DataBuffer16FixedType
    VNvm_DidF120NIFfactory
      data Array: type=Dcm_DataBuffer16FixedType
    VNvm_DidF121NIFcur
      data Array: type=Dcm_DataBuffer16FixedType
    VNvm_DidF183BootloaderSRN
      data Array: type=Dcm_DataBuffer10FixedType
    VNvm_DidF187ECUPN
      data Array: type=Dcm_DataBuffer5FixedType
    VNvm_DidF18ASupID
      data Array: type=Dcm_DataBuffer5FixedType
    VNvm_DidF18BECUDate
      data Array: type=Dcm_DataBuffer3FixedType
    VNvm_DidF18CECUSN
      data Array: type=Dcm_DataBuffer16FixedType
    VNvm_DidF190VIN
      data Array: type=Dcm_DataBuffer17FixedType
    VNvm_DidF191ECUHWNo
      data Array: type=Dcm_DataBuffer5FixedType
    VNvm_DidF192SupHWRN
      data Array: type=Dcm_DataBuffer10FixedType
    VNvm_DidF194SupSWRN
      data Array: type=Dcm_DataBuffer10FixedType
    VNvm_DidF198ConfigTF
      data Array: type=Dcm_DataBuffer11FixedType
    VNvm_DidF1A0AppSWNo
      data Array: type=Dcm_DataBuffer5FixedType
    VNvm_DidF1A1CalSWNo
      data Array: type=Dcm_DataBuffer5FixedType
    VNvm_DidF1A2NCFRN
      data Array: type=Dcm_DataBuffer8FixedType
    VNvm_DidF1A5ECUIndex
      data Array: type=Dcm_DataBuffer3FixedType
    VNvm_DidF1A8VehFeature
      data Array: type=Dcm_DataBuffer20FixedType
    VNvm_DidF1A9ECUConfigFN
      data Array: type=Dcm_DataBuffer5FixedType
    VNvm_BlockPIF0DataV
      data Flg: type=Boolean
    VNvm_BlockPIF0DataFb
      data Enum: type=UInt8
    VNvm_BlockLogisticDataAppFb
      data Enum: type=UInt8
    VIpm_Mod01CellVoltMax
      data V: sw-calibration-access=READ-ONLY, type=Signal_Float
    VIpm_Mod01CellVoltMin
      data V: sw-calibration-access=READ-ONLY, type=Signal_Float
    VIpm_Mod02CellVoltMax
      data V: sw-calibration-access=READ-ONLY, type=Signal_Float
    VIpm_Mod02CellVoltMin
      data V: sw-calibration-access=READ-ONLY, type=Signal_Float
    VIpm_Mod03CellVoltMax
      data V: sw-calibration-access=READ-ONLY, type=Signal_Float
    VIpm_Mod03CellVoltMin
      data V: sw-calibration-access=READ-ONLY, type=Signal_Float
    VIpm_Mod04CellVoltMax
      data V: sw-calibration-access=READ-ONLY, type=Signal_Float
    VIpm_Mod04CellVoltMin
      data V: sw-calibration-access=READ-ONLY, type=Signal_Float
    VIpm_Mod05CellVoltMax
      data V: sw-calibration-access=READ-ONLY, type=Signal_Float
    VIpm_Mod05CellVoltMin
      data V: sw-calibration-access=READ-ONLY, type=Signal_Float
    VIpm_Mod06CellVoltMax
      data V: sw-calibration-access=READ-ONLY, type=Signal_Float
    VIpm_Mod06CellVoltMin
      data V: sw-calibration-access=READ-ONLY, type=Signal_Float
    VIpm_Mod01Temp01
      data C: sw-calibration-access=READ-ONLY, type=Signal_Float
    VIpm_Mod01Temp02
      data C: sw-calibration-access=READ-ONLY, type=Signal_Float
    VIpm_Mod01TempPcb
      data C: sw-calibration-access=READ-ONLY, type=Signal_Float
    VIpm_Mod02Temp01
      data C: sw-calibration-access=READ-ONLY, type=Signal_Float
    VIpm_Mod02Temp02
      data C: sw-calibration-access=READ-ONLY, type=Signal_Float
    VIpm_Mod02TempPcb
      data C: sw-calibration-access=READ-ONLY, type=Signal_Float
    VIpm_Mod03Temp01
      data C: sw-calibration-access=READ-ONLY, type=Signal_Float
    VIpm_Mod03Temp02
      data C: sw-calibration-access=READ-ONLY, type=Signal_Float
    VIpm_Mod03TempPcb
      data C: sw-calibration-access=READ-ONLY, type=Signal_Float
    VIpm_Mod04Temp01
      data C: sw-calibration-access=READ-ONLY, type=Signal_Float
    VIpm_Mod04Temp02
      data C: sw-calibration-access=READ-ONLY, type=Signal_Float
    VIpm_Mod04TempPcb
      data C: sw-calibration-access=READ-ONLY, type=Signal_Float
    VIpm_Mod05Temp01
      data C: sw-calibration-access=READ-ONLY, type=Signal_Float
    VIpm_Mod05Temp02
      data C: sw-calibration-access=READ-ONLY, type=Signal_Float
    VIpm_Mod05TempPcb
      data C: sw-calibration-access=READ-ONLY, type=Signal_Float
    VIpm_Mod06Temp01
      data C: sw-calibration-access=READ-ONLY, type=Signal_Float
    VIpm_Mod06Temp02
      data C: sw-calibration-access=READ-ONLY, type=Signal_Float
    VIpm_Mod06TempPcb
      data C: sw-calibration-access=READ-ONLY, type=Signal_Float
    VRcm_RlyLvDiagDone
      data Enum: sw-calibration-access=READ-ONLY, type=UInt8
    VOnc_VoltReverseCheck
      data Flg: sw-calibration-access=READ-ONLY, type=Boolean
    VOnc_FltInd
      data Array: sw-calibration-access=READ-ONLY, type=rt_Array_UInt8_50
    VFpm_ReturnToDefault
      data Flg: type=Boolean
    VIpm_FunSafe
      data Flg: type=Boolean
    VOnc_OnChgWorking
      data Flg: sw-calibration-access=READ-ONLY, type=Boolean
    VBal_NetTimeSetPerfd
      data Flg: sw-calibration-access=READ-ONLY, type=Boolean
    VBal_RtcSetPerfd
      data Flg: sw-calibration-access=READ-ONLY, type=Boolean
    VIpm_EepWipFb
      data Flg: sw-calibration-access=READ-ONLY, type=Boolean
    VIpm_NetModeTBox
      data Enum: sw-calibration-access=READ-ONLY, type=Signal_Uint
    VNvm_NvmReserChgReqMode
      data Enum: sw-calibration-access=READ-ONLY, type=UInt8
    VNvm_NvmReserChgStat
      data Enum: type=UInt8
    VNvm_NvmReserChgStTime
      data Array: sw-calibration-access=READ-ONLY, type=rt_Array_UInt8_6
    VNvm_NvmReserChgStTimeV
      data Flg: sw-calibration-access=READ-ONLY, type=Boolean
    VIpm_PtReady
      data Flg: sw-calibration-access=READ-ONLY, type=Signal_Uint
    VIpm_FicmReserChgReqFreq
      data Enum: sw-calibration-access=READ-ONLY, type=Signal_Uint
    VIpm_AppReserChgReqMode
      data Enum: sw-calibration-access=READ-ONLY, type=Signal_Uint
    VIpm_AppReserChgCtrlReq
      data Enum: sw-calibration-access=READ-ONLY, type=Signal_Uint
    VIpm_AppReserChgStTime
      data Array: sw-calibration-access=READ-ONLY, type=rt_Array_UInt8_6
    VIpm_AppReserChgStTimeV
      data Flg: sw-calibration-access=READ-ONLY, type=Boolean
    VIpm_SigConfigIDTBox
      data Cnt: sw-calibration-access=READ-ONLY, type=Signal_Uint
    VBmm_KeepNetTBox
      data Flg: sw-calibration-access=READ-ONLY, type=Signal_Uint
    VBmm_WakeNetTBox
      data Flg: sw-calibration-access=READ-ONLY, type=Signal_Uint
    VIpm_NvmAccumEngyBkp
      data Kwh: sw-calibration-access=READ-ONLY, type=Signal_Float
    VIpm_NvmAccumTimeBkp
      data Sec: sw-calibration-access=READ-ONLY, type=Signal_Float
    VIpm_NvmCldCapFadeBkp
      data Pct: sw-calibration-access=READ-ONLY, type=Signal_Float
    VIpm_NvmCldResiGrwBkp
      data Pct: sw-calibration-access=READ-ONLY, type=Signal_Float
    VIpm_NvmCycCapFadeBkp
      data Pct: sw-calibration-access=READ-ONLY, type=Signal_Float
    VIpm_NvmCycResiGrwBkp
      data Pct: sw-calibration-access=READ-ONLY, type=Signal_Float
    VIpm_NvmSohSwVer
      data Enum: sw-calibration-access=READ-ONLY, type=Signal_Uint
    VSoh_SohSwVer
      data Enum: sw-calibration-access=READ-ONLY, type=Signal_Uint
    VSoh_LatchOcv
      data V: sw-calibration-access=READ-ONLY, type=Signal_Float
    VSoh_LatchSoc
      data Pct: sw-calibration-access=READ-ONLY, type=Signal_Float
    VIpm_NvmLatchOcv
      data V: sw-calibration-access=READ-ONLY, type=Signal_Float
    VIpm_NvmLatchOcvBkp
      data V: sw-calibration-access=READ-ONLY, type=Signal_Float
    VIpm_NvmLatchSoc
      data Pct: sw-calibration-access=READ-ONLY, type=Signal_Float
    VIpm_NvmLatchSocBkp
      data Pct: sw-calibration-access=READ-ONLY, type=Signal_Float
    VIpm_AppScratchpadV
      data Flg: sw-calibration-access=READ-ONLY, type=Boolean
    VNvm_BlockLogisticDataAppV
      data Flg: sw-calibration-access=READ-ONLY, type=Boolean
    VIpm_Rcv0x3C2
      data Flg: sw-calibration-access=READ-ONLY, type=Boolean
    VNvm_NvmAccumEngyBkp
      data Kwh: sw-calibration-access=READ-ONLY, type=Float
    VNvm_NvmAccumTimeBkp
      data Sec: sw-calibration-access=READ-ONLY, type=Float
    VNvm_NvmCldCapFadeBkp
      data Pct: sw-calibration-access=READ-ONLY, type=Float
    VNvm_NvmCldResiGrwBkp
      data Pct: sw-calibration-access=READ-ONLY, type=Float
    VNvm_NvmCycCapFadeBkp
      data Pct: sw-calibration-access=READ-ONLY, type=Float
    VNvm_NvmCycResiGrwBkp
      data Pct: sw-calibration-access=READ-ONLY, type=Float
    VNvm_NvmLatchOcv
      data V: sw-calibration-access=READ-ONLY, type=Float
    VNvm_NvmLatchOcvBkp
      data V: sw-calibration-access=READ-ONLY, type=Float
    VNvm_NvmLatchSoc
      data Pct: sw-calibration-access=READ-ONLY, type=Float
    VNvm_NvmLatchSocBkp
      data Pct: sw-calibration-access=READ-ONLY, type=Float
    VNvm_NvmSohSwVer
      data Enum: sw-calibration-access=READ-ONLY, type=UInt32
    VNvm_BlockCriticalDataMirrorFb
      data Enum: type=UInt8
    VNvm_BlockCoreDataV
      data Flg: sw-calibration-access=READ-ONLY, type=Boolean
    VNvm_BlockCoreDataFb
      data Enum: type=UInt8
    VNvm_BlockCriticalDataV
      data Flg: type=Boolean
    VNvm_BlockBlackBoxFb
      data Enum: type=UInt8
    VNvm_BlockBlackBoxV
      data Flg: sw-calibration-access=READ-ONLY, type=Boolean
    VNvm_BlockBlackBoxMirrorFb
      data Enum: type=UInt8
    VNvm_BlockBlackBoxMirrorV
      data Flg: type=Boolean
    VNvm_BlockCriticalDataFb
      data Enum: type=UInt8
    VNvm_BlockCriticalDataMirrorV
      data Flg: type=Boolean
    VOpm_NvmOnChgEngy
      data Wh: sw-calibration-access=READ-ONLY, type=Float
    VOpm_NvmLatchOcv
      data V: sw-calibration-access=READ-ONLY, type=Float
    VOpm_NvmLatchSoc
      data Pct: sw-calibration-access=READ-ONLY, type=Float
    VOpm_NvmSohSwVer
      data Enum: sw-calibration-access=READ-ONLY, type=UInt32
    VSoc_SocLowCnt
      data Cnt: sw-calibration-access=READ-ONLY, type=Signal_Uint
    VIpm_NvmSocLowCnt
      data Cnt: sw-calibration-access=READ-ONLY, type=Signal_Uint
    VIpm_NvmSocLowCntBkp
      data Cnt: sw-calibration-access=READ-ONLY, type=Signal_Uint
    VOpm_NvmSocLowCnt
      data Cnt: sw-calibration-access=READ-ONLY, type=UInt8
    VNvm_NvmSocLowCnt
      data Cnt: sw-calibration-access=READ-ONLY, type=UInt16
    VNvm_NvmSocLowCntBkp
      data Cnt: sw-calibration-access=READ-ONLY, type=UInt16
    VNvm_BlockLogisticDataBootFb
      data Enum: type=UInt8
    VNvm_BlockLogisticDataBootV
      data Flg: sw-calibration-access=READ-ONLY, type=Boolean
    VNvm_BlockPIF1DataFb
      data Enum: type=UInt8
    VNvm_BlockPIF1DataV
      data Flg: type=Boolean
    VNvm_BlockPIF2DataFb
      data Enum: type=UInt8
    VNvm_BlockPIF2DataV
      data Flg: type=Boolean
    VNvm_BlockPIF3DataFb
      data Enum: type=UInt8
    VNvm_BlockPIF3DataV
      data Flg: type=Boolean
    VNvm_BlockPIF4DataFb
      data Enum: type=UInt8
    VNvm_BlockPIF4DataV
      data Flg: type=Boolean
    VNvm_BlockPIF5DataFb
      data Enum: type=UInt8
    VNvm_BlockPIF5DataV
      data Flg: type=Boolean
    VNvm_BlockPIF6DataFb
      data Enum: type=UInt8
    VNvm_BlockPIF6DataV
      data Flg: type=Boolean
    VNvm_BlockPIF7DataFb
      data Enum: type=UInt8
    VNvm_BlockPIF7DataV
      data Flg: type=Boolean
    VNvm_BlockPIF8DataFb
      data Enum: type=UInt8
    VNvm_BlockPIF8DataV
      data Flg: type=Boolean
    VNvm_BlockPIF9DataFb
      data Enum: type=UInt8
    VNvm_BlockPIF9DataV
      data Flg: type=Boolean
    VNvm_BlockPIFADataFb
      data Enum: type=UInt8
    VNvm_BlockPIFADataV
      data Flg: type=Boolean
    VNvm_BlockPIFBDataFb
      data Enum: type=UInt8
    VNvm_BlockPIFBDataV
      data Flg: type=Boolean
    VNvm_BlockPIFCDataFb
      data Enum: type=UInt8
    VNvm_BlockPIFCDataV
      data Flg: type=Boolean
    VNvm_BlockPIFDDataFb
      data Enum: type=UInt8
    VNvm_BlockPIFDDataV
      data Flg: type=Boolean
    VNvm_BlockPIFEDataFb
      data Enum: type=UInt8
    VNvm_BlockPIFEDataV
      data Flg: type=Boolean
    VNvm_BlockPIFFDataFb
      data Enum: type=UInt8
    VNvm_BlockPIFFDataV
      data Flg: type=Boolean
  client server interface VDsm_NvmReprogramFlagReq
    operation NvmReprogramFlagReq
      arg NvmReprogramFlagReq_Enum: type=UInt8, direction=IN
  186 x sender receiver interface:
    VNvm_PIFIndex
      data Cnt: type=UInt8
    VNvm_DidF190VINWipNum
      data Cnt: type=UInt8
    VNvm_DidF18BECUDateWipNum
      data Cnt: type=UInt8
    VNvm_DidF18CECUSNWipNum
      data Cnt: type=UInt8
    VOpm_NvmLogiSwVer
      data Enum: sw-calibration-access=READ-ONLY, type=UInt32
    VNvm_NvmLogiSwVer
      data Enum: sw-calibration-access=READ-ONLY, type=UInt32
    VIpm_NvmLogiSwVer
      data Enum: sw-calibration-access=READ-ONLY, type=Signal_Uint
    VNvm_NvmPresentTimeBkp
      data Array: sw-calibration-access=READ-ONLY, type=rt_Array_UInt16_6
    VNvm_NvmBalTimeBkp
      data Sec: sw-calibration-access=READ-ONLY, type=Float
    VIpm_NvmBalTimeBkp
      data Sec: sw-calibration-access=READ-ONLY, type=Signal_Float
    VIpm_NvmCrankCntBkp
      data Cnt: sw-calibration-access=READ-ONLY, type=Signal_Uint
    VNvm_NvmCrankCntBkp
      data Cnt: sw-calibration-access=READ-ONLY, type=UInt8
    VNvm_BlockReprogramFlagFb
      data Enum: type=UInt8
    VNvm_BlockReprogramFlagV
      data Flg: sw-calibration-access=READ-ONLY, type=Boolean
    VWlc_WlChgStat
      data Enum: sw-calibration-access=READ-ONLY, type=Signal_Uint
    VBmm_OfcCtrl
      data Enum: sw-calibration-access=READ-ONLY, type=UInt8
    VDsm_ClsOffChgRlyReqRCtrl
      data Flg: sw-calibration-access=READ-ONLY, type=Signal_Uint
    VDsm_WakeOnChrgrRCtrl
      data Flg: sw-calibration-access=READ-ONLY, type=Signal_Uint
    VBmm_WakeOnChrgrSRspd
      data Enum: sw-calibration-access=READ-ONLY, type=UInt8
    VBmm_WakeOnChrgrSInfo
      data Enum: sw-calibration-access=READ-ONLY, type=UInt8
    VOfc_ClsOffChgRlyReq
      data Flg: sw-calibration-access=READ-ONLY, type=Boolean
    VOfc_OffChgCeaseReason
      data Enum: sw-calibration-access=READ-ONLY, type=UInt8
    VOfc_OffChgReadyReq
      data Flg: sw-calibration-access=READ-ONLY, type=Boolean
    VWlc_ClsWlChgRlyReq
      data Flg: sw-calibration-access=READ-ONLY, type=Boolean
    VWlc_WlChgCeaseReason
      data Enum: sw-calibration-access=READ-ONLY, type=UInt8
    VWlc_WlChgReadyReq
      data Flg: sw-calibration-access=READ-ONLY, type=Boolean
    VRcm_ClsOffChgRlyReqSInfo
      data Enum: sw-calibration-access=READ-ONLY, type=UInt8
    VRcm_ClsOffChgRlyReqSRspd
      data Enum: sw-calibration-access=READ-ONLY, type=UInt8
    VOfc_FltInd
      data Array: sw-calibration-access=READ-ONLY, type=rt_Array_UInt8_50
    VWlc_FltInd
      data Array: sw-calibration-access=READ-ONLY, type=rt_Array_UInt8_50
    VIpm_NvmAccumChgEngy
      data Kwh: sw-calibration-access=READ-ONLY, type=Signal_Float
    VIpm_NvmAccumDisEngy
      data Kwh: sw-calibration-access=READ-ONLY, type=Signal_Float
    VIpm_NvmAccumOdo
      data Km: sw-calibration-access=READ-ONLY, type=Signal_Float
    VIpm_ElecEngyRstReq
      data Flg: sw-calibration-access=READ-ONLY, type=Signal_Uint
    VSoe_TotalAccumChgEngy
      data Kwh: sw-calibration-access=READ-ONLY, type=Signal_Float
    VSoe_CrntAccumDisEngy
      data Kwh: sw-calibration-access=READ-ONLY, type=Signal_Float
    VSoe_CrntAccumOdo
      data Km: sw-calibration-access=READ-ONLY, type=Signal_Float
    VSoe_VehOdo
      data Km: sw-calibration-access=READ-ONLY, type=Signal_Float
    VSoe_TotalElecEngyAvg
      data KwhP100Km: sw-calibration-access=READ-ONLY, type=Signal_Float
    VSoe_ElecEngyAvgRstRsp
      data Flg: sw-calibration-access=READ-ONLY, type=Boolean
    VSoe_AvailEngy
      data Kwh: sw-calibration-access=READ-ONLY, type=Signal_Float
    VSoe_NvmCtrl
      data Flg: sw-calibration-access=READ-ONLY, type=Boolean
    VOfc_VoltReverseCheck
      data Flg: sw-calibration-access=READ-ONLY, type=Boolean
    VWlc_VoltReverseCheck
      data Flg: sw-calibration-access=READ-ONLY, type=Boolean
    VIpm_WlChrgrStat
      data Enum: sw-calibration-access=READ-ONLY, type=Signal_Uint
    VIpm_WlChrgrHvCur
      data A: sw-calibration-access=READ-ONLY, type=Signal_Float
    VIpm_WlChrgrHvVolt
      data V: sw-calibration-access=READ-ONLY, type=Signal_Float
    VIpm_WlChrgrTem
      data C: sw-calibration-access=READ-ONLY, type=Signal_Float
    VIpm_AmbTem
      data C: sw-calibration-access=READ-ONLY, type=Signal_Float
    VIpm_WlChgWake
      data Flg: sw-calibration-access=READ-ONLY, type=Boolean
    VIpm_NvmWlChgAccumTime
      data Sec: sw-calibration-access=READ-ONLY, type=Signal_Float
    VIpm_NvmWlChgAccumTimeBkp
      data Sec: sw-calibration-access=READ-ONLY, type=Signal_Float
    VIpm_NvmWlChgCnt
      data Cnt: sw-calibration-access=READ-ONLY, type=Signal_Uint
    VIpm_NvmWlChgCntBkp
      data Cnt: sw-calibration-access=READ-ONLY, type=Signal_Uint
    VIpm_PosBusVolt
      data V: sw-calibration-access=READ-ONLY, type=Signal_Float
    VIpm_NegBusVolt
      data V: sw-calibration-access=READ-ONLY, type=Signal_Float
    VBmm_WlcCtrl
      data Enum: sw-calibration-access=READ-ONLY, type=UInt8
    VIpm_WlChrgrUniqueNum
      data Cnt: sw-calibration-access=READ-ONLY, type=Signal_Uint
    VWlc_WlChgEn
      data Flg: sw-calibration-access=READ-ONLY, type=Boolean
    VWlc_WlChgMode
      data Enum: sw-calibration-access=READ-ONLY, type=Signal_Uint
    VWlc_WlChgReqCur
      data A: sw-calibration-access=READ-ONLY, type=Signal_Float
    VWlc_WlChgReqVolt
      data V: sw-calibration-access=READ-ONLY, type=Signal_Float
    VWlc_WlChgReqPwr
      data Kw: sw-calibration-access=READ-ONLY, type=Signal_Float
    VWlc_WlChgAccumTime
      data Sec: sw-calibration-access=READ-ONLY, type=Signal_Float
    VWlc_WlChgCnt
      data Cnt: sw-calibration-access=READ-ONLY, type=Signal_Uint
    VWlc_WlChgReqCapac
      data Ah: sw-calibration-access=READ-ONLY, type=Signal_Float
    VWlc_WlChgDone
      data Flg: sw-calibration-access=READ-ONLY, type=Boolean
    VWlc_WlChgOffReq
      data Flg: sw-calibration-access=READ-ONLY, type=Signal_Uint
    VWlc_WlChgConIndDrv
      data Enum: sw-calibration-access=READ-ONLY, type=UInt8
    VWlc_WlChgingIndDrv
      data Enum: sw-calibration-access=READ-ONLY, type=UInt8
    VWlc_WlChgFlt
      data Flg: sw-calibration-access=READ-ONLY, type=Boolean
    VWlc_WlChrgrFlt
      data Flg: sw-calibration-access=READ-ONLY, type=Boolean
    VWlc_WlChgNotSafe
      data Flg: sw-calibration-access=READ-ONLY, type=Signal_Uint
    VWlc_WlChgSysKeepWake
      data Flg: sw-calibration-access=READ-ONLY, type=Signal_Uint
    VWlc_WlChgRemainTime
      data Hr: sw-calibration-access=READ-ONLY, type=Signal_Float
    VIpm_CrmFbResult
      data Cnt: sw-calibration-access=READ-ONLY, type=Signal_Uint
    VIpm_NvmAccumAh
      data Ah: sw-calibration-access=READ-ONLY, type=Signal_Float
    VIpm_NvmAccumAhBkp
      data Ah: sw-calibration-access=READ-ONLY, type=Signal_Float
    VSoc_AccumAh
      data Ah: sw-calibration-access=READ-ONLY, type=Signal_Float
    VIpm_CroPrepareStat
      data Enum: sw-calibration-access=READ-ONLY, type=UInt8
    VIpm_CstFltCease
      data Enum: sw-calibration-access=READ-ONLY, type=Signal_Uint
    VIpm_CstChgOt
      data Enum: sw-calibration-access=READ-ONLY, type=Signal_Uint
    VIpm_CstChgConFlt
      data Enum: sw-calibration-access=READ-ONLY, type=UInt8
    VIpm_CstInternOt
      data Enum: sw-calibration-access=READ-ONLY, type=Signal_Uint
    VIpm_CstOtherFlt
      data Enum: sw-calibration-access=READ-ONLY, type=UInt8
    VIpm_CstCurMis
      data Enum: sw-calibration-access=READ-ONLY, type=UInt8
    VIpm_CstVoltError
      data Enum: sw-calibration-access=READ-ONLY, type=UInt8
    VIpm_CstChgCeaseSet
      data Enum: sw-calibration-access=READ-ONLY, type=Signal_Uint
    VIpm_CstEngyNotAccess
      data Enum: sw-calibration-access=READ-ONLY, type=Signal_Uint
    VIpm_CstEpo
      data Enum: sw-calibration-access=READ-ONLY, type=Signal_Uint
    VIpm_CemBrmTo
      data Enum: sw-calibration-access=READ-ONLY, type=UInt8
    VIpm_CemBcpTo
      data Enum: sw-calibration-access=READ-ONLY, type=UInt8
    VIpm_CemBroTo
      data Enum: sw-calibration-access=READ-ONLY, type=UInt8
    VIpm_CemBcsTo
      data Enum: sw-calibration-access=READ-ONLY, type=UInt8
    VIpm_CemBclTo
      data Enum: sw-calibration-access=READ-ONLY, type=UInt8
    VIpm_CemBstTo
      data Enum: sw-calibration-access=READ-ONLY, type=UInt8
    VIpm_CemBsdTo
      data Enum: sw-calibration-access=READ-ONLY, type=UInt8
    VIpm_CsdChgAccumTime
      data Min: sw-calibration-access=READ-ONLY, type=Signal_Float
    VIpm_RcvCrm
      data Flg: sw-calibration-access=READ-ONLY, type=Boolean
    VIpm_RcvCcs
      data Flg: sw-calibration-access=READ-ONLY, type=Boolean
    VOfc_BrmCommVer
      data Cnt: sw-calibration-access=READ-ONLY, type=Signal_Uint
    VOfc_BrmBatType
      data Cnt: sw-calibration-access=READ-ONLY, type=UInt8
    VOfc_BrmRatedCap
      data Ah: sw-calibration-access=READ-ONLY, type=Signal_Float
    VOfc_BrmRatedVolt
      data V: sw-calibration-access=READ-ONLY, type=Signal_Float
    VOfc_BrmBatManu
      data Cnt: sw-calibration-access=READ-ONLY, type=UInt32
    VOfc_BrmBatNum
      data Cnt: sw-calibration-access=READ-ONLY, type=UInt32
    VOfc_BrmManuYear
      data Cnt: sw-calibration-access=READ-ONLY, type=UInt32
    VOfc_BrmManuMonth
      data Cnt: sw-calibration-access=READ-ONLY, type=UInt32
    VOfc_BrmManuDay
      data Cnt: sw-calibration-access=READ-ONLY, type=UInt32
    VOfc_BrmChgCyc
      data Cnt: sw-calibration-access=READ-ONLY, type=UInt32
    VOfc_BrmBatId
      data Cnt: sw-calibration-access=READ-ONLY, type=UInt32
    VOfc_BrmReasr
      data Cnt: sw-calibration-access=READ-ONLY, type=UInt32
    VOfc_BemCrmTo
      data Enum: type=UInt8
    VOfc_BemCrmPassTo
      data Enum: type=UInt8
    VOfc_BemCmlTo
      data Enum: type=UInt8
    VOfc_BemCroTo
      data Enum: type=UInt8
    VOfc_BemCcsTo
      data Enum: type=UInt8
    VOfc_BemCstTo
      data Enum: type=UInt8
    VOfc_BemCsdTo
      data Enum: type=UInt8
    VOfc_BcpAcptCellVoltMax
      data V: sw-calibration-access=READ-ONLY, type=Signal_Float
    VOfc_BcpAcptCurMax
      data A: sw-calibration-access=READ-ONLY, type=Signal_Float
    VOfc_BcpAcptPackVoltMax
      data V: sw-calibration-access=READ-ONLY, type=Signal_Float
    VOfc_BcpAcptTemMax
      data C: sw-calibration-access=READ-ONLY, type=Signal_Float
    VOfc_BcpPackSoc
      data Pct: sw-calibration-access=READ-ONLY, type=Signal_Float
    VOfc_BcpPackVolt
      data V: sw-calibration-access=READ-ONLY, type=Signal_Float
    VOfc_BclCurReq
      data A: sw-calibration-access=READ-ONLY, type=Signal_Float
    VOfc_BclVoltReq
      data V: sw-calibration-access=READ-ONLY, type=Signal_Float
    VOfc_BclOffChgMode
      data Enum: sw-calibration-access=READ-ONLY, type=UInt8
    VOfc_BcsPackVolt
      data V: sw-calibration-access=READ-ONLY, type=Signal_Float
    VOfc_BcsPackCur
      data A: sw-calibration-access=READ-ONLY, type=Signal_Float
    VOfc_BcsCellVoltMax
      data V: sw-calibration-access=READ-ONLY, type=Signal_Float
    VOfc_BcsCellVoltMaxNum
      data Cnt: sw-calibration-access=READ-ONLY, type=UInt8
    VOfc_BcsPackSoc
      data Pct: sw-calibration-access=READ-ONLY, type=Signal_Float
    VOfc_BcsEstChgTime
      data Min: sw-calibration-access=READ-ONLY, type=Signal_Float
    VOfc_BsmCellVoltMaxNum
      data Cnt: sw-calibration-access=READ-ONLY, type=UInt8
    VOfc_BsmCellTemMax
      data C: sw-calibration-access=READ-ONLY, type=Signal_Float
    VOfc_BsmCellTemMaxNum
      data Cnt: sw-calibration-access=READ-ONLY, type=UInt8
    VOfc_BsmCellTemMin
      data C: sw-calibration-access=READ-ONLY, type=Signal_Float
    VOfc_BsmCellTemMinNum
      data Cnt: sw-calibration-access=READ-ONLY, type=UInt8
    VOfc_BsmCellVoltStat
      data Enum: sw-calibration-access=READ-ONLY, type=UInt8
    VOfc_BsmSocStat
      data Enum: sw-calibration-access=READ-ONLY, type=UInt8
    VOfc_BsmCurStat
      data Enum: sw-calibration-access=READ-ONLY, type=UInt8
    VOfc_BsmCellTemStat
      data Enum: sw-calibration-access=READ-ONLY, type=UInt8
    VOfc_BsmIsoStat
      data Enum: sw-calibration-access=READ-ONLY, type=UInt8
    VOfc_BsmChgAllow
      data Enum: sw-calibration-access=READ-ONLY, type=UInt8
    VOfc_BsmHvConStat
      data Enum: sw-calibration-access=READ-ONLY, type=UInt8
    VOfc_BstSocSet
      data Enum: sw-calibration-access=READ-ONLY, type=UInt8
    VOfc_BstVoltSet
      data Enum: sw-calibration-access=READ-ONLY, type=UInt8
    VOfc_BstHvIso
      data Enum: sw-calibration-access=READ-ONLY, type=UInt8
    VOfc_BstOc
      data Enum: sw-calibration-access=READ-ONLY, type=UInt8
    VOfc_BstVoltMis
      data Enum: sw-calibration-access=READ-ONLY, type=UInt8
    VOfc_BstCellVoltSet
      data Enum: sw-calibration-access=READ-ONLY, type=UInt8
    VOfc_BstConOtSet
      data Enum: sw-calibration-access=READ-ONLY, type=UInt8
    VOfc_BstBmsOtSet
      data Enum: sw-calibration-access=READ-ONLY, type=UInt8
    VOfc_BstOtherFltSet
      data Enum: sw-calibration-access=READ-ONLY, type=UInt8
    VOfc_BstPackOtSet
      data Enum: sw-calibration-access=READ-ONLY, type=UInt8
    VOfc_BsdFinalSoc
      data Pct: sw-calibration-access=READ-ONLY, type=Signal_Float
    VOfc_BsdFinalCellVoltMin
      data V: sw-calibration-access=READ-ONLY, type=Signal_Float
    VOfc_BsdFinalCellVoltMax
      data V: sw-calibration-access=READ-ONLY, type=Signal_Float
    VOfc_BsdFinalCellTemMin
      data C: sw-calibration-access=READ-ONLY, type=Signal_Float
    VOfc_BsdFinalCellTemMax
      data C: sw-calibration-access=READ-ONLY, type=Signal_Float
    VOfc_BstOcSet
      data Enum: sw-calibration-access=READ-ONLY, type=UInt8
    VOfc_BstVoltMisSet
      data Enum: sw-calibration-access=READ-ONLY, type=UInt8
    VOfc_NvmCtrl
      data Enum: sw-calibration-access=READ-ONLY, type=UInt8
    VOfc_OffChgConIndDrv
      data Enum: type=UInt8
    VOfc_OffChgingIndDrv
      data Enum: type=UInt8
    VIpm_ChrgrAcLim
      data A: sw-calibration-access=READ-ONLY, type=Signal_Float
    VIpm_IsgInvtrCur
      data A: sw-calibration-access=READ-ONLY, type=Signal_Float
    VIpm_IsgInvtrVolt
      data V: sw-calibration-access=READ-ONLY, type=Signal_Float
    VIpm_TmInvtrCur
      data A: sw-calibration-access=READ-ONLY, type=Signal_Float
    VIpm_TmInvtrVolt
      data V: sw-calibration-access=READ-ONLY, type=Signal_Float
    VIpm_OnChrgrHvCur
      data A: sw-calibration-access=READ-ONLY, type=Signal_Float
    VIpm_OnChrgrStat
      data Enum: sw-calibration-access=READ-ONLY, type=Signal_Uint
    VIpm_OnChrgrHvVolt
      data V: sw-calibration-access=READ-ONLY, type=Signal_Float
    VOnc_OnChgEn
      data Flg: sw-calibration-access=READ-ONLY, type=Boolean
    VOnc_OnChgEngy
      data Wh: sw-calibration-access=READ-ONLY, type=Signal_Float
    VOnc_OnChrgrFlt
      data Flg: sw-calibration-access=READ-ONLY, type=Boolean
    VOnc_OnChgFlt
      data Flg: sw-calibration-access=READ-ONLY, type=Boolean
    VOnc_OnChgMode
      data Enum: sw-calibration-access=READ-ONLY, type=Signal_Uint
    VOnc_OnChgNotSafe
      data Flg: sw-calibration-access=READ-ONLY, type=Signal_Uint
    VOnc_OnChgOffReq
      data Flg: sw-calibration-access=READ-ONLY, type=Signal_Uint
    VOnc_OnChgReqCapac
      data Ah: sw-calibration-access=READ-ONLY, type=Signal_Float
    VOnc_OnChgReqCur
      data A: sw-calibration-access=READ-ONLY, type=Signal_Float
    VOnc_OnChgReqPwr
      data Kw: sw-calibration-access=READ-ONLY, type=Signal_Float
    VOnc_OnChgReqVolt
      data V: sw-calibration-access=READ-ONLY, type=Signal_Float
    VWlc_NvmCtrl
      data Flg: sw-calibration-access=READ-ONLY, type=Boolean
  client server interface VBmm_WakeTBox
    operation SendOnce
  client server interface VFpm_WakeTBoxEn
    operation SendOnce
  6 x sender receiver interface:
    VIpm_AcpReq
      data Enum: sw-calibration-access=READ-ONLY, type=Signal_Uint
    VIpm_EptStartCmdOn
      data Flg: sw-calibration-access=READ-ONLY, type=Signal_Uint
    VIpm_DcdcHvVolt
      data V: sw-calibration-access=READ-ONLY, type=Signal_Float
    VIpm_DcdcHvCur
      data A: sw-calibration-access=READ-ONLY, type=Signal_Float
    VIpm_Rcv0x1F2
      data Flg: sw-calibration-access=READ-ONLY, type=Boolean
    VIpm_OffChgPlugResi
      data Ohm: sw-calibration-access=READ-ONLY, type=Signal_AI
  client server interface VFpm_DtcInfoEn
    operation SendOnce
  15 x sender receiver interface:
    VIpm_NvmElecEngyAvg
      data KwhP100Km: sw-calibration-access=READ-ONLY, type=Signal_Float
    VIpm_NvmAvailEngy
      data Kwh: sw-calibration-access=READ-ONLY, type=Signal_Float
    VIpm_NvmAvailEngyBkp
      data Kwh: sw-calibration-access=READ-ONLY, type=Signal_Float
    VIpm_NvmElecEngyAvgBkp
      data KwhP100Km: sw-calibration-access=READ-ONLY, type=Signal_Float
    VIpm_NvmAccumChgEngyBkp
      data Kwh: sw-calibration-access=READ-ONLY, type=Signal_Float
    VIpm_NvmAccumDisEngyBkp
      data Kwh: sw-calibration-access=READ-ONLY, type=Signal_Float
    VIpm_NvmAccumOdoBkp
      data Km: sw-calibration-access=READ-ONLY, type=Signal_Float
    VIpm_NvmCellSoeMaxBkp
      data Pct: sw-calibration-access=READ-ONLY, type=Signal_Float
    VIpm_NvmCellSoeMinBkp
      data Pct: sw-calibration-access=READ-ONLY, type=Signal_Float
    VIpm_NvmPackSoeDspBkp
      data Pct: sw-calibration-access=READ-ONLY, type=Signal_Float
    VOpm_NvmAccumChgEngy
      data Kwh: sw-calibration-access=READ-ONLY, type=Float
    VOpm_NvmAccumDisEngy
      data Kwh: sw-calibration-access=READ-ONLY, type=Float
    VOpm_NvmAccumOdo
      data Km: sw-calibration-access=READ-ONLY, type=Float
    VOpm_NvmAvailEngy
      data Kwh: sw-calibration-access=READ-ONLY, type=Float
    VOpm_NvmElecEngyAvg
      data KwhP100Km: sw-calibration-access=READ-ONLY, type=Float
  client server interface VOpm_WakeTBox
    operation SendOnce
  44 x sender receiver interface:
    VNvm_NvmPackSoeDspBkp
      data Pct: sw-calibration-access=READ-ONLY, type=Float
    VNvm_NvmCellSoeMinBkp
      data Pct: sw-calibration-access=READ-ONLY, type=Float
    VNvm_NvmCellSoeMaxBkp
      data Pct: sw-calibration-access=READ-ONLY, type=Float
    VNvm_NvmAccumChgEngy
      data Kwh: sw-calibration-access=READ-ONLY, type=Float
    VNvm_NvmAccumChgEngyBkp
      data Kwh: sw-calibration-access=READ-ONLY, type=Float
    VNvm_NvmAccumDisEngy
      data Kwh: sw-calibration-access=READ-ONLY, type=Float
    VNvm_NvmAccumDisEngyBkp
      data Kwh: sw-calibration-access=READ-ONLY, type=Float
    VNvm_NvmAccumOdo
      data Km: sw-calibration-access=READ-ONLY, type=Float
    VNvm_NvmAccumOdoBkp
      data Km: sw-calibration-access=READ-ONLY, type=Float
    VNvm_NvmAvailEngy
      data Kwh: sw-calibration-access=READ-ONLY, type=Float
    VNvm_NvmAvailEngyBkp
      data Kwh: sw-calibration-access=READ-ONLY, type=Float
    VNvm_NvmElecEngyAvg
      data KwhP100Km: sw-calibration-access=READ-ONLY, type=Float
    VNvm_NvmElecEngyAvgBkp
      data KwhP100Km: sw-calibration-access=READ-ONLY, type=Float
    VIpm_CellSoeMax
      data Pct: sw-calibration-access=READ-ONLY, type=Signal_Float
    VIpm_CellSoeMin
      data Pct: sw-calibration-access=READ-ONLY, type=Signal_Float
    VOpm_WlChgAccumTime
      data Sec: sw-calibration-access=READ-ONLY, type=Float
    VOpm_WlChgCnt
      data Cnt: sw-calibration-access=READ-ONLY, type=UInt32
    VNvm_NvmWlChgAccumTime
      data Sec: sw-calibration-access=READ-ONLY, type=Float
    VNvm_NvmWlChgAccumTimeBkp
      data Sec: sw-calibration-access=READ-ONLY, type=Float
    VNvm_NvmWlChgCnt
      data Cnt: sw-calibration-access=READ-ONLY, type=UInt32
    VNvm_NvmWlChgCntBkp
      data Cnt: sw-calibration-access=READ-ONLY, type=UInt32
    VIpm_BpmmAvail
      data Flg: sw-calibration-access=READ-ONLY, type=Signal_Uint
    VFpm_SysFailureInd
      data Enum: sw-calibration-access=READ-ONLY, type=UInt8
    VFpm_AppFailureInd
      data Enum: sw-calibration-access=READ-ONLY, type=UInt8
    VFpm_SysFltInd
      data Array: sw-calibration-access=READ-ONLY, type=rt_Array_UInt8_200
    VFpm_AppFltInd
      data Array: sw-calibration-access=READ-ONLY, type=rt_Array_UInt8_200
    VFpm_SysFltLvl
      data Enum: sw-calibration-access=READ-ONLY, type=UInt8
    VFpm_AppFltLvl
      data Enum: sw-calibration-access=READ-ONLY, type=UInt8
    VSoe_PwrEfncy
      data Pct: sw-calibration-access=READ-ONLY, type=Signal_Float
    VIpm_DcdcStat
      data Enum: sw-calibration-access=READ-ONLY, type=Signal_Uint
    VOnc_OnChgBthIndDrv
      data Enum: sw-calibration-access=READ-ONLY, type=UInt8
    VFpm_CmuRst
      data Flg: sw-calibration-access=READ-ONLY, type=Boolean
    VIpm_Cmu09Stat
      data Enum: sw-calibration-access=READ-ONLY, type=Signal_Uint
    VIpm_Cmu10Stat
      data Enum: sw-calibration-access=READ-ONLY, type=Signal_Uint
    VSof_ChgCurLimitActual
      data A: sw-calibration-access=READ-ONLY, type=Signal_Float
    VSof_DisCurLimitActual
      data A: sw-calibration-access=READ-ONLY, type=Signal_Float
    VFpm_FltCt
      data Cnt: sw-calibration-access=READ-ONLY, type=UInt8
    VDsm_DidB075UnlockLogi
      data Cnt: type=UInt8
    VDsm_DidF18BECUDateWipNum
      data Cnt: type=UInt8
    VDsm_DidF18CECUSNWipNum
      data Cnt: type=UInt8
    VDsm_DidF190VINWipNum
      data Cnt: type=UInt8
    VNvm_DidF100SVIF
      data Array: type=Dcm_DataBuffer4FixedType
    VNvm_DidF1AAECUProgPrcsFN
      data Array: type=Dcm_DataBuffer5FixedType
    VDsm_HvmRtcTimeOvrd
      data Array: sw-calibration-access=READ-ONLY, type=rt_Array_UInt8_8
  client server interface VDsm_SetRtc
    operation SendOnce
  209 x sender receiver interface:
    VDsm_CmuMissCntOvrd
      data Cnt: sw-calibration-access=READ-ONLY, type=Signal_Uint
    VDsm_CmuMissTimeOvrd
      data Sec: sw-calibration-access=READ-ONLY, type=Signal_Float
    VDsm_DtcExLeakgeCntOvrd
      data Cnt: sw-calibration-access=READ-ONLY, type=Signal_Uint
    VDsm_DtcInLeakgeCntOvrd
      data Cnt: sw-calibration-access=READ-ONLY, type=Signal_Uint
    VDsm_DtcOvCntOvrd
      data Cnt: sw-calibration-access=READ-ONLY, type=Signal_Uint
    VDsm_DtcSocLoTimeOvrd
      data Sec: sw-calibration-access=READ-ONLY, type=Signal_Float
    VDsm_DtcUvCntOvrd
      data Cnt: sw-calibration-access=READ-ONLY, type=Signal_Uint
    VDsm_OnChgEngyOvrd
      data Wh: sw-calibration-access=READ-ONLY, type=Signal_Float
    VDsm_DtcPreChgEnyCntOvrd
      data Cnt: sw-calibration-access=READ-ONLY, type=Signal_Uint
    VDsm_DtcPreChgToCntOvrd
      data Cnt: sw-calibration-access=READ-ONLY, type=Signal_Uint
    VDsm_DtcRlyOpenCurCntOvrd
      data Cnt: sw-calibration-access=READ-ONLY, type=Signal_Uint
    VDsm_DtcRlyOpenCurLvl1CntOvrd
      data Cnt: sw-calibration-access=READ-ONLY, type=Signal_Uint
    VDsm_DtcRlyOpenCurLvl2CntOvrd
      data Cnt: sw-calibration-access=READ-ONLY, type=Signal_Uint
    VDsm_DtcRlyOpenCurLvl3CntOvrd
      data Cnt: sw-calibration-access=READ-ONLY, type=Signal_Uint
    VDsm_NvmTempLvl1CntOvrd
      data Cnt: sw-calibration-access=READ-ONLY, type=Signal_Uint
    VDsm_NvmTempLvl2CntOvrd
      data Cnt: sw-calibration-access=READ-ONLY, type=Signal_Uint
    VDsm_NvmTempLvl3CntOvrd
      data Cnt: sw-calibration-access=READ-ONLY, type=Signal_Uint
    VDsm_NvmTempLvl4CntOvrd
      data Cnt: sw-calibration-access=READ-ONLY, type=Signal_Uint
    VDsm_NvmTempLvl5CntOvrd
      data Cnt: sw-calibration-access=READ-ONLY, type=Signal_Uint
    VDsm_NvmTempLvl6CntOvrd
      data Cnt: sw-calibration-access=READ-ONLY, type=Signal_Uint
    VDsm_NvmTempLvl7CntOvrd
      data Cnt: sw-calibration-access=READ-ONLY, type=Signal_Uint
    VFpm_DtcInfo
      data Array: sw-calibration-access=READ-ONLY, type=rt_Array_UInt8_7
    VRcm_FltInd
      data Array: sw-calibration-access=READ-ONLY, type=rt_Array_UInt8_50
    VNvm_NvmOnChgAccumTimeBkp
      data Sec: sw-calibration-access=READ-ONLY, type=Float
    VNvm_NvmOnChgCntBkp
      data Cnt: sw-calibration-access=READ-ONLY, type=UInt16
    VNvm_NvmOnChgEngy
      data Wh: sw-calibration-access=READ-ONLY, type=Float
    VNvm_NvmOnChgEngyBkp
      data Wh: sw-calibration-access=READ-ONLY, type=Float
    VIpm_NvmOnChgAccumTimeBkp
      data Sec: sw-calibration-access=READ-ONLY, type=Signal_Float
    VIpm_NvmOnChgCntBkp
      data Cnt: sw-calibration-access=READ-ONLY, type=Signal_Uint
    VIpm_NvmOnChgEngy
      data Wh: sw-calibration-access=READ-ONLY, type=Signal_Float
    VIpm_NvmOnChgEngyBkp
      data Wh: sw-calibration-access=READ-ONLY, type=Signal_Float
    VBal_CellBalEn
      data Array: sw-calibration-access=READ-ONLY, type=rt_Array_UInt16_15
    VBal_RtcClearPerfd
      data Flg: sw-calibration-access=READ-ONLY, type=Boolean
    VIpm_CcsVoltOut
      data V: sw-calibration-access=READ-ONLY, type=Signal_Float
    VIpm_CcsCurOut
      data A: sw-calibration-access=READ-ONLY, type=Signal_Float
    VIpm_FicmReserCtrlReq
      data Enum: sw-calibration-access=READ-ONLY, type=Signal_Uint
    VIpm_FicmChgCtrlReq
      data Enum: sw-calibration-access=READ-ONLY, type=Signal_Uint
    VBmm_FltInd
      data Array: sw-calibration-access=READ-ONLY, type=rt_Array_UInt8_50
    VIpm_AppReserChgMaxCur
      data A: sw-calibration-access=READ-ONLY, type=Signal_Float
    VIpm_AppReserChgReqFreq
      data Enum: sw-calibration-access=READ-ONLY, type=Signal_Uint
    VIpm_AppReserChgReqSoc
      data Pct: sw-calibration-access=READ-ONLY, type=Signal_Float
    VIpm_FicmReserChgMaxCur
      data A: sw-calibration-access=READ-ONLY, type=Signal_Float
    VIpm_FicmReserChgReqEngy
      data Kwh: sw-calibration-access=READ-ONLY, type=Signal_Float
    VIpm_FicmReserChgReqMode
      data Enum: sw-calibration-access=READ-ONLY, type=Signal_Uint
    VIpm_FicmReserChgReqRange
      data Km: sw-calibration-access=READ-ONLY, type=Signal_Float
    VIpm_FicmReserChgReqSoc
      data Pct: sw-calibration-access=READ-ONLY, type=Signal_Float
    VIpm_FicmReserChgReqTime
      data Hr: sw-calibration-access=READ-ONLY, type=Signal_Float
    VIpm_FicmReserChgStTime
      data Array: sw-calibration-access=READ-ONLY, type=rt_Array_UInt8_6
    VIpm_FicmReserChgStTimeV
      data Flg: sw-calibration-access=READ-ONLY, type=Boolean
    VNvm_NvmReserChgMaxCur
      data A: sw-calibration-access=READ-ONLY, type=Float
    VNvm_NvmReserChgReqSoc
      data Pct: sw-calibration-access=READ-ONLY, type=Float
    VNvm_NvmReserChgStDurtnTime
      data Hr: sw-calibration-access=READ-ONLY, type=Float
    VIpm_EngRun
      data Flg: sw-calibration-access=READ-ONLY, type=Signal_Uint
    VRsc_ReserChgPushInfo
      data Enum: sw-calibration-access=READ-ONLY, type=Signal_Uint
    VRsc_ReserChgStat
      data Enum: sw-calibration-access=READ-ONLY, type=UInt8
    VRsc_ReserCtrlStat
      data Enum: sw-calibration-access=READ-ONLY, type=Signal_Uint
    VRsc_ChgCtrlStat
      data Enum: sw-calibration-access=READ-ONLY, type=Signal_Uint
    VRsc_ReserChgRemainTime
      data Min: sw-calibration-access=READ-ONLY, type=Signal_Float
    VRsc_ReserChgCtrlPerfd
      data Enum: sw-calibration-access=READ-ONLY, type=Signal_Uint
    VRsc_ReserFltReason
      data Enum: sw-calibration-access=READ-ONLY, type=Signal_Uint
    VRsc_ReserChgFltReason
      data Enum: sw-calibration-access=READ-ONLY, type=Signal_Uint
    VRsc_ReserChgStTime
      data Array: sw-calibration-access=READ-ONLY, type=rt_Array_UInt8_6
    VRsc_ReserChgStDurtnTime
      data Hr: sw-calibration-access=READ-ONLY, type=Float
    VRsc_ReserChgMaxCur
      data A: sw-calibration-access=READ-ONLY, type=Float
    VRsc_ReserChgReqFreq
      data Enum: sw-calibration-access=READ-ONLY, type=UInt8
    VRsc_ReserChgReqMode
      data Enum: sw-calibration-access=READ-ONLY, type=UInt8
    VRsc_ReserChgReqTime
      data Hr: sw-calibration-access=READ-ONLY, type=Float
    VRsc_ReserChgReqEngy
      data Kwh: sw-calibration-access=READ-ONLY, type=Float
    VRsc_ReserChgReqRange
      data Km: sw-calibration-access=READ-ONLY, type=Float
    VRsc_ReserChgReqSoc
      data Pct: sw-calibration-access=READ-ONLY, type=Float
    VRsc_ReserChgV
      data Flg: sw-calibration-access=READ-ONLY, type=Boolean
    VRsc_ReserChgCeaseReason
      data Enum: sw-calibration-access=READ-ONLY, type=Signal_Uint
    VRsc_ReserDataSet
      data Enum: sw-calibration-access=READ-ONLY, type=Signal_Uint
    VRsc_NetTime
      data Array: sw-calibration-access=READ-ONLY, type=rt_Array_UInt8_6
    VRsc_NetTimeV
      data Flg: sw-calibration-access=READ-ONLY, type=Boolean
    VRsc_RtcSetReq
      data Flg: sw-calibration-access=READ-ONLY, type=Boolean
    VRsc_RtcClearReq
      data Flg: sw-calibration-access=READ-ONLY, type=Boolean
    VRsc_NetTimeSetReq
      data Flg: sw-calibration-access=READ-ONLY, type=Boolean
    VRsc_CtrlOnChg
      data Enum: sw-calibration-access=READ-ONLY, type=Signal_Uint
    VIpm_Rcv0x86
      data Flg: sw-calibration-access=READ-ONLY, type=Boolean
    VIpm_Rcv0x87
      data Flg: sw-calibration-access=READ-ONLY, type=Boolean
    VIpm_Rcv0x80
      data Flg: sw-calibration-access=READ-ONLY, type=Boolean
    VIpm_Rcv0x82
      data Flg: sw-calibration-access=READ-ONLY, type=Boolean
    VIpm_Rcv0x83
      data Flg: sw-calibration-access=READ-ONLY, type=Boolean
    VIpm_Rcv0x3BA
      data Flg: sw-calibration-access=READ-ONLY, type=Boolean
    VIpm_Rcv0x3BC
      data Flg: sw-calibration-access=READ-ONLY, type=Boolean
    VIpm_Rcv0x3BE
      data Flg: sw-calibration-access=READ-ONLY, type=Boolean
    VIpm_Rcv0x3BD
      data Flg: sw-calibration-access=READ-ONLY, type=Boolean
    VIpm_Rcv0xC9
      data Flg: sw-calibration-access=READ-ONLY, type=Boolean
    VIpm_Rcv0x84
      data Flg: sw-calibration-access=READ-ONLY, type=Boolean
    VIpm_Rcv0x364
      data Flg: sw-calibration-access=READ-ONLY, type=Boolean
    VIpm_Rcv0x30B
      data Flg: sw-calibration-access=READ-ONLY, type=Boolean
    VIpm_Rcv0x4C1
      data Flg: sw-calibration-access=READ-ONLY, type=Boolean
    VIpm_Rcv0x169
      data Flg: sw-calibration-access=READ-ONLY, type=Boolean
    VIpm_Rcv0x541
      data Flg: sw-calibration-access=READ-ONLY, type=Boolean
    VIpm_Rcv0x353
      data Flg: sw-calibration-access=READ-ONLY, type=Boolean
    VIpm_Rcv0x163
      data Flg: sw-calibration-access=READ-ONLY, type=Boolean
    VIpm_Rcv0xAF
      data Flg: sw-calibration-access=READ-ONLY, type=Boolean
    VIpm_Rcv0x196
      data Flg: sw-calibration-access=READ-ONLY, type=Boolean
    VIpm_Rcv0x540
      data Flg: sw-calibration-access=READ-ONLY, type=Boolean
    VIpm_Rcv0x3F1
      data Flg: sw-calibration-access=READ-ONLY, type=Boolean
    VIpm_Rcv0x3A2
      data Flg: sw-calibration-access=READ-ONLY, type=Boolean
    VIpm_Rcv0x96
      data Flg: sw-calibration-access=READ-ONLY, type=Boolean
    VIpm_Rcv0x41F
      data Flg: sw-calibration-access=READ-ONLY, type=Boolean
    VIpm_Rcv0x99
      data Flg: sw-calibration-access=READ-ONLY, type=Boolean
    VRcm_OnChgReverseCheckSRspd
      data Enum: sw-calibration-access=READ-ONLY, type=UInt8
    VRcm_OnChgReverseCheckSInfo
      data Enum: sw-calibration-access=READ-ONLY, type=UInt8
    VDsm_OnChgReverseCheckRCtrl
      data Enum: sw-calibration-access=READ-ONLY, type=Signal_Uint
    VRsc_ReserChgStep
      data Enum: sw-calibration-access=READ-ONLY, type=UInt8
    VRsc_ReserStep
      data Enum: sw-calibration-access=READ-ONLY, type=UInt8
    VIpm_RvsReq
      data Flg: sw-calibration-access=READ-ONLY, type=Signal_Uint
    VRcm_VoltReverseCheck
      data Flg: sw-calibration-access=READ-ONLY, type=Boolean
    VIpm_Rcv0x647
      data Flg: sw-calibration-access=READ-ONLY, type=Boolean
    VIpm_Rcv0x630
      data Flg: sw-calibration-access=READ-ONLY, type=Boolean
    VIpm_Rcv0x320
      data Flg: sw-calibration-access=READ-ONLY, type=Boolean
    VIpm_Rcv0x321
      data Flg: sw-calibration-access=READ-ONLY, type=Boolean
    VIpm_Rcv0x322
      data Flg: sw-calibration-access=READ-ONLY, type=Boolean
    VIpm_Rcv0x323
      data Flg: sw-calibration-access=READ-ONLY, type=Boolean
    VIpm_Rcv0x324
      data Flg: sw-calibration-access=READ-ONLY, type=Boolean
    VIpm_Rcv0x325
      data Flg: sw-calibration-access=READ-ONLY, type=Boolean
    VBal_DebugInfo
      data Array: sw-calibration-access=READ-ONLY, type=rt_Array_UInt8_8
    VBmm_DebugInfo
      data Array: sw-calibration-access=READ-ONLY, type=rt_Array_UInt8_8
    VOnc_DebugInfo
      data Array: sw-calibration-access=READ-ONLY, type=rt_Array_UInt8_8
    VRcm_DebugInfo
      data Array: sw-calibration-access=READ-ONLY, type=rt_Array_UInt8_8
    VRsc_DebugInfo
      data Array: sw-calibration-access=READ-ONLY, type=rt_Array_UInt8_8
    VSoc_DebugInfo
      data Array: sw-calibration-access=READ-ONLY, type=rt_Array_UInt8_8
    VSod_DebugInfo
      data Array: sw-calibration-access=READ-ONLY, type=rt_Array_UInt8_8
    VSoe_DebugInfo
      data Array: sw-calibration-access=READ-ONLY, type=rt_Array_UInt8_8
    VSof_DebugInfo
      data Array: sw-calibration-access=READ-ONLY, type=rt_Array_UInt8_8
    VSoh_DebugInfo
      data Array: sw-calibration-access=READ-ONLY, type=rt_Array_UInt8_8
    VThm_DebugInfo
      data Array: sw-calibration-access=READ-ONLY, type=rt_Array_UInt8_8
    VWlc_DebugInfo
      data Array: sw-calibration-access=READ-ONLY, type=rt_Array_UInt8_8
    VIpm_Rcv0x41B
      data Flg: sw-calibration-access=READ-ONLY, type=Boolean
    VIpm_Rcv0x356
      data Flg: sw-calibration-access=READ-ONLY, type=Boolean
    VIpm_Rcv0x358
      data Flg: sw-calibration-access=READ-ONLY, type=Boolean
    VIpm_Rcv0x21C
      data Flg: sw-calibration-access=READ-ONLY, type=Boolean
    VIpm_Rcv0x376
      data Flg: sw-calibration-access=READ-ONLY, type=Boolean
    VIpm_Rcv0x34F
      data Flg: sw-calibration-access=READ-ONLY, type=Boolean
    VIpm_FicmResetToDefaultReq
      data Flg: type=Boolean
    VIpm_AppNetTime
      data Array: sw-calibration-access=READ-ONLY, type=rt_Array_UInt8_6
    VBmm_NvmReserData
      data Array: sw-calibration-access=READ-ONLY, type=rt_Array_Float_20
    VSoh_NvmCapBufData
      data Array: sw-calibration-access=READ-ONLY, type=rt_Array_Float_2x20
    VNvm_NvmCapBufData
      data Array: sw-calibration-access=READ-ONLY, type=rt_Array_Float_2x20
    VSoh_NvmResiBufData
      data Array: sw-calibration-access=READ-ONLY, type=rt_Array_Float_10x10
    VNvm_NvmResiBufData
      data Array: sw-calibration-access=READ-ONLY, type=rt_Array_Float_10x10
    VNvm_NvmResiBufDataBkp
      data Array: sw-calibration-access=READ-ONLY, type=rt_Array_Float_10x10
    VNvm_NvmCapBufDataBkp
      data Array: sw-calibration-access=READ-ONLY, type=rt_Array_Float_2x20
    VSod_PackSodStartUp
      data Pct: sw-calibration-access=READ-ONLY, type=Signal_Float
    VSod_PackSodChg
      data Pct: sw-calibration-access=READ-ONLY, type=Signal_Float
    VSod_PackSodDisChg
      data Pct: sw-calibration-access=READ-ONLY, type=Signal_Float
    VSod_PackSod
      data Pct: sw-calibration-access=READ-ONLY, type=Signal_Float
    VOpm_NvmPackSod
      data Pct: sw-calibration-access=READ-ONLY, type=Float
    VNvm_NvmPackSod
      data Pct: sw-calibration-access=READ-ONLY, type=Float
    VNvm_NvmPackSodBkp
      data Pct: sw-calibration-access=READ-ONLY, type=Float
    VIpm_NvmPackSod
      data Pct: sw-calibration-access=READ-ONLY, type=Signal_Float
    VIpm_NvmPackSodBkp
      data Pct: sw-calibration-access=READ-ONLY, type=Signal_Float
    VNvm_NvmReserData
      data Array: sw-calibration-access=READ-ONLY, type=rt_Array_Float_20
    VNvm_NvmReserDataBkp
      data Array: sw-calibration-access=READ-ONLY, type=rt_Array_Float_20
    VRsc_ChgingStat
      data Enum: sw-calibration-access=READ-ONLY, type=Signal_Uint
    VSoh_OcvInitFlg
      data Flg: sw-calibration-access=READ-ONLY, type=Signal_Uint
    VSoh_OcvInit
      data V: sw-calibration-access=READ-ONLY, type=Signal_Float
    VSoh_DeltaSoc
      data Pct: sw-calibration-access=READ-ONLY, type=Signal_Float
    VSoh_DeltaCapFadeOut
      data Pct: sw-calibration-access=READ-ONLY, type=Signal_Float
    VSoh_CapFadeNumber
      data Enum: sw-calibration-access=READ-ONLY, type=Signal_Uint
    VSoh_CapFadeCnt
      data Enum: sw-calibration-access=READ-ONLY, type=Signal_Uint
    VSoh_CapFadeAccum
      data Pct: sw-calibration-access=READ-ONLY, type=Signal_Float
    VSoh_AccumCurTime
      data Sec: sw-calibration-access=READ-ONLY, type=Signal_Float
    VOpm_NvmOcvInitFlg
      data Flg: sw-calibration-access=READ-ONLY, type=Boolean
    VOpm_NvmOcvInit
      data V: sw-calibration-access=READ-ONLY, type=Float
    VOpm_NvmDeltaSoc
      data Pct: sw-calibration-access=READ-ONLY, type=Float
    VOpm_NvmDeltaCapFadeOut
      data Pct: sw-calibration-access=READ-ONLY, type=Float
    VOpm_NvmCapFadeNumber
      data Enum: sw-calibration-access=READ-ONLY, type=UInt8
    VOpm_NvmCapFadeCnt
      data Enum: sw-calibration-access=READ-ONLY, type=UInt8
    VOpm_NvmCapFadeAccum
      data Pct: sw-calibration-access=READ-ONLY, type=Float
    VOpm_NvmAccumCurTime
      data Sec: sw-calibration-access=READ-ONLY, type=Float
    VIpm_NvmOcvInitFlg
      data Flg: sw-calibration-access=READ-ONLY, type=Signal_Uint
    VIpm_NvmOcvInitFlgBkp
      data Flg: sw-calibration-access=READ-ONLY, type=Signal_Uint
    VIpm_NvmOcvInit
      data V: sw-calibration-access=READ-ONLY, type=Signal_Float
    VIpm_NvmOcvInitBkp
      data V: sw-calibration-access=READ-ONLY, type=Signal_Float
    VIpm_NvmDeltaSoc
      data Pct: sw-calibration-access=READ-ONLY, type=Signal_Float
    VIpm_NvmDeltaSocBkp
      data Pct: sw-calibration-access=READ-ONLY, type=Signal_Float
    VIpm_NvmDeltaCapFadeOut
      data Pct: sw-calibration-access=READ-ONLY, type=Signal_Float
    VIpm_NvmDeltaCapFadeOutBkp
      data Pct: sw-calibration-access=READ-ONLY, type=Signal_Float
    VIpm_NvmCapFadeNumber
      data Enum: sw-calibration-access=READ-ONLY, type=Signal_Uint
    VIpm_NvmCapFadeNumberBkp
      data Enum: sw-calibration-access=READ-ONLY, type=Signal_Uint
    VIpm_NvmCapFadeCnt
      data Enum: sw-calibration-access=READ-ONLY, type=Signal_Uint
    VIpm_NvmCapFadeCntBkp
      data Enum: sw-calibration-access=READ-ONLY, type=Signal_Uint
    VIpm_NvmCapFadeAccum
      data Pct: sw-calibration-access=READ-ONLY, type=Signal_Float
    VIpm_NvmCapFadeAccumBkp
      data Pct: sw-calibration-access=READ-ONLY, type=Signal_Float
    VIpm_NvmAccumCurTime
      data Sec: sw-calibration-access=READ-ONLY, type=Signal_Float
    VIpm_NvmAccumCurTimeBkp
      data Sec: sw-calibration-access=READ-ONLY, type=Signal_Float
    VNvm_NvmAccumCurTime
      data Sec: sw-calibration-access=READ-ONLY, type=Float
    VNvm_NvmAccumCurTimeBkp
      data Sec: sw-calibration-access=READ-ONLY, type=Float
    VNvm_NvmCapFadeAccum
      data Pct: sw-calibration-access=READ-ONLY, type=Float
    VNvm_NvmCapFadeAccumBkp
      data Pct: sw-calibration-access=READ-ONLY, type=Float
    VNvm_NvmCapFadeCnt
      data Enum: sw-calibration-access=READ-ONLY, type=UInt8
    VNvm_NvmCapFadeCntBkp
      data Enum: sw-calibration-access=READ-ONLY, type=UInt8
    VNvm_NvmCapFadeNumber
      data Enum: sw-calibration-access=READ-ONLY, type=UInt8
    VNvm_NvmCapFadeNumberBkp
      data Enum: sw-calibration-access=READ-ONLY, type=UInt8
    VNvm_NvmDeltaCapFadeOut
      data Pct: sw-calibration-access=READ-ONLY, type=Float
    VNvm_NvmDeltaCapFadeOutBkp
      data Pct: sw-calibration-access=READ-ONLY, type=Float
    VNvm_NvmDeltaSoc
      data Pct: sw-calibration-access=READ-ONLY, type=Float
    VNvm_NvmDeltaSocBkp
      data Pct: sw-calibration-access=READ-ONLY, type=Float
    VNvm_NvmOcvInitFlg
      data Flg: sw-calibration-access=READ-ONLY, type=Boolean
    VNvm_NvmOcvInitFlgBkp
      data Flg: sw-calibration-access=READ-ONLY, type=Boolean
    VNvm_NvmOcvInit
      data V: sw-calibration-access=READ-ONLY, type=Float
    VNvm_NvmOcvInitBkp
      data V: sw-calibration-access=READ-ONLY, type=Float
    VNvm_BlockSohDataFlagFb
      data Enum: type=UInt8
    VNvm_BlockSohDataFlagV
      data Flg: sw-calibration-access=READ-ONLY, type=Boolean
  client server interface VSoh_NvmSohDataReq
    operation NvmSohDataReq
      arg NvmSohDataReq_Enum: type=UInt8, direction=IN
  client server interface VRsc_NvmRscDataReq
    operation NvmRscDataReq
      arg NvmRscDataReq_Enum: type=UInt8, direction=IN
  sender receiver interface VNvm_BlockRscDataFlagFb
    data Enum: type=UInt8
  sender receiver interface VNvm_BlockRscDataFlagV
    data Flg: sw-calibration-access=READ-ONLY, type=Boolean
  client server interface VSoh_NvmSohMirrorDataReq
    operation NvmSohMirrorDataReq
      arg NvmSohMirrorDataReq_Enum: type=UInt8, direction=IN
  328 x sender receiver interface:
    VNvm_BlockSohDataFlagMirrorFb
      data Enum: type=UInt8
    VNvm_BlockSohDataFlagMirrorV
      data Flg: sw-calibration-access=READ-ONLY, type=Boolean
    VOnc_OncSwVer
      data Enum: sw-calibration-access=READ-ONLY, type=Signal_Uint
    VIpm_NvmOncSwVer
      data Enum: sw-calibration-access=READ-ONLY, type=Signal_Uint
    VOpm_NvmOncSwVer
      data Enum: sw-calibration-access=READ-ONLY, type=UInt32
    VNvm_NvmOncSwVer
      data Enum: sw-calibration-access=READ-ONLY, type=UInt32
    VNvm_NvmAccumAh
      data Ah: sw-calibration-access=READ-ONLY, type=Float
    VNvm_NvmAccumAhBkp
      data Ah: sw-calibration-access=READ-ONLY, type=Float
    VOpm_NvmAccumAh
      data Ah: sw-calibration-access=READ-ONLY, type=Float
    VIpm_Mod01BalStat
      data Array: sw-calibration-access=READ-ONLY, type=rt_Array_UInt8_32
    VIpm_Mod00BalStat
      data Array: sw-calibration-access=READ-ONLY, type=rt_Array_UInt8_32
    VIpm_Mod02BalStat
      data Array: sw-calibration-access=READ-ONLY, type=rt_Array_UInt8_32
    VIpm_Mod03BalStat
      data Array: sw-calibration-access=READ-ONLY, type=rt_Array_UInt8_32
    VIpm_Mod04BalStat
      data Array: sw-calibration-access=READ-ONLY, type=rt_Array_UInt8_32
    VIpm_Mod05BalStat
      data Array: sw-calibration-access=READ-ONLY, type=rt_Array_UInt8_32
    VIpm_Mod06BalStat
      data Array: sw-calibration-access=READ-ONLY, type=rt_Array_UInt8_32
    VIpm_Mod07BalStat
      data Array: sw-calibration-access=READ-ONLY, type=rt_Array_UInt8_32
    VIpm_Mod08BalStat
      data Array: sw-calibration-access=READ-ONLY, type=rt_Array_UInt8_32
    VIpm_Mod09BalStat
      data Array: sw-calibration-access=READ-ONLY, type=rt_Array_UInt8_32
    VIpm_Mod10BalStat
      data Array: sw-calibration-access=READ-ONLY, type=rt_Array_UInt8_32
    VIpm_Mod11BalStat
      data Array: sw-calibration-access=READ-ONLY, type=rt_Array_UInt8_32
    VIpm_Mod07CellVoltMax
      data V: sw-calibration-access=READ-ONLY, type=Signal_Float
    VIpm_Mod07CellVoltMin
      data V: sw-calibration-access=READ-ONLY, type=Signal_Float
    VIpm_Mod07TemBusbar
      data C: sw-calibration-access=READ-ONLY, type=Signal_Float
    VIpm_Mod07Temp01
      data C: sw-calibration-access=READ-ONLY, type=Signal_Float
    VIpm_Mod07Temp02
      data C: sw-calibration-access=READ-ONLY, type=Signal_Float
    VIpm_Mod07TempPcb
      data C: sw-calibration-access=READ-ONLY, type=Signal_Float
    VIpm_Mod07Volt
      data V: sw-calibration-access=READ-ONLY, type=Signal_Float
    VIpm_Mod00CellVoltMax
      data V: sw-calibration-access=READ-ONLY, type=Signal_Float
    VIpm_Mod00CellVoltMin
      data V: sw-calibration-access=READ-ONLY, type=Signal_Float
    VIpm_Mod00Temp01
      data C: sw-calibration-access=READ-ONLY, type=Signal_Float
    VIpm_Mod00Temp02
      data C: sw-calibration-access=READ-ONLY, type=Signal_Float
    VIpm_Mod00TemBusbar
      data C: sw-calibration-access=READ-ONLY, type=Signal_Float
    VIpm_Mod00TempPcb
      data C: sw-calibration-access=READ-ONLY, type=Signal_Float
    VIpm_Mod00Volt
      data V: sw-calibration-access=READ-ONLY, type=Signal_Float
    VIpm_Mod08CellVoltMax
      data V: sw-calibration-access=READ-ONLY, type=Signal_Float
    VIpm_Mod08CellVoltMin
      data V: sw-calibration-access=READ-ONLY, type=Signal_Float
    VIpm_Mod08Temp01
      data C: sw-calibration-access=READ-ONLY, type=Signal_Float
    VIpm_Mod08Temp02
      data C: sw-calibration-access=READ-ONLY, type=Signal_Float
    VIpm_Mod08TemBusbar
      data C: sw-calibration-access=READ-ONLY, type=Signal_Float
    VIpm_Mod08TempPcb
      data C: sw-calibration-access=READ-ONLY, type=Signal_Float
    VIpm_Mod08Volt
      data V: sw-calibration-access=READ-ONLY, type=Signal_Float
    VIpm_Mod09CellVoltMax
      data V: sw-calibration-access=READ-ONLY, type=Signal_Float
    VIpm_Mod09CellVoltMin
      data V: sw-calibration-access=READ-ONLY, type=Signal_Float
    VIpm_Mod09Temp01
      data C: sw-calibration-access=READ-ONLY, type=Signal_Float
    VIpm_Mod09Temp02
      data C: sw-calibration-access=READ-ONLY, type=Signal_Float
    VIpm_Mod09TemBusbar
      data C: sw-calibration-access=READ-ONLY, type=Signal_Float
    VIpm_Mod09TempPcb
      data C: sw-calibration-access=READ-ONLY, type=Signal_Float
    VIpm_Mod09Volt
      data V: sw-calibration-access=READ-ONLY, type=Signal_Float
    VIpm_Mod10CellVoltMax
      data V: sw-calibration-access=READ-ONLY, type=Signal_Float
    VIpm_Mod10CellVoltMin
      data V: sw-calibration-access=READ-ONLY, type=Signal_Float
    VIpm_Mod10Temp01
      data C: sw-calibration-access=READ-ONLY, type=Signal_Float
    VIpm_Mod10Temp02
      data C: sw-calibration-access=READ-ONLY, type=Signal_Float
    VIpm_Mod10TemBusbar
      data C: sw-calibration-access=READ-ONLY, type=Signal_Float
    VIpm_Mod10TempPcb
      data C: sw-calibration-access=READ-ONLY, type=Signal_Float
    VIpm_Mod10Volt
      data V: sw-calibration-access=READ-ONLY, type=Signal_Float
    VIpm_Mod11CellVoltMax
      data V: sw-calibration-access=READ-ONLY, type=Signal_Float
    VIpm_Mod11CellVoltMin
      data V: sw-calibration-access=READ-ONLY, type=Signal_Float
    VIpm_Mod11Temp01
      data C: sw-calibration-access=READ-ONLY, type=Signal_Float
    VIpm_Mod11Temp02
      data C: sw-calibration-access=READ-ONLY, type=Signal_Float
    VIpm_Mod11TemBusbar
      data C: sw-calibration-access=READ-ONLY, type=Signal_Float
    VIpm_Mod11TempPcb
      data C: sw-calibration-access=READ-ONLY, type=Signal_Float
    VIpm_Mod11Volt
      data V: sw-calibration-access=READ-ONLY, type=Signal_Float
    VIpm_Mod00CellVoltAvg
      data V: sw-calibration-access=READ-ONLY, type=Signal_Float
    VIpm_Mod00CellVoltMaxId
      data Enum: sw-calibration-access=READ-ONLY, type=Signal_Uint
    VIpm_Mod00CellVoltMinId
      data Enum: sw-calibration-access=READ-ONLY, type=Signal_Uint
    VIpm_Mod00BalCnt
      data Cnt: sw-calibration-access=READ-ONLY, type=Signal_Uint
    VIpm_Mod00TempMaxId
      data Enum: sw-calibration-access=READ-ONLY, type=Signal_Uint
    VIpm_Mod00TempMinId
      data Enum: sw-calibration-access=READ-ONLY, type=Signal_Uint
    VIpm_Mod00BalFlt
      data Enum: sw-calibration-access=READ-ONLY, type=Signal_Uint
    VIpm_Mod00BalFltId
      data Enum: sw-calibration-access=READ-ONLY, type=Signal_Uint
    VIpm_Mod00DtcDetail
      data Enum: sw-calibration-access=READ-ONLY, type=Signal_Uint
    VIpm_Mod00FltOut
      data Flg: sw-calibration-access=READ-ONLY, type=Signal_Uint
    VIpm_Mod00TempFlt
      data Enum: sw-calibration-access=READ-ONLY, type=Signal_Uint
    VIpm_Mod00TempFltId
      data Enum: sw-calibration-access=READ-ONLY, type=Signal_Uint
    VIpm_Mod00VoltFlt
      data Enum: sw-calibration-access=READ-ONLY, type=Signal_Uint
    VIpm_Mod00VoltFltId
      data Enum: sw-calibration-access=READ-ONLY, type=Signal_Uint
    VIpm_Mod01BalCnt
      data Cnt: sw-calibration-access=READ-ONLY, type=Signal_Uint
    VIpm_Mod01BalFlt
      data Enum: sw-calibration-access=READ-ONLY, type=Signal_Uint
    VIpm_Mod01BalFltId
      data Enum: sw-calibration-access=READ-ONLY, type=Signal_Uint
    VIpm_Mod01CellVoltAvg
      data V: sw-calibration-access=READ-ONLY, type=Signal_Float
    VIpm_Mod01CellVoltMaxId
      data Enum: sw-calibration-access=READ-ONLY, type=Signal_Uint
    VIpm_Mod01CellVoltMinId
      data Enum: sw-calibration-access=READ-ONLY, type=Signal_Uint
    VIpm_Mod01DtcDetail
      data Enum: sw-calibration-access=READ-ONLY, type=Signal_Uint
    VIpm_Mod01FltOut
      data Flg: sw-calibration-access=READ-ONLY, type=Signal_Uint
    VIpm_Mod01TempFlt
      data Enum: sw-calibration-access=READ-ONLY, type=Signal_Uint
    VIpm_Mod01TempFltId
      data Enum: sw-calibration-access=READ-ONLY, type=Signal_Uint
    VIpm_Mod01TempMaxId
      data Enum: sw-calibration-access=READ-ONLY, type=Signal_Uint
    VIpm_Mod01TempMinId
      data Enum: sw-calibration-access=READ-ONLY, type=Signal_Uint
    VIpm_Mod01VoltFlt
      data Enum: sw-calibration-access=READ-ONLY, type=Signal_Uint
    VIpm_Mod01VoltFltId
      data Enum: sw-calibration-access=READ-ONLY, type=Signal_Uint
    VIpm_Mod02BalCnt
      data Cnt: sw-calibration-access=READ-ONLY, type=Signal_Uint
    VIpm_Mod02BalFlt
      data Enum: sw-calibration-access=READ-ONLY, type=Signal_Uint
    VIpm_Mod02BalFltId
      data Enum: sw-calibration-access=READ-ONLY, type=Signal_Uint
    VIpm_Mod02CellVoltAvg
      data V: sw-calibration-access=READ-ONLY, type=Signal_Float
    VIpm_Mod02CellVoltMaxId
      data Enum: sw-calibration-access=READ-ONLY, type=Signal_Uint
    VIpm_Mod02CellVoltMinId
      data Enum: sw-calibration-access=READ-ONLY, type=Signal_Uint
    VIpm_Mod02DtcDetail
      data Enum: sw-calibration-access=READ-ONLY, type=Signal_Uint
    VIpm_Mod02FltOut
      data Flg: sw-calibration-access=READ-ONLY, type=Signal_Uint
    VIpm_Mod02TempFlt
      data Enum: sw-calibration-access=READ-ONLY, type=Signal_Uint
    VIpm_Mod02TempFltId
      data Enum: sw-calibration-access=READ-ONLY, type=Signal_Uint
    VIpm_Mod02TempMaxId
      data Enum: sw-calibration-access=READ-ONLY, type=Signal_Uint
    VIpm_Mod02TempMinId
      data Enum: sw-calibration-access=READ-ONLY, type=Signal_Uint
    VIpm_Mod02VoltFlt
      data Enum: sw-calibration-access=READ-ONLY, type=Signal_Uint
    VIpm_Mod02VoltFltId
      data Enum: sw-calibration-access=READ-ONLY, type=Signal_Uint
    VIpm_Mod03BalCnt
      data Cnt: sw-calibration-access=READ-ONLY, type=Signal_Uint
    VIpm_Mod03BalFlt
      data Enum: sw-calibration-access=READ-ONLY, type=Signal_Uint
    VIpm_Mod03BalFltId
      data Enum: sw-calibration-access=READ-ONLY, type=Signal_Uint
    VIpm_Mod03CellVoltAvg
      data V: sw-calibration-access=READ-ONLY, type=Signal_Float
    VIpm_Mod03CellVoltMaxId
      data Enum: sw-calibration-access=READ-ONLY, type=Signal_Uint
    VIpm_Mod03CellVoltMinId
      data Enum: sw-calibration-access=READ-ONLY, type=Signal_Uint
    VIpm_Mod03DtcDetail
      data Enum: sw-calibration-access=READ-ONLY, type=Signal_Uint
    VIpm_Mod03FltOut
      data Flg: sw-calibration-access=READ-ONLY, type=Signal_Uint
    VIpm_Mod03TempFlt
      data Enum: sw-calibration-access=READ-ONLY, type=Signal_Uint
    VIpm_Mod03TempFltId
      data Enum: sw-calibration-access=READ-ONLY, type=Signal_Uint
    VIpm_Mod03TempMaxId
      data Enum: sw-calibration-access=READ-ONLY, type=Signal_Uint
    VIpm_Mod03TempMinId
      data Enum: sw-calibration-access=READ-ONLY, type=Signal_Uint
    VIpm_Mod03VoltFlt
      data Enum: sw-calibration-access=READ-ONLY, type=Signal_Uint
    VIpm_Mod03VoltFltId
      data Enum: sw-calibration-access=READ-ONLY, type=Signal_Uint
    VIpm_Mod04BalCnt
      data Cnt: sw-calibration-access=READ-ONLY, type=Signal_Uint
    VIpm_Mod04BalFlt
      data Enum: sw-calibration-access=READ-ONLY, type=Signal_Uint
    VIpm_Mod04BalFltId
      data Enum: sw-calibration-access=READ-ONLY, type=Signal_Uint
    VIpm_Mod04CellVoltAvg
      data V: sw-calibration-access=READ-ONLY, type=Signal_Float
    VIpm_Mod04CellVoltMaxId
      data Enum: sw-calibration-access=READ-ONLY, type=Signal_Uint
    VIpm_Mod04CellVoltMinId
      data Enum: sw-calibration-access=READ-ONLY, type=Signal_Uint
    VIpm_Mod04DtcDetail
      data Enum: sw-calibration-access=READ-ONLY, type=Signal_Uint
    VIpm_Mod04FltOut
      data Flg: sw-calibration-access=READ-ONLY, type=Signal_Uint
    VIpm_Mod04TempFlt
      data Enum: sw-calibration-access=READ-ONLY, type=Signal_Uint
    VIpm_Mod04TempFltId
      data Enum: sw-calibration-access=READ-ONLY, type=Signal_Uint
    VIpm_Mod04TempMaxId
      data Enum: sw-calibration-access=READ-ONLY, type=Signal_Uint
    VIpm_Mod04TempMinId
      data Enum: sw-calibration-access=READ-ONLY, type=Signal_Uint
    VIpm_Mod04VoltFlt
      data Enum: sw-calibration-access=READ-ONLY, type=Signal_Uint
    VIpm_Mod04VoltFltId
      data Enum: sw-calibration-access=READ-ONLY, type=Signal_Uint
    VIpm_Mod05BalCnt
      data Cnt: sw-calibration-access=READ-ONLY, type=Signal_Uint
    VIpm_Mod05BalFlt
      data Enum: sw-calibration-access=READ-ONLY, type=Signal_Uint
    VIpm_Mod05BalFltId
      data Enum: sw-calibration-access=READ-ONLY, type=Signal_Uint
    VIpm_Mod05CellVoltAvg
      data V: sw-calibration-access=READ-ONLY, type=Signal_Float
    VIpm_Mod05CellVoltMaxId
      data Enum: sw-calibration-access=READ-ONLY, type=Signal_Uint
    VIpm_Mod05CellVoltMinId
      data Enum: sw-calibration-access=READ-ONLY, type=Signal_Uint
    VIpm_Mod05DtcDetail
      data Enum: sw-calibration-access=READ-ONLY, type=Signal_Uint
    VIpm_Mod05FltOut
      data Flg: sw-calibration-access=READ-ONLY, type=Signal_Uint
    VIpm_Mod05TempFlt
      data Enum: sw-calibration-access=READ-ONLY, type=Signal_Uint
    VIpm_Mod05TempFltId
      data Enum: sw-calibration-access=READ-ONLY, type=Signal_Uint
    VIpm_Mod05TempMaxId
      data Enum: sw-calibration-access=READ-ONLY, type=Signal_Uint
    VIpm_Mod05TempMinId
      data Enum: sw-calibration-access=READ-ONLY, type=Signal_Uint
    VIpm_Mod05VoltFlt
      data Enum: sw-calibration-access=READ-ONLY, type=Signal_Uint
    VIpm_Mod05VoltFltId
      data Enum: sw-calibration-access=READ-ONLY, type=Signal_Uint
    VIpm_Mod06BalCnt
      data Cnt: sw-calibration-access=READ-ONLY, type=Signal_Uint
    VIpm_Mod06BalFlt
      data Enum: sw-calibration-access=READ-ONLY, type=Signal_Uint
    VIpm_Mod06BalFltId
      data Enum: sw-calibration-access=READ-ONLY, type=Signal_Uint
    VIpm_Mod06CellVoltAvg
      data V: sw-calibration-access=READ-ONLY, type=Signal_Float
    VIpm_Mod06CellVoltMaxId
      data Enum: sw-calibration-access=READ-ONLY, type=Signal_Uint
    VIpm_Mod06CellVoltMinId
      data Enum: sw-calibration-access=READ-ONLY, type=Signal_Uint
    VIpm_Mod06DtcDetail
      data Enum: sw-calibration-access=READ-ONLY, type=Signal_Uint
    VIpm_Mod06FltOut
      data Flg: sw-calibration-access=READ-ONLY, type=Signal_Uint
    VIpm_Mod06TempFlt
      data Enum: sw-calibration-access=READ-ONLY, type=Signal_Uint
    VIpm_Mod06TempFltId
      data Enum: sw-calibration-access=READ-ONLY, type=Signal_Uint
    VIpm_Mod06TempMaxId
      data Enum: sw-calibration-access=READ-ONLY, type=Signal_Uint
    VIpm_Mod06TempMinId
      data Enum: sw-calibration-access=READ-ONLY, type=Signal_Uint
    VIpm_Mod06VoltFlt
      data Enum: sw-calibration-access=READ-ONLY, type=Signal_Uint
    VIpm_Mod06VoltFltId
      data Enum: sw-calibration-access=READ-ONLY, type=Signal_Uint
    VIpm_Mod07BalCnt
      data Cnt: sw-calibration-access=READ-ONLY, type=Signal_Uint
    VIpm_Mod07BalFlt
      data Enum: sw-calibration-access=READ-ONLY, type=Signal_Uint
    VIpm_Mod07BalFltId
      data Enum: sw-calibration-access=READ-ONLY, type=Signal_Uint
    VIpm_Mod07CellVoltAvg
      data V: sw-calibration-access=READ-ONLY, type=Signal_Float
    VIpm_Mod07CellVoltMaxId
      data Enum: sw-calibration-access=READ-ONLY, type=Signal_Uint
    VIpm_Mod07CellVoltMinId
      data Enum: sw-calibration-access=READ-ONLY, type=Signal_Uint
    VIpm_Mod07DtcDetail
      data Enum: sw-calibration-access=READ-ONLY, type=Signal_Uint
    VIpm_Mod07FltOut
      data Flg: sw-calibration-access=READ-ONLY, type=Signal_Uint
    VIpm_Mod07TempFlt
      data Enum: sw-calibration-access=READ-ONLY, type=Signal_Uint
    VIpm_Mod07TempFltId
      data Enum: sw-calibration-access=READ-ONLY, type=Signal_Uint
    VIpm_Mod07TempMaxId
      data Enum: sw-calibration-access=READ-ONLY, type=Signal_Uint
    VIpm_Mod07TempMinId
      data Enum: sw-calibration-access=READ-ONLY, type=Signal_Uint
    VIpm_Mod07VoltFlt
      data Enum: sw-calibration-access=READ-ONLY, type=Signal_Uint
    VIpm_Mod07VoltFltId
      data Enum: sw-calibration-access=READ-ONLY, type=Signal_Uint
    VIpm_Mod08BalCnt
      data Cnt: sw-calibration-access=READ-ONLY, type=Signal_Uint
    VIpm_Mod08BalFlt
      data Enum: sw-calibration-access=READ-ONLY, type=Signal_Uint
    VIpm_Mod08BalFltId
      data Enum: sw-calibration-access=READ-ONLY, type=Signal_Uint
    VIpm_Mod08CellVoltAvg
      data V: sw-calibration-access=READ-ONLY, type=Signal_Float
    VIpm_Mod08CellVoltMaxId
      data Enum: sw-calibration-access=READ-ONLY, type=Signal_Uint
    VIpm_Mod08CellVoltMinId
      data Enum: sw-calibration-access=READ-ONLY, type=Signal_Uint
    VIpm_Mod08DtcDetail
      data Enum: sw-calibration-access=READ-ONLY, type=Signal_Uint
    VIpm_Mod08FltOut
      data Flg: sw-calibration-access=READ-ONLY, type=Signal_Uint
    VIpm_Mod08TempFlt
      data Enum: sw-calibration-access=READ-ONLY, type=Signal_Uint
    VIpm_Mod08TempFltId
      data Enum: sw-calibration-access=READ-ONLY, type=Signal_Uint
    VIpm_Mod08TempMaxId
      data Enum: sw-calibration-access=READ-ONLY, type=Signal_Uint
    VIpm_Mod08TempMinId
      data Enum: sw-calibration-access=READ-ONLY, type=Signal_Uint
    VIpm_Mod08VoltFlt
      data Enum: sw-calibration-access=READ-ONLY, type=Signal_Uint
    VIpm_Mod08VoltFltId
      data Enum: sw-calibration-access=READ-ONLY, type=Signal_Uint
    VIpm_Mod09BalCnt
      data Cnt: sw-calibration-access=READ-ONLY, type=Signal_Uint
    VIpm_Mod09BalFlt
      data Enum: sw-calibration-access=READ-ONLY, type=Signal_Uint
    VIpm_Mod09BalFltId
      data Enum: sw-calibration-access=READ-ONLY, type=Signal_Uint
    VIpm_Mod09CellVoltAvg
      data V: sw-calibration-access=READ-ONLY, type=Signal_Float
    VIpm_Mod09CellVoltMaxId
      data Enum: sw-calibration-access=READ-ONLY, type=Signal_Uint
    VIpm_Mod09CellVoltMinId
      data Enum: sw-calibration-access=READ-ONLY, type=Signal_Uint
    VIpm_Mod09DtcDetail
      data Enum: sw-calibration-access=READ-ONLY, type=Signal_Uint
    VIpm_Mod09FltOut
      data Flg: sw-calibration-access=READ-ONLY, type=Signal_Uint
    VIpm_Mod09TempFlt
      data Enum: sw-calibration-access=READ-ONLY, type=Signal_Uint
    VIpm_Mod09TempFltId
      data Enum: sw-calibration-access=READ-ONLY, type=Signal_Uint
    VIpm_Mod09TempMaxId
      data Enum: sw-calibration-access=READ-ONLY, type=Signal_Uint
    VIpm_Mod09TempMinId
      data Enum: sw-calibration-access=READ-ONLY, type=Signal_Uint
    VIpm_Mod09VoltFlt
      data Enum: sw-calibration-access=READ-ONLY, type=Signal_Uint
    VIpm_Mod09VoltFltId
      data Enum: sw-calibration-access=READ-ONLY, type=Signal_Uint
    VIpm_Mod10BalCnt
      data Cnt: sw-calibration-access=READ-ONLY, type=Signal_Uint
    VIpm_Mod10BalFlt
      data Enum: sw-calibration-access=READ-ONLY, type=Signal_Uint
    VIpm_Mod10BalFltId
      data Enum: sw-calibration-access=READ-ONLY, type=Signal_Uint
    VIpm_Mod10CellVoltAvg
      data V: sw-calibration-access=READ-ONLY, type=Signal_Float
    VIpm_Mod10CellVoltMaxId
      data Enum: sw-calibration-access=READ-ONLY, type=Signal_Uint
    VIpm_Mod10CellVoltMinId
      data Enum: sw-calibration-access=READ-ONLY, type=Signal_Uint
    VIpm_Mod10DtcDetail
      data Enum: sw-calibration-access=READ-ONLY, type=Signal_Uint
    VIpm_Mod10FltOut
      data Flg: sw-calibration-access=READ-ONLY, type=Signal_Uint
    VIpm_Mod10TempFlt
      data Enum: sw-calibration-access=READ-ONLY, type=Signal_Uint
    VIpm_Mod10TempFltId
      data Enum: sw-calibration-access=READ-ONLY, type=Signal_Uint
    VIpm_Mod10TempMaxId
      data Enum: sw-calibration-access=READ-ONLY, type=Signal_Uint
    VIpm_Mod10TempMinId
      data Enum: sw-calibration-access=READ-ONLY, type=Signal_Uint
    VIpm_Mod10VoltFlt
      data Enum: sw-calibration-access=READ-ONLY, type=Signal_Uint
    VIpm_Mod10VoltFltId
      data Enum: sw-calibration-access=READ-ONLY, type=Signal_Uint
    VIpm_Mod11BalCnt
      data Cnt: sw-calibration-access=READ-ONLY, type=Signal_Uint
    VIpm_Mod11BalFlt
      data Enum: sw-calibration-access=READ-ONLY, type=Signal_Uint
    VIpm_Mod11BalFltId
      data Enum: sw-calibration-access=READ-ONLY, type=Signal_Uint
    VIpm_Mod11CellVoltAvg
      data V: sw-calibration-access=READ-ONLY, type=Signal_Float
    VIpm_Mod11CellVoltMaxId
      data Enum: sw-calibration-access=READ-ONLY, type=Signal_Uint
    VIpm_Mod11CellVoltMinId
      data Enum: sw-calibration-access=READ-ONLY, type=Signal_Uint
    VIpm_Mod11DtcDetail
      data Enum: sw-calibration-access=READ-ONLY, type=Signal_Uint
    VIpm_Mod11FltOut
      data Flg: sw-calibration-access=READ-ONLY, type=Signal_Uint
    VIpm_Mod11TempFlt
      data Enum: sw-calibration-access=READ-ONLY, type=Signal_Uint
    VIpm_Mod11TempFltId
      data Enum: sw-calibration-access=READ-ONLY, type=Signal_Uint
    VIpm_Mod11TempMaxId
      data Enum: sw-calibration-access=READ-ONLY, type=Signal_Uint
    VIpm_Mod11TempMinId
      data Enum: sw-calibration-access=READ-ONLY, type=Signal_Uint
    VIpm_Mod11VoltFlt
      data Enum: sw-calibration-access=READ-ONLY, type=Signal_Uint
    VIpm_Mod11VoltFltId
      data Enum: sw-calibration-access=READ-ONLY, type=Signal_Uint
    VIpm_Rcv0x100
      data Flg: sw-calibration-access=READ-ONLY, type=Boolean
    VIpm_Rcv0x101
      data Flg: sw-calibration-access=READ-ONLY, type=Boolean
    VIpm_Rcv0x102
      data Flg: sw-calibration-access=READ-ONLY, type=Boolean
    VIpm_Rcv0x103
      data Flg: sw-calibration-access=READ-ONLY, type=Boolean
    VIpm_Rcv0x104
      data Flg: sw-calibration-access=READ-ONLY, type=Boolean
    VIpm_Rcv0x105
      data Flg: sw-calibration-access=READ-ONLY, type=Boolean
    VIpm_Rcv0x106
      data Flg: sw-calibration-access=READ-ONLY, type=Boolean
    VIpm_Rcv0x107
      data Flg: sw-calibration-access=READ-ONLY, type=Boolean
    VIpm_Rcv0x108
      data Flg: sw-calibration-access=READ-ONLY, type=Boolean
    VIpm_Rcv0x109
      data Flg: sw-calibration-access=READ-ONLY, type=Boolean
    VIpm_Rcv0x110
      data Flg: sw-calibration-access=READ-ONLY, type=Boolean
    VIpm_Rcv0x10A
      data Flg: sw-calibration-access=READ-ONLY, type=Boolean
    VIpm_Rcv0x10B
      data Flg: sw-calibration-access=READ-ONLY, type=Boolean
    VIpm_Rcv0x111
      data Flg: sw-calibration-access=READ-ONLY, type=Boolean
    VIpm_Rcv0x112
      data Flg: sw-calibration-access=READ-ONLY, type=Boolean
    VIpm_Rcv0x113
      data Flg: sw-calibration-access=READ-ONLY, type=Boolean
    VIpm_Rcv0x114
      data Flg: sw-calibration-access=READ-ONLY, type=Boolean
    VIpm_Rcv0x115
      data Flg: sw-calibration-access=READ-ONLY, type=Boolean
    VIpm_Rcv0x116
      data Flg: sw-calibration-access=READ-ONLY, type=Boolean
    VIpm_Rcv0x117
      data Flg: sw-calibration-access=READ-ONLY, type=Boolean
    VIpm_Rcv0x118
      data Flg: sw-calibration-access=READ-ONLY, type=Boolean
    VIpm_Rcv0x119
      data Flg: sw-calibration-access=READ-ONLY, type=Boolean
    VIpm_Rcv0x11A
      data Flg: sw-calibration-access=READ-ONLY, type=Boolean
    VIpm_Rcv0x11B
      data Flg: sw-calibration-access=READ-ONLY, type=Boolean
    VIpm_Rcv0x120
      data Flg: sw-calibration-access=READ-ONLY, type=Boolean
    VIpm_Rcv0x121
      data Flg: sw-calibration-access=READ-ONLY, type=Boolean
    VIpm_Rcv0x122
      data Flg: sw-calibration-access=READ-ONLY, type=Boolean
    VIpm_Rcv0x123
      data Flg: sw-calibration-access=READ-ONLY, type=Boolean
    VIpm_Rcv0x124
      data Flg: sw-calibration-access=READ-ONLY, type=Boolean
    VIpm_Rcv0x125
      data Flg: sw-calibration-access=READ-ONLY, type=Boolean
    VIpm_Rcv0x126
      data Flg: sw-calibration-access=READ-ONLY, type=Boolean
    VIpm_Rcv0x127
      data Flg: sw-calibration-access=READ-ONLY, type=Boolean
    VIpm_Rcv0x128
      data Flg: sw-calibration-access=READ-ONLY, type=Boolean
    VIpm_Rcv0x129
      data Flg: sw-calibration-access=READ-ONLY, type=Boolean
    VIpm_Rcv0x12A
      data Flg: sw-calibration-access=READ-ONLY, type=Boolean
    VIpm_Rcv0x12B
      data Flg: sw-calibration-access=READ-ONLY, type=Boolean
    VBal_ReqAwake
      data Flg: sw-calibration-access=READ-ONLY, type=Boolean
    VBal_ReqLeakageCmd
      data Enum: sw-calibration-access=READ-ONLY, type=UInt8
    VIpm_Rcv0x343
      data Flg: sw-calibration-access=READ-ONLY, type=Boolean
    VIpm_Rcv0x38B
      data Flg: sw-calibration-access=READ-ONLY, type=Boolean
    VIpm_Rcv0x30C
      data Flg: sw-calibration-access=READ-ONLY, type=Boolean
    VIpm_Rcv0xE5
      data Flg: sw-calibration-access=READ-ONLY, type=Boolean
    VIpm_Rcv0x354
      data Flg: sw-calibration-access=READ-ONLY, type=Boolean
    VIpm_EduCoolTem
      data C: sw-calibration-access=READ-ONLY, type=Signal_Float
    VIpm_EduCoolPumpStat
      data Flg: sw-calibration-access=READ-ONLY, type=Signal_Uint
    VIpm_Rcv0x394
      data Flg: sw-calibration-access=READ-ONLY, type=Boolean
    VIpm_Rcv0x395
      data Flg: sw-calibration-access=READ-ONLY, type=Boolean
    VIpm_Rcv0x396
      data Flg: sw-calibration-access=READ-ONLY, type=Boolean
    VIpm_CcsChgAccumTime
      data Min: sw-calibration-access=READ-ONLY, type=Signal_Float
    VIpm_CcsChgEn
      data Enum: sw-calibration-access=READ-ONLY, type=UInt8
    VIpm_ChmProtocolVer
      data Cnt: sw-calibration-access=READ-ONLY, type=UInt32
    VIpm_CmlCurOutMax
      data A: sw-calibration-access=READ-ONLY, type=Signal_Float
    VIpm_CmlCurOutMin
      data A: sw-calibration-access=READ-ONLY, type=Signal_Float
    VIpm_CmlVoltOutMax
      data V: sw-calibration-access=READ-ONLY, type=Signal_Float
    VIpm_CmlVoltOutMin
      data V: sw-calibration-access=READ-ONLY, type=Signal_Float
    VIpm_CrmChrgrNum
      data Cnt: sw-calibration-access=READ-ONLY, type=UInt16
    VIpm_CsdChrgrNum
      data Cnt: sw-calibration-access=READ-ONLY, type=UInt32
    VIpm_CsdEngyOut
      data Kwh: sw-calibration-access=READ-ONLY, type=Signal_Float
    VIpm_CstBmsCs
      data Enum: sw-calibration-access=READ-ONLY, type=UInt8
    VIpm_CstChgCsSet
      data Enum: sw-calibration-access=READ-ONLY, type=UInt8
    VIpm_CstChrgrEpo
      data Enum: sw-calibration-access=READ-ONLY, type=UInt8
    VIpm_CstChrgrIntOt
      data Enum: sw-calibration-access=READ-ONLY, type=UInt8
    VIpm_CstChrgrOt
      data Enum: sw-calibration-access=READ-ONLY, type=UInt8
    VIpm_CstEngyNotTrsmt
      data Enum: sw-calibration-access=READ-ONLY, type=UInt8
    VIpm_CstFltCs
      data Enum: sw-calibration-access=READ-ONLY, type=UInt8
    VIpm_CstManualCs
      data Enum: sw-calibration-access=READ-ONLY, type=UInt8
    VIpm_CtsTimeDay
      data Day: sw-calibration-access=READ-ONLY, type=Signal_Uint
    VIpm_CtsTimeHour
      data Hr: sw-calibration-access=READ-ONLY, type=Signal_Uint
    VIpm_CtsTimeMinute
      data Min: sw-calibration-access=READ-ONLY, type=Signal_Uint
    VIpm_CtsTimeMonth
      data Mon: sw-calibration-access=READ-ONLY, type=Signal_Uint
    VIpm_CtsTimeSecond
      data Sec: sw-calibration-access=READ-ONLY, type=Signal_Uint
    VIpm_CtsTimeYear
      data Yr: sw-calibration-access=READ-ONLY, type=Signal_Uint
    VIpm_RcvChm
      data Flg: sw-calibration-access=READ-ONLY, type=Boolean
    VIpm_RcvCml
      data Flg: sw-calibration-access=READ-ONLY, type=Boolean
    VIpm_RcvCro
      data Flg: sw-calibration-access=READ-ONLY, type=Boolean
    VIpm_RcvCsd
      data Flg: sw-calibration-access=READ-ONLY, type=Boolean
    VIpm_RcvCst
      data Flg: sw-calibration-access=READ-ONLY, type=Boolean
    VOfc_BcpNomEngy
      data Kwh: sw-calibration-access=READ-ONLY, type=Signal_Float
    VOfc_BemCtsCmlTo
      data Enum: sw-calibration-access=READ-ONLY, type=UInt8
    VOfc_BhmAcptChgVoltMax
      data V: sw-calibration-access=READ-ONLY, type=Signal_Float
    VOfc_BrmBmsSoftVer01
      data Cnt: sw-calibration-access=READ-ONLY, type=UInt32
    VOfc_BrmBmsSoftVer02
      data Cnt: sw-calibration-access=READ-ONLY, type=UInt32
    VOfc_BrmProperty
      data Cnt: sw-calibration-access=READ-ONLY, type=UInt8
    VOfc_BrmProtocolVer
      data Cnt: sw-calibration-access=READ-ONLY, type=Signal_Uint
    VOfc_BroPrepareStat
      data Enum: sw-calibration-access=READ-ONLY, type=UInt8
    VOfc_BsmTemStat
      data Enum: sw-calibration-access=READ-ONLY, type=UInt8
    VOfc_BstBmsOtFlt
      data Enum: sw-calibration-access=READ-ONLY, type=UInt8
    VOfc_BstChgConFlt
      data Enum: sw-calibration-access=READ-ONLY, type=UInt8
    VOfc_BstChrgrCs
      data Enum: sw-calibration-access=READ-ONLY, type=UInt8
    VOfc_BstChk2VoltFlt
      data Enum: sw-calibration-access=READ-ONLY, type=UInt8
    VOfc_BstConOtFlt
      data Enum: sw-calibration-access=READ-ONLY, type=UInt8
    VOfc_BstHvIsoFlt
      data Enum: sw-calibration-access=READ-ONLY, type=UInt8
    VOfc_BstHvRelayFlt
      data Enum: sw-calibration-access=READ-ONLY, type=UInt8
    VOfc_BstOtherFlt
      data Enum: sw-calibration-access=READ-ONLY, type=UInt8
    VOfc_BstOvCur
      data Enum: sw-calibration-access=READ-ONLY, type=UInt8
    VOfc_BstPackOtFlt
      data Enum: sw-calibration-access=READ-ONLY, type=UInt8
    VOfc_BstVoltErr
      data Enum: sw-calibration-access=READ-ONLY, type=UInt8
  10 x client server interface:
    VOfc_OffChgKeepBcl
      operation SendOnce
    VOfc_OffChgKeepBcp
      operation SendOnce
    VOfc_OffChgKeepBcs
      operation SendOnce
    VOfc_OffChgKeepBem
      operation SendOnce
    VOfc_OffChgKeepBhm
      operation SendOnce
    VOfc_OffChgKeepBrm
      operation SendOnce
    VOfc_OffChgKeepBro
      operation SendOnce
    VOfc_OffChgKeepBsd
      operation SendOnce
    VOfc_OffChgKeepBsm
      operation SendOnce
    VOfc_OffChgKeepBst
      operation SendOnce
  280 x sender receiver interface:
    VSod_CellTemAvg
      data C: sw-calibration-access=READ-ONLY, type=Signal_Float
    VSod_CellTemMax
      data C: sw-calibration-access=READ-ONLY, type=Signal_Float
    VSod_CellTemMin
      data C: sw-calibration-access=READ-ONLY, type=Signal_Float
    VSod_CellVoltAvg
      data V: sw-calibration-access=READ-ONLY, type=Signal_Float
    VSod_CellVoltMax
      data V: sw-calibration-access=READ-ONLY, type=Signal_Float
    VSod_CellVoltMin
      data V: sw-calibration-access=READ-ONLY, type=Signal_Float
    VIpm_OffChrgrNegSktTem
      data C: sw-calibration-access=READ-ONLY, type=Signal_Float
    VIpm_OffChrgrPosSktTem
      data C: sw-calibration-access=READ-ONLY, type=Signal_Float
    VIpm_OnChrgrSktELock
      data Enum: sw-calibration-access=READ-ONLY, type=Signal_Uint
    VIpm_Rcv0x31B
      data Flg: sw-calibration-access=READ-ONLY, type=Boolean
    VIpm_ElecEngyRstPerfd
      data Flg: sw-calibration-access=READ-ONLY, type=Boolean
    VIpm_HvElecEngyAvgRate
      data Pct: sw-calibration-access=READ-ONLY, type=Signal_Uint
    VIpm_Rcv0x3A3
      data Flg: sw-calibration-access=READ-ONLY, type=Boolean
    VIpm_Rcv0x551
      data Flg: sw-calibration-access=READ-ONLY, type=Boolean
    VIpm_Rcv0x41D
      data Flg: sw-calibration-access=READ-ONLY, type=Boolean
    VThm_TempFactor
      data Pct: sw-calibration-access=READ-ONLY, type=Float
    VSod_BusbarTemMax
      data C: sw-calibration-access=READ-ONLY, type=Signal_Float
    VSod_ModBalCnt
      data Cnt: sw-calibration-access=READ-ONLY, type=Signal_Uint
    VSod_PcbTemMax
      data C: sw-calibration-access=READ-ONLY, type=Signal_Float
    VSod_CellVoltMaxId
      data Enum: sw-calibration-access=READ-ONLY, type=Signal_Uint
    VSod_CellVoltMinId
      data Enum: sw-calibration-access=READ-ONLY, type=Signal_Uint
    VSod_CellTempMaxId
      data Enum: sw-calibration-access=READ-ONLY, type=Signal_Uint
    VSod_CellTempMinId
      data Enum: sw-calibration-access=READ-ONLY, type=Signal_Uint
    VOnc_OnChgCmd
      data Enum: sw-calibration-access=READ-ONLY, type=UInt8
    VIpm_RcvCem
      data Flg: sw-calibration-access=READ-ONLY, type=Boolean
    VIpm_RcvCts
      data Flg: sw-calibration-access=READ-ONLY, type=Boolean
    VOfc_OffChgDone
      data Flg: sw-calibration-access=READ-ONLY, type=Boolean
    VIpm_CellVoltMaxId
      data Enum: sw-calibration-access=READ-ONLY, type=Signal_Uint
    VIpm_CellVoltMinId
      data Enum: sw-calibration-access=READ-ONLY, type=Signal_Uint
    VIpm_CellTempMaxId
      data Enum: sw-calibration-access=READ-ONLY, type=Signal_Uint
    VIpm_CellTempMinId
      data Enum: sw-calibration-access=READ-ONLY, type=Signal_Uint
    VIpm_HwDebugInfo
      data Array: sw-calibration-access=READ-ONLY, type=rt_Array_UInt8_8
    VOfc_OffChgBthIndDrv
      data Enum: sw-calibration-access=READ-ONLY, type=UInt8
    VWlc_WlChgBthIndDrv
      data Enum: sw-calibration-access=READ-ONLY, type=UInt8
    VOnc_BalCtrlForce
      data Enum: sw-calibration-access=READ-ONLY, type=UInt8
    VSoh_SohAccumOdo
      data Km: sw-calibration-access=READ-ONLY, type=Signal_Float
    VIpm_NvmSohAccumOdo
      data Km: sw-calibration-access=READ-ONLY, type=Signal_Float
    VIpm_NvmSohAccumOdoBkp
      data Km: sw-calibration-access=READ-ONLY, type=Signal_Float
    VNvm_NvmSohAccumOdo
      data Km: sw-calibration-access=READ-ONLY, type=Float
    VNvm_NvmSohAccumOdoBkp
      data Km: sw-calibration-access=READ-ONLY, type=Float
    VOpm_NvmSohAccumOdo
      data Km: sw-calibration-access=READ-ONLY, type=Float
    VIpm_Rcv0x373
      data Flg: sw-calibration-access=READ-ONLY, type=Boolean
    VIpm_Rcv0x46A
      data Flg: sw-calibration-access=READ-ONLY, type=Boolean
    VIpm_VehLckngStat
      data Enum: sw-calibration-access=READ-ONLY, type=Signal_Uint
    VIpm_ChrgrCoolngSysStat
      data Enum: sw-calibration-access=READ-ONLY, type=Signal_Uint
    VIpm_Rcv0x14B
      data Flg: sw-calibration-access=READ-ONLY, type=Boolean
    VIpm_SdmRc
      data Enum: sw-calibration-access=READ-ONLY, type=Signal_Uint
    VOfc_OffChgSysKeepWake
      data Flg: sw-calibration-access=READ-ONLY, type=Signal_Uint
    VBmm_ChrgrReq
      data Enum: sw-calibration-access=READ-ONLY, type=UInt8
    VDsm_SupConfigParam
      data Enum: sw-calibration-access=READ-ONLY, type=Signal_Uint
    VOfc_OffChgStep
      data Enum: sw-calibration-access=READ-ONLY, type=UInt8
    VDsm_PackSocAvailOvrd
      data Pct: sw-calibration-access=READ-ONLY, type=Signal_Float
    VDsm_OffChgAccumTimeOvrd
      data Sec: sw-calibration-access=READ-ONLY, type=Signal_Uint
    VIpm_NvmOffChgAccumTime
      data Sec: sw-calibration-access=READ-ONLY, type=Signal_Uint
    VIpm_NvmOffChgAccumTimeBkp
      data Sec: sw-calibration-access=READ-ONLY, type=Signal_Uint
    VOfc_DebugInfo
      data Enum: sw-calibration-access=READ-ONLY, type=UInt32
    VOfc_OffChgAccumTime
      data Sec: sw-calibration-access=READ-ONLY, type=Signal_Uint
    VOpm_NvmCellTempDiffTime
      data Sec: sw-calibration-access=READ-ONLY, type=UInt32
    VNvm_NvmCellTempDiffTime
      data Sec: sw-calibration-access=READ-ONLY, type=UInt32
    VNvm_NvmCellTempDiffTimeBkp
      data Sec: sw-calibration-access=READ-ONLY, type=UInt32
    VIpm_NvmCellTempDiffTime
      data Sec: sw-calibration-access=READ-ONLY, type=Signal_Uint
    VIpm_NvmCellTempDiffTimeBkp
      data Sec: sw-calibration-access=READ-ONLY, type=Signal_Uint
    VOpm_NvmOffChgAccumTime
      data Sec: sw-calibration-access=READ-ONLY, type=UInt32
    VNvm_NvmOffChgAccumTime
      data Sec: sw-calibration-access=READ-ONLY, type=UInt32
    VNvm_NvmOffChgAccumTimeBkp
      data Sec: sw-calibration-access=READ-ONLY, type=UInt32
    VDsm_CellTempDiffTimeOvrd
      data Sec: sw-calibration-access=READ-ONLY, type=Signal_Uint
    VOnc_OnChrgrSktELockEn
      data Flg: sw-calibration-access=READ-ONLY, type=Signal_Uint
    VSoe_CrntElecEngyAvg
      data KwhP100Km: sw-calibration-access=READ-ONLY, type=Signal_Float
    VSoe_PerKmElecEngyAvg
      data KwhP100Km: sw-calibration-access=READ-ONLY, type=Signal_Float
    VSoe_TotalAccumOdo
      data Km: sw-calibration-access=READ-ONLY, type=Signal_Float
    VIpm_NvmCrntAccumDisEngy
      data Kwh: sw-calibration-access=READ-ONLY, type=Signal_Float
    VIpm_NvmCrntAccumOdo
      data Km: sw-calibration-access=READ-ONLY, type=Signal_Float
    VIpm_NvmCrntElecEngyAvg
      data KwhP100Km: sw-calibration-access=READ-ONLY, type=Signal_Float
    VIpm_NvmPerKmElecEngyAvg
      data KwhP100Km: sw-calibration-access=READ-ONLY, type=Signal_Float
    VIpm_NvmTotalAccumChgEngy
      data Kwh: sw-calibration-access=READ-ONLY, type=Signal_Float
    VIpm_NvmTotalAccumOdo
      data Km: sw-calibration-access=READ-ONLY, type=Signal_Float
    VIpm_NvmTotalElecEngyAvg
      data KwhP100Km: sw-calibration-access=READ-ONLY, type=Signal_Float
    VIpm_NvmCrntAccumDisEngyBkp
      data Kwh: sw-calibration-access=READ-ONLY, type=Signal_Float
    VIpm_NvmCrntAccumOdoBkp
      data Km: sw-calibration-access=READ-ONLY, type=Signal_Float
    VIpm_NvmCrntElecEngyAvgBkp
      data KwhP100Km: sw-calibration-access=READ-ONLY, type=Signal_Float
    VIpm_NvmPerKmElecEngyAvgBkp
      data KwhP100Km: sw-calibration-access=READ-ONLY, type=Signal_Float
    VIpm_NvmTotalAccumChgEngyBkp
      data Kwh: sw-calibration-access=READ-ONLY, type=Signal_Float
    VIpm_NvmTotalAccumOdoBkp
      data Km: sw-calibration-access=READ-ONLY, type=Signal_Float
    VIpm_NvmTotalElecEngyAvgBkp
      data KwhP100Km: sw-calibration-access=READ-ONLY, type=Signal_Float
    VNvm_NvmCrntAccumDisEngy
      data Kwh: sw-calibration-access=READ-ONLY, type=Float
    VNvm_NvmCrntAccumDisEngyBkp
      data Kwh: sw-calibration-access=READ-ONLY, type=Float
    VNvm_NvmCrntAccumOdo
      data Km: sw-calibration-access=READ-ONLY, type=Float
    VNvm_NvmCrntAccumOdoBkp
      data Km: sw-calibration-access=READ-ONLY, type=Float
    VNvm_NvmCrntElecEngyAvg
      data KwhP100Km: sw-calibration-access=READ-ONLY, type=Float
    VNvm_NvmCrntElecEngyAvgBkp
      data KwhP100Km: sw-calibration-access=READ-ONLY, type=Float
    VNvm_NvmPerKmElecEngyAvg
      data KwhP100Km: sw-calibration-access=READ-ONLY, type=Float
    VNvm_NvmPerKmElecEngyAvgBkp
      data KwhP100Km: sw-calibration-access=READ-ONLY, type=Float
    VNvm_NvmTotalAccumChgEngy
      data Kwh: sw-calibration-access=READ-ONLY, type=Float
    VNvm_NvmTotalAccumChgEngyBkp
      data Kwh: sw-calibration-access=READ-ONLY, type=Float
    VNvm_NvmTotalAccumOdo
      data Km: sw-calibration-access=READ-ONLY, type=Float
    VNvm_NvmTotalAccumOdoBkp
      data Km: sw-calibration-access=READ-ONLY, type=Float
    VNvm_NvmTotalElecEngyAvg
      data KwhP100Km: sw-calibration-access=READ-ONLY, type=Float
    VNvm_NvmTotalElecEngyAvgBkp
      data KwhP100Km: sw-calibration-access=READ-ONLY, type=Float
    VOpm_NvmCrntAccumDisEngy
      data Kwh: sw-calibration-access=READ-ONLY, type=Float
    VOpm_NvmCrntAccumOdo
      data Km: sw-calibration-access=READ-ONLY, type=Float
    VOpm_NvmCrntElecEngyAvg
      data KwhP100Km: sw-calibration-access=READ-ONLY, type=Float
    VOpm_NvmPerKmElecEngyAvg
      data KwhP100Km: sw-calibration-access=READ-ONLY, type=Float
    VOpm_NvmTotalAccumChgEngy
      data Kwh: sw-calibration-access=READ-ONLY, type=Float
    VOpm_NvmTotalAccumOdo
      data Km: sw-calibration-access=READ-ONLY, type=Float
    VOpm_NvmTotalElecEngyAvg
      data KwhP100Km: sw-calibration-access=READ-ONLY, type=Float
    VDsm_OnChgBthIndCtrl
      data Flg: sw-calibration-access=READ-ONLY, type=Signal_Uint
    VIpm_ObdCpPwmStat
      data Enum: sw-calibration-access=READ-ONLY, type=Signal_Uint
    VIpm_ObdCpPwmDuty
      data Pct: sw-calibration-access=READ-ONLY, type=Signal_Float
    VIpm_FltInd
      data Array: sw-calibration-access=READ-ONLY, type=UInt8
    VSoe_AccumChgEngy
      data Kwh: sw-calibration-access=READ-ONLY, type=Signal_Float
    VSoe_AccumDisEngy
      data Kwh: sw-calibration-access=READ-ONLY, type=Signal_Float
    VSoe_AccumOdo
      data Km: sw-calibration-access=READ-ONLY, type=Signal_Float
    VSoe_ElecEngyAvg
      data KwhP100Km: sw-calibration-access=READ-ONLY, type=Signal_Float
    VIpm_Mod00CellTemp00
      data C: sw-calibration-access=READ-ONLY, type=Signal_UInt8Id
    VIpm_Mod00CellTemp01
      data C: sw-calibration-access=READ-ONLY, type=Signal_UInt8Id
    VIpm_Mod00CellTemp02
      data C: sw-calibration-access=READ-ONLY, type=Signal_UInt8Id
    VIpm_Mod00CellTemp03
      data C: sw-calibration-access=READ-ONLY, type=Signal_UInt8Id
    VIpm_Mod00CellTemp04
      data C: sw-calibration-access=READ-ONLY, type=Signal_UInt8Id
    VIpm_Mod00CellTemp05
      data C: sw-calibration-access=READ-ONLY, type=Signal_UInt8Id
    VIpm_Mod01CellTemp00
      data C: sw-calibration-access=READ-ONLY, type=Signal_UInt8Id
    VIpm_Mod01CellTemp01
      data C: sw-calibration-access=READ-ONLY, type=Signal_UInt8Id
    VIpm_Mod01CellTemp02
      data C: sw-calibration-access=READ-ONLY, type=Signal_UInt8Id
    VIpm_Mod01CellTemp03
      data C: sw-calibration-access=READ-ONLY, type=Signal_UInt8Id
    VIpm_Mod01CellTemp04
      data C: sw-calibration-access=READ-ONLY, type=Signal_UInt8Id
    VIpm_Mod01CellTemp05
      data C: sw-calibration-access=READ-ONLY, type=Signal_UInt8Id
    VIpm_Mod02CellTemp00
      data C: sw-calibration-access=READ-ONLY, type=Signal_UInt8Id
    VIpm_Mod02CellTemp01
      data C: sw-calibration-access=READ-ONLY, type=Signal_UInt8Id
    VIpm_Mod02CellTemp02
      data C: sw-calibration-access=READ-ONLY, type=Signal_UInt8Id
    VIpm_Mod02CellTemp03
      data C: sw-calibration-access=READ-ONLY, type=Signal_UInt8Id
    VIpm_Mod02CellTemp04
      data C: sw-calibration-access=READ-ONLY, type=Signal_UInt8Id
    VIpm_Mod02CellTemp05
      data C: sw-calibration-access=READ-ONLY, type=Signal_UInt8Id
    VIpm_Mod03CellTemp00
      data C: sw-calibration-access=READ-ONLY, type=Signal_UInt8Id
    VIpm_Mod03CellTemp01
      data C: sw-calibration-access=READ-ONLY, type=Signal_UInt8Id
    VIpm_Mod03CellTemp02
      data C: sw-calibration-access=READ-ONLY, type=Signal_UInt8Id
    VIpm_Mod03CellTemp03
      data C: sw-calibration-access=READ-ONLY, type=Signal_UInt8Id
    VIpm_Mod03CellTemp04
      data C: sw-calibration-access=READ-ONLY, type=Signal_UInt8Id
    VIpm_Mod03CellTemp05
      data C: sw-calibration-access=READ-ONLY, type=Signal_UInt8Id
    VIpm_Mod04CellTemp00
      data C: sw-calibration-access=READ-ONLY, type=Signal_UInt8Id
    VIpm_Mod04CellTemp01
      data C: sw-calibration-access=READ-ONLY, type=Signal_UInt8Id
    VIpm_Mod04CellTemp02
      data C: sw-calibration-access=READ-ONLY, type=Signal_UInt8Id
    VIpm_Mod04CellTemp03
      data C: sw-calibration-access=READ-ONLY, type=Signal_UInt8Id
    VIpm_Mod04CellTemp04
      data C: sw-calibration-access=READ-ONLY, type=Signal_UInt8Id
    VIpm_Mod04CellTemp05
      data C: sw-calibration-access=READ-ONLY, type=Signal_UInt8Id
    VIpm_Mod05CellTemp00
      data C: sw-calibration-access=READ-ONLY, type=Signal_UInt8Id
    VIpm_Mod05CellTemp01
      data C: sw-calibration-access=READ-ONLY, type=Signal_UInt8Id
    VIpm_Mod05CellTemp02
      data C: sw-calibration-access=READ-ONLY, type=Signal_UInt8Id
    VIpm_Mod05CellTemp03
      data C: sw-calibration-access=READ-ONLY, type=Signal_UInt8Id
    VIpm_Mod05CellTemp04
      data C: sw-calibration-access=READ-ONLY, type=Signal_UInt8Id
    VIpm_Mod05CellTemp05
      data C: sw-calibration-access=READ-ONLY, type=Signal_UInt8Id
    VIpm_Mod00CellVolt00
      data V: sw-calibration-access=READ-ONLY, type=Signal_UInt16Id
    VIpm_Mod00CellVolt01
      data V: sw-calibration-access=READ-ONLY, type=Signal_UInt16Id
    VIpm_Mod00CellVolt02
      data V: sw-calibration-access=READ-ONLY, type=Signal_UInt16Id
    VIpm_Mod00CellVolt03
      data V: sw-calibration-access=READ-ONLY, type=Signal_UInt16Id
    VIpm_Mod00CellVolt04
      data V: sw-calibration-access=READ-ONLY, type=Signal_UInt16Id
    VIpm_Mod00CellVolt05
      data V: sw-calibration-access=READ-ONLY, type=Signal_UInt16Id
    VIpm_Mod00CellVolt06
      data V: sw-calibration-access=READ-ONLY, type=Signal_UInt16Id
    VIpm_Mod00CellVolt07
      data V: sw-calibration-access=READ-ONLY, type=Signal_UInt16Id
    VIpm_Mod00CellVolt08
      data V: sw-calibration-access=READ-ONLY, type=Signal_UInt16Id
    VIpm_Mod00CellVolt09
      data V: sw-calibration-access=READ-ONLY, type=Signal_UInt16Id
    VIpm_Mod00CellVolt10
      data V: sw-calibration-access=READ-ONLY, type=Signal_UInt16Id
    VIpm_Mod00CellVolt11
      data V: sw-calibration-access=READ-ONLY, type=Signal_UInt16Id
    VIpm_Mod00CellVolt12
      data V: sw-calibration-access=READ-ONLY, type=Signal_UInt16Id
    VIpm_Mod00CellVolt13
      data V: sw-calibration-access=READ-ONLY, type=Signal_UInt16Id
    VIpm_Mod00CellVolt14
      data V: sw-calibration-access=READ-ONLY, type=Signal_UInt16Id
    VIpm_Mod00CellVolt15
      data V: sw-calibration-access=READ-ONLY, type=Signal_UInt16Id
    VIpm_Mod01CellVolt00
      data V: sw-calibration-access=READ-ONLY, type=Signal_UInt16Id
    VIpm_Mod01CellVolt01
      data V: sw-calibration-access=READ-ONLY, type=Signal_UInt16Id
    VIpm_Mod01CellVolt02
      data V: sw-calibration-access=READ-ONLY, type=Signal_UInt16Id
    VIpm_Mod01CellVolt03
      data V: sw-calibration-access=READ-ONLY, type=Signal_UInt16Id
    VIpm_Mod01CellVolt04
      data V: sw-calibration-access=READ-ONLY, type=Signal_UInt16Id
    VIpm_Mod01CellVolt05
      data V: sw-calibration-access=READ-ONLY, type=Signal_UInt16Id
    VIpm_Mod01CellVolt06
      data V: sw-calibration-access=READ-ONLY, type=Signal_UInt16Id
    VIpm_Mod01CellVolt07
      data V: sw-calibration-access=READ-ONLY, type=Signal_UInt16Id
    VIpm_Mod01CellVolt08
      data V: sw-calibration-access=READ-ONLY, type=Signal_UInt16Id
    VIpm_Mod01CellVolt09
      data V: sw-calibration-access=READ-ONLY, type=Signal_UInt16Id
    VIpm_Mod01CellVolt10
      data V: sw-calibration-access=READ-ONLY, type=Signal_UInt16Id
    VIpm_Mod01CellVolt11
      data V: sw-calibration-access=READ-ONLY, type=Signal_UInt16Id
    VIpm_Mod01CellVolt12
      data V: sw-calibration-access=READ-ONLY, type=Signal_UInt16Id
    VIpm_Mod01CellVolt13
      data V: sw-calibration-access=READ-ONLY, type=Signal_UInt16Id
    VIpm_Mod01CellVolt14
      data V: sw-calibration-access=READ-ONLY, type=Signal_UInt16Id
    VIpm_Mod01CellVolt15
      data V: sw-calibration-access=READ-ONLY, type=Signal_UInt16Id
    VIpm_Mod02CellVolt00
      data V: sw-calibration-access=READ-ONLY, type=Signal_UInt16Id
    VIpm_Mod02CellVolt01
      data V: sw-calibration-access=READ-ONLY, type=Signal_UInt16Id
    VIpm_Mod02CellVolt02
      data V: sw-calibration-access=READ-ONLY, type=Signal_UInt16Id
    VIpm_Mod02CellVolt03
      data V: sw-calibration-access=READ-ONLY, type=Signal_UInt16Id
    VIpm_Mod02CellVolt04
      data V: sw-calibration-access=READ-ONLY, type=Signal_UInt16Id
    VIpm_Mod02CellVolt05
      data V: sw-calibration-access=READ-ONLY, type=Signal_UInt16Id
    VIpm_Mod02CellVolt06
      data V: sw-calibration-access=READ-ONLY, type=Signal_UInt16Id
    VIpm_Mod02CellVolt07
      data V: sw-calibration-access=READ-ONLY, type=Signal_UInt16Id
    VIpm_Mod02CellVolt08
      data V: sw-calibration-access=READ-ONLY, type=Signal_UInt16Id
    VIpm_Mod02CellVolt09
      data V: sw-calibration-access=READ-ONLY, type=Signal_UInt16Id
    VIpm_Mod02CellVolt10
      data V: sw-calibration-access=READ-ONLY, type=Signal_UInt16Id
    VIpm_Mod02CellVolt11
      data V: sw-calibration-access=READ-ONLY, type=Signal_UInt16Id
    VIpm_Mod02CellVolt12
      data V: sw-calibration-access=READ-ONLY, type=Signal_UInt16Id
    VIpm_Mod02CellVolt13
      data V: sw-calibration-access=READ-ONLY, type=Signal_UInt16Id
    VIpm_Mod02CellVolt14
      data V: sw-calibration-access=READ-ONLY, type=Signal_UInt16Id
    VIpm_Mod02CellVolt15
      data V: sw-calibration-access=READ-ONLY, type=Signal_UInt16Id
    VIpm_Mod03CellVolt00
      data V: sw-calibration-access=READ-ONLY, type=Signal_UInt16Id
    VIpm_Mod03CellVolt01
      data V: sw-calibration-access=READ-ONLY, type=Signal_UInt16Id
    VIpm_Mod03CellVolt02
      data V: sw-calibration-access=READ-ONLY, type=Signal_UInt16Id
    VIpm_Mod03CellVolt03
      data V: sw-calibration-access=READ-ONLY, type=Signal_UInt16Id
    VIpm_Mod03CellVolt04
      data V: sw-calibration-access=READ-ONLY, type=Signal_UInt16Id
    VIpm_Mod03CellVolt05
      data V: sw-calibration-access=READ-ONLY, type=Signal_UInt16Id
    VIpm_Mod03CellVolt06
      data V: sw-calibration-access=READ-ONLY, type=Signal_UInt16Id
    VIpm_Mod03CellVolt07
      data V: sw-calibration-access=READ-ONLY, type=Signal_UInt16Id
    VIpm_Mod03CellVolt08
      data V: sw-calibration-access=READ-ONLY, type=Signal_UInt16Id
    VIpm_Mod03CellVolt09
      data V: sw-calibration-access=READ-ONLY, type=Signal_UInt16Id
    VIpm_Mod03CellVolt10
      data V: sw-calibration-access=READ-ONLY, type=Signal_UInt16Id
    VIpm_Mod03CellVolt11
      data V: sw-calibration-access=READ-ONLY, type=Signal_UInt16Id
    VIpm_Mod03CellVolt12
      data V: sw-calibration-access=READ-ONLY, type=Signal_UInt16Id
    VIpm_Mod03CellVolt13
      data V: sw-calibration-access=READ-ONLY, type=Signal_UInt16Id
    VIpm_Mod03CellVolt14
      data V: sw-calibration-access=READ-ONLY, type=Signal_UInt16Id
    VIpm_Mod03CellVolt15
      data V: sw-calibration-access=READ-ONLY, type=Signal_UInt16Id
    VIpm_Mod04CellVolt00
      data V: sw-calibration-access=READ-ONLY, type=Signal_UInt16Id
    VIpm_Mod04CellVolt01
      data V: sw-calibration-access=READ-ONLY, type=Signal_UInt16Id
    VIpm_Mod04CellVolt02
      data V: sw-calibration-access=READ-ONLY, type=Signal_UInt16Id
    VIpm_Mod04CellVolt03
      data V: sw-calibration-access=READ-ONLY, type=Signal_UInt16Id
    VIpm_Mod04CellVolt04
      data V: sw-calibration-access=READ-ONLY, type=Signal_UInt16Id
    VIpm_Mod04CellVolt05
      data V: sw-calibration-access=READ-ONLY, type=Signal_UInt16Id
    VIpm_Mod04CellVolt06
      data V: sw-calibration-access=READ-ONLY, type=Signal_UInt16Id
    VIpm_Mod04CellVolt07
      data V: sw-calibration-access=READ-ONLY, type=Signal_UInt16Id
    VIpm_Mod04CellVolt08
      data V: sw-calibration-access=READ-ONLY, type=Signal_UInt16Id
    VIpm_Mod04CellVolt09
      data V: sw-calibration-access=READ-ONLY, type=Signal_UInt16Id
    VIpm_Mod04CellVolt10
      data V: sw-calibration-access=READ-ONLY, type=Signal_UInt16Id
    VIpm_Mod04CellVolt11
      data V: sw-calibration-access=READ-ONLY, type=Signal_UInt16Id
    VIpm_Mod04CellVolt12
      data V: sw-calibration-access=READ-ONLY, type=Signal_UInt16Id
    VIpm_Mod04CellVolt13
      data V: sw-calibration-access=READ-ONLY, type=Signal_UInt16Id
    VIpm_Mod04CellVolt14
      data V: sw-calibration-access=READ-ONLY, type=Signal_UInt16Id
    VIpm_Mod04CellVolt15
      data V: sw-calibration-access=READ-ONLY, type=Signal_UInt16Id
    VIpm_Mod05CellVolt00
      data V: sw-calibration-access=READ-ONLY, type=Signal_UInt16Id
    VIpm_Mod05CellVolt01
      data V: sw-calibration-access=READ-ONLY, type=Signal_UInt16Id
    VIpm_Mod05CellVolt02
      data V: sw-calibration-access=READ-ONLY, type=Signal_UInt16Id
    VIpm_Mod05CellVolt03
      data V: sw-calibration-access=READ-ONLY, type=Signal_UInt16Id
    VIpm_Mod05CellVolt04
      data V: sw-calibration-access=READ-ONLY, type=Signal_UInt16Id
    VIpm_Mod05CellVolt05
      data V: sw-calibration-access=READ-ONLY, type=Signal_UInt16Id
    VIpm_Mod05CellVolt06
      data V: sw-calibration-access=READ-ONLY, type=Signal_UInt16Id
    VIpm_Mod05CellVolt07
      data V: sw-calibration-access=READ-ONLY, type=Signal_UInt16Id
    VIpm_Mod05CellVolt08
      data V: sw-calibration-access=READ-ONLY, type=Signal_UInt16Id
    VIpm_Mod05CellVolt09
      data V: sw-calibration-access=READ-ONLY, type=Signal_UInt16Id
    VIpm_Mod05CellVolt10
      data V: sw-calibration-access=READ-ONLY, type=Signal_UInt16Id
    VIpm_Mod05CellVolt11
      data V: sw-calibration-access=READ-ONLY, type=Signal_UInt16Id
    VIpm_Mod05CellVolt12
      data V: sw-calibration-access=READ-ONLY, type=Signal_UInt16Id
    VIpm_Mod05CellVolt13
      data V: sw-calibration-access=READ-ONLY, type=Signal_UInt16Id
    VIpm_Mod05CellVolt14
      data V: sw-calibration-access=READ-ONLY, type=Signal_UInt16Id
    VIpm_Mod05CellVolt15
      data V: sw-calibration-access=READ-ONLY, type=Signal_UInt16Id
    VIpm_Rcv0x500
      data Flg: sw-calibration-access=READ-ONLY, type=Boolean
    VIpm_Rcv0x501
      data Flg: sw-calibration-access=READ-ONLY, type=Boolean
    VIpm_Rcv0x502
      data Flg: sw-calibration-access=READ-ONLY, type=Boolean
    VIpm_Rcv0x503
      data Flg: sw-calibration-access=READ-ONLY, type=Boolean
    VIpm_Rcv0x504
      data Flg: sw-calibration-access=READ-ONLY, type=Boolean
    VIpm_Rcv0x505
      data Flg: sw-calibration-access=READ-ONLY, type=Boolean
    VIpm_Rcv0x400
      data Flg: sw-calibration-access=READ-ONLY, type=Boolean
    VIpm_Rcv0x410
      data Flg: sw-calibration-access=READ-ONLY, type=Boolean
    VIpm_Rcv0x420
      data Flg: sw-calibration-access=READ-ONLY, type=Boolean
    VIpm_Rcv0x430
      data Flg: sw-calibration-access=READ-ONLY, type=Boolean
    VIpm_Rcv0x401
      data Flg: sw-calibration-access=READ-ONLY, type=Boolean
    VIpm_Rcv0x411
      data Flg: sw-calibration-access=READ-ONLY, type=Boolean
    VIpm_Rcv0x421
      data Flg: sw-calibration-access=READ-ONLY, type=Boolean
    VIpm_Rcv0x431
      data Flg: sw-calibration-access=READ-ONLY, type=Boolean
    VIpm_Rcv0x402
      data Flg: sw-calibration-access=READ-ONLY, type=Boolean
    VIpm_Rcv0x412
      data Flg: sw-calibration-access=READ-ONLY, type=Boolean
    VIpm_Rcv0x422
      data Flg: sw-calibration-access=READ-ONLY, type=Boolean
    VIpm_Rcv0x432
      data Flg: sw-calibration-access=READ-ONLY, type=Boolean
    VIpm_Rcv0x403
      data Flg: sw-calibration-access=READ-ONLY, type=Boolean
    VIpm_Rcv0x413
      data Flg: sw-calibration-access=READ-ONLY, type=Boolean
    VIpm_Rcv0x423
      data Flg: sw-calibration-access=READ-ONLY, type=Boolean
    VIpm_Rcv0x433
      data Flg: sw-calibration-access=READ-ONLY, type=Boolean
    VIpm_Rcv0x404
      data Flg: sw-calibration-access=READ-ONLY, type=Boolean
    VIpm_Rcv0x414
      data Flg: sw-calibration-access=READ-ONLY, type=Boolean
    VIpm_Rcv0x424
      data Flg: sw-calibration-access=READ-ONLY, type=Boolean
    VIpm_Rcv0x434
      data Flg: sw-calibration-access=READ-ONLY, type=Boolean
    VIpm_Rcv0x405
      data Flg: sw-calibration-access=READ-ONLY, type=Boolean
    VIpm_Rcv0x415
      data Flg: sw-calibration-access=READ-ONLY, type=Boolean
    VIpm_Rcv0x425
      data Flg: sw-calibration-access=READ-ONLY, type=Boolean
    VIpm_Rcv0x435
      data Flg: sw-calibration-access=READ-ONLY, type=Boolean
    VBmm_WakeOnChrgrStep
      data Enum: sw-calibration-access=READ-ONLY, type=UInt8
    VTMod_CellTempMax
      data C: sw-calibration-access=READ-ONLY, type=Signal_Float
    VTMod_DebugInfo
      data Array: sw-calibration-access=READ-ONLY, type=rt_Array_UInt8_8
    VDsp_OnChgRmTime
      data Sec: sw-calibration-access=READ-ONLY, type=Signal_Float
    VDsp_DebugInfo
      data Array: sw-calibration-access=READ-ONLY, type=rt_Array_UInt8_8
  client server interface VFpm_ReadSysFltInd
    operation ReadSysFlt
      arg ID: type=UInt8, direction=IN
      arg Status: type=UInt8, direction=OUT
  client server interface VFpm_ReadAppFltInd
    operation ReadAppFlt
      arg ID: type=UInt8, direction=IN
      arg Status: type=UInt8, direction=OUT

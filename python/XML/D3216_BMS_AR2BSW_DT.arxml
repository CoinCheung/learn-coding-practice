AUTOSAR XML (schema 4-0-3)
standard types defined: Boolean, Double, Float, UInt8, SInt16, SInt32, SInt8, UInt16, UInt32, boolean, float32, float64, sint16, sint32, sint8, uint16, uint32, uint8
package /DT/ImplementType
  39 x impl type:
    rt_Array_Float_250x6: category=ARRAY
      element rt_Array_Float_250: category=ARRAY, array-size=250
        element Float: array-size=6, implementation-data-type=Float
    rt_Array_Float_50x3: category=ARRAY
      element rt_Array_Float_50: category=ARRAY, array-size=50
        element Float: array-size=3, implementation-data-type=Float
    rt_Array_Boolean_100: category=ARRAY
      element rt_Array_Boolean_100: array-size=100, array-size-semantics=FIXED-SIZE, implementation-data-type=Boolean
    rt_Array_Float_100: category=ARRAY
      element rt_Array_Float_100: array-size=100, array-size-semantics=FIXED-SIZE, implementation-data-type=Float
    rt_Array_UInt8_8: category=ARRAY
      element rt_Array_UInt8_8: array-size=8, array-size-semantics=FIXED-SIZE, implementation-data-type=UInt8
    rt_Array_UInt16_6: category=ARRAY
      element rt_Array_UInt16_6: array-size=6, array-size-semantics=FIXED-SIZE, implementation-data-type=UInt16
    rt_Array_UInt8_50: category=ARRAY
      element rt_Array_UInt8_50: array-size=50, implementation-data-type=UInt8
    rt_Array_UInt8_400: category=ARRAY
      element rt_Array_UInt8_400: array-size=400, implementation-data-type=UInt8
    rt_Array_Double_100: category=ARRAY
      element rt_Array_Double_100: array-size=100, implementation-data-type=Double
    rt_Array_Float_110: category=ARRAY
      element rt_Array_Float_110: array-size=110, implementation-data-type=Float
    rt_Array_Float_10: category=ARRAY
      element rt_Array_Float_10: array-size=10, implementation-data-type=Float
    rt_Array_Float_11: category=ARRAY
      element rt_Array_Float_11: array-size=11, implementation-data-type=Float
    Sig_CAN: category=STRUCTURE
      4 x element, all with category=TYPE_REFERENCE:
        Val: implementation-data-type=Float
        IsValid: implementation-data-type=Boolean
        IsNoVal: implementation-data-type=Boolean
        IsErrVal: implementation-data-type=Boolean
    Signal_Float: category=STRUCTURE
      4 x element, all with category=TYPE_REFERENCE:
        Value: implementation-data-type=Float
        IsValid: implementation-data-type=Boolean
        IsErrValue: implementation-data-type=Boolean
        IsNoValue: implementation-data-type=Boolean
    Signal_Uint: category=STRUCTURE
      4 x element, all with category=TYPE_REFERENCE:
        Value: implementation-data-type=UInt32
        IsValid: implementation-data-type=Boolean
        IsErrValue: implementation-data-type=Boolean
        IsNoValue: implementation-data-type=Boolean
    Signal_AI: category=STRUCTURE
      5 x element, all with category=TYPE_REFERENCE:
        RawValue: implementation-data-type=Float
        EngValue: implementation-data-type=Float
        IsValid: implementation-data-type=Boolean
        IsOorH: implementation-data-type=Boolean
        IsOorL: implementation-data-type=Boolean
    Signal_Double: category=STRUCTURE
      4 x element, all with category=TYPE_REFERENCE:
        Value: implementation-data-type=Double
        IsValid: implementation-data-type=Boolean
        IsErrValue: implementation-data-type=Boolean
        IsNoValue: implementation-data-type=Boolean
    rt_Array_Float_9: category=ARRAY
      element rt_Array_Float_9: array-size=9, implementation-data-type=Float
    rt_Array_Float_21: category=ARRAY
      element rt_Array_Float_21: array-size=21, implementation-data-type=Float
    rt_Array_Float_6: category=ARRAY
      element rt_Array_Float_6: array-size=6, implementation-data-type=Float
    rt_Array_Float_9x21: category=ARRAY
      element rt_Array_Float_21: category=ARRAY, array-size=9, implementation-data-type=Float
        element Float: array-size=21, implementation-data-type=Float
    rt_Array_UInt8_200: category=ARRAY
      element rt_Array_UInt8_200: array-size=200, implementation-data-type=UInt8
    rt_Array_Float_11x10: category=ARRAY
      element rt_Array_Float_11: category=ARRAY, array-size=11, implementation-data-type=Float
        element Float: array-size=10, implementation-data-type=Float
    rt_Array_UInt16_15: category=ARRAY
      element rt_Array_UInt16_15: array-size=15, array-size-semantics=FIXED-SIZE, implementation-data-type=UInt16
    rt_Array_Float_2: category=ARRAY
      element rt_Array_Float_2: array-size=2, implementation-data-type=Float
    rt_Array_UInt8_7: category=ARRAY
      element rt_Array_UInt8_7: array-size=7, array-size-semantics=FIXED-SIZE, implementation-data-type=UInt8
    Ovrd_Float: category=STRUCTURE
      element Value: implementation-data-type=Float
      element IsValid: implementation-data-type=Boolean
    rt_Array_Float_3: category=ARRAY
      element rt_Array_Float_3: array-size=3, implementation-data-type=Float
    Ovrd_Uint: category=STRUCTURE
      element Value: implementation-data-type=UInt32
      element IsValid: implementation-data-type=Boolean
    rt_Array_Float_20: category=ARRAY
      element rt_Array_Float_20: array-size=20, implementation-data-type=Float
    rt_Array_Float_10x10: category=ARRAY
      element rt_Array_Float_10: category=ARRAY, array-size=10, implementation-data-type=Float
        element Float: array-size=10, implementation-data-type=Float
    rt_Array_Float_2x20: category=ARRAY
      element rt_Array_Float_2: category=ARRAY, array-size=2, implementation-data-type=Float
        element Float: array-size=20, implementation-data-type=Float
    rt_Array_UInt8_2: category=ARRAY
      element rt_Array_UInt8_2: array-size=2, array-size-semantics=FIXED-SIZE, implementation-data-type=UInt8
    rt_Array_UInt8_6: category=ARRAY
      element rt_Array_UInt8_6: array-size=6, array-size-semantics=FIXED-SIZE, implementation-data-type=UInt8
    rt_Array_Float_400x6: category=ARRAY
      element rt_Array_Float_400: category=ARRAY, array-size=400
        element Float: array-size=6, implementation-data-type=SInt16
    rt_Array_Float_2x6: category=ARRAY
      element rt_Array_Float_2: category=ARRAY, array-size=2, implementation-data-type=Float
        element Float: array-size=6, implementation-data-type=Float
    rt_Array_UInt8_32: category=ARRAY
      element rt_Array_UInt8_32: array-size=32, array-size-semantics=FIXED-SIZE, implementation-data-type=UInt8
    Signal_UInt16Id: category=STRUCTURE
      element Value: implementation-data-type=UInt16
      element ValueId: implementation-data-type=UInt8
      element IsValid: implementation-data-type=Boolean
    Signal_UInt8Id: category=STRUCTURE
      element Value: implementation-data-type=UInt8
      element ValueId: implementation-data-type=UInt8
      element IsValid: implementation-data-type=Boolean
package /DT/ImplementType/Ground
  345 x constant specification:
    DefaultInitValue_Boolean: value-spec=false
    DefaultInitValue_Double: value-spec=0
    DefaultInitValue_Float: value-spec=0
    DefaultInitValue_rt_Array_Boolean_100: value-spec=[{short-label=DefaultInitValue_rt_Array_Boolean_100_rt_Array_Boolean_100_1, constant=DefaultInitValue_Boolean}, {short-label=DefaultInitValue_rt_Array_Boolean_100_rt_Array_Boolean_100_2, constant=DefaultInitValue_Boolean}, {short-label=DefaultInitValue_rt_Array_Boolean_100_rt_Array_Boolean_100_3, constant=DefaultInitValue_Boolean}, {short-label=DefaultInitValue_rt_Array_Boolean_100_rt_Array_Boolean_100_4, constant=DefaultInitValue_Boolean}, {short-label=DefaultInitValue_rt_Array_Boolean_100_rt_Array_Boolean_100_5, constant=DefaultInitValue_Boolean}, {short-label=DefaultInitValue_rt_Array_Boolean_100_rt_Array_Boolean_100_6, constant=DefaultInitValue_Boolean}, {short-label=DefaultInitValue_rt_Array_Boolean_100_rt_Array_Boolean_100_7, constant=DefaultInitValue_Boolean}, {short-label=DefaultInitValue_rt_Array_Boolean_100_rt_Array_Boolean_100_8, constant=DefaultInitValue_Boolean}, {short-label=DefaultInitValue_rt_Array_Boolean_100_rt_Array_Boolean_100_9, constant=DefaultInitValue_Boolean}, {short-label=DefaultInitValue_rt_Array_Boolean_100_rt_Array_Boolean_100_10, constant=DefaultInitValue_Boolean}, {short-label=DefaultInitValue_rt_Array_Boolean_100_rt_Array_Boolean_100_11, constant=DefaultInitValue_Boolean}, {short-label=DefaultInitValue_rt_Array_Boolean_100_rt_Array_Boolean_100_12, constant=DefaultInitValue_Boolean}, {short-label=DefaultInitValue_rt_Array_Boolean_100_rt_Array_Boolean_100_13, constant=DefaultInitValue_Boolean}, {short-label=DefaultInitValue_rt_Array_Boolean_100_rt_Array_Boolean_100_14, constant=DefaultInitValue_Boolean}, {short-label=DefaultInitValue_rt_Array_Boolean_100_rt_Array_Boolean_100_15, constant=DefaultInitValue_Boolean}, {short-label=DefaultInitValue_rt_Array_Boolean_100_rt_Array_Boolean_100_16, constant=DefaultInitValue_Boolean}, {short-label=DefaultInitValue_rt_Array_Boolean_100_rt_Array_Boolean_100_17, constant=DefaultInitValue_Boolean}, {short-label=DefaultInitValue_rt_Array_Boolean_100_rt_Array_Boolean_100_18, constant=DefaultInitValue_Boolean}, {short-label=DefaultInitValue_rt_Array_Boolean_100_rt_Array_Boolean_100_19, constant=DefaultInitValue_Boolean}, {short-label=DefaultInitValue_rt_Array_Boolean_100_rt_Array_Boolean_100_20, constant=DefaultInitValue_Boolean}, {short-label=DefaultInitValue_rt_Array_Boolean_100_rt_Array_Boolean_100_21, constant=DefaultInitValue_Boolean}, {short-label=DefaultInitValue_rt_Array_Boolean_100_rt_Array_Boolean_100_22, constant=DefaultInitValue_Boolean}, {short-label=DefaultInitValue_rt_Array_Boolean_100_rt_Array_Boolean_100_23, constant=DefaultInitValue_Boolean}, {short-label=DefaultInitValue_rt_Array_Boolean_100_rt_Array_Boolean_100_24, constant=DefaultInitValue_Boolean}, {short-label=DefaultInitValue_rt_Array_Boolean_100_rt_Array_Boolean_100_25, constant=DefaultInitValue_Boolean}, {short-label=DefaultInitValue_rt_Array_Boolean_100_rt_Array_Boolean_100_26, constant=DefaultInitValue_Boolean}, {short-label=DefaultInitValue_rt_Array_Boolean_100_rt_Array_Boolean_100_27, constant=DefaultInitValue_Boolean}, {short-label=DefaultInitValue_rt_Array_Boolean_100_rt_Array_Boolean_100_28, constant=DefaultInitValue_Boolean}, {short-label=DefaultInitValue_rt_Array_Boolean_100_rt_Array_Boolean_100_29, constant=DefaultInitValue_Boolean}, {short-label=DefaultInitValue_rt_Array_Boolean_100_rt_Array_Boolean_100_30, constant=DefaultInitValue_Boolean}, {short-label=DefaultInitValue_rt_Array_Boolean_100_rt_Array_Boolean_100_31, constant=DefaultInitValue_Boolean}, {short-label=DefaultInitValue_rt_Array_Boolean_100_rt_Array_Boolean_100_32, constant=DefaultInitValue_Boolean}, {short-label=DefaultInitValue_rt_Array_Boolean_100_rt_Array_Boolean_100_33, constant=DefaultInitValue_Boolean}, {short-label=DefaultInitValue_rt_Array_Boolean_100_rt_Array_Boolean_100_34, constant=DefaultInitValue_Boolean}, {short-label=DefaultInitValue_rt_Array_Boolean_100_rt_Array_Boolean_100_35, constant=DefaultInitValue_Boolean}, {short-label=DefaultInitValue_rt_Array_Boolean_100_rt_Array_Boolean_100_36, constant=DefaultInitValue_Boolean}, {short-label=DefaultInitValue_rt_Array_Boolean_100_rt_Array_Boolean_100_37, constant=DefaultInitValue_Boolean}, {short-label=DefaultInitValue_rt_Array_Boolean_100_rt_Array_Boolean_100_38, constant=DefaultInitValue_Boolean}, {short-label=DefaultInitValue_rt_Array_Boolean_100_rt_Array_Boolean_100_39, constant=DefaultInitValue_Boolean}, {short-label=DefaultInitValue_rt_Array_Boolean_100_rt_Array_Boolean_100_40, constant=DefaultInitValue_Boolean}, {short-label=DefaultInitValue_rt_Array_Boolean_100_rt_Array_Boolean_100_41, constant=DefaultInitValue_Boolean}, {short-label=DefaultInitValue_rt_Array_Boolean_100_rt_Array_Boolean_100_42, constant=DefaultInitValue_Boolean}, {short-label=DefaultInitValue_rt_Array_Boolean_100_rt_Array_Boolean_100_43, constant=DefaultInitValue_Boolean}, {short-label=DefaultInitValue_rt_Array_Boolean_100_rt_Array_Boolean_100_44, constant=DefaultInitValue_Boolean}, {short-label=DefaultInitValue_rt_Array_Boolean_100_rt_Array_Boolean_100_45, constant=DefaultInitValue_Boolean}, {short-label=DefaultInitValue_rt_Array_Boolean_100_rt_Array_Boolean_100_46, constant=DefaultInitValue_Boolean}, {short-label=DefaultInitValue_rt_Array_Boolean_100_rt_Array_Boolean_100_47, constant=DefaultInitValue_Boolean}, {short-label=DefaultInitValue_rt_Array_Boolean_100_rt_Array_Boolean_100_48, constant=DefaultInitValue_Boolean}, {short-label=DefaultInitValue_rt_Array_Boolean_100_rt_Array_Boolean_100_49, constant=DefaultInitValue_Boolean}, {short-label=DefaultInitValue_rt_Array_Boolean_100_rt_Array_Boolean_100_50, constant=DefaultInitValue_Boolean}, {short-label=DefaultInitValue_rt_Array_Boolean_100_rt_Array_Boolean_100_51, constant=DefaultInitValue_Boolean}, {short-label=DefaultInitValue_rt_Array_Boolean_100_rt_Array_Boolean_100_52, constant=DefaultInitValue_Boolean}, {short-label=DefaultInitValue_rt_Array_Boolean_100_rt_Array_Boolean_100_53, constant=DefaultInitValue_Boolean}, {short-label=DefaultInitValue_rt_Array_Boolean_100_rt_Array_Boolean_100_54, constant=DefaultInitValue_Boolean}, {short-label=DefaultInitValue_rt_Array_Boolean_100_rt_Array_Boolean_100_55, constant=DefaultInitValue_Boolean}, {short-label=DefaultInitValue_rt_Array_Boolean_100_rt_Array_Boolean_100_56, constant=DefaultInitValue_Boolean}, {short-label=DefaultInitValue_rt_Array_Boolean_100_rt_Array_Boolean_100_57, constant=DefaultInitValue_Boolean}, {short-label=DefaultInitValue_rt_Array_Boolean_100_rt_Array_Boolean_100_58, constant=DefaultInitValue_Boolean}, {short-label=DefaultInitValue_rt_Array_Boolean_100_rt_Array_Boolean_100_59, constant=DefaultInitValue_Boolean}, {short-label=DefaultInitValue_rt_Array_Boolean_100_rt_Array_Boolean_100_60, constant=DefaultInitValue_Boolean}, {short-label=DefaultInitValue_rt_Array_Boolean_100_rt_Array_Boolean_100_61, constant=DefaultInitValue_Boolean}, {short-label=DefaultInitValue_rt_Array_Boolean_100_rt_Array_Boolean_100_62, constant=DefaultInitValue_Boolean}, {short-label=DefaultInitValue_rt_Array_Boolean_100_rt_Array_Boolean_100_63, constant=DefaultInitValue_Boolean}, {short-label=DefaultInitValue_rt_Array_Boolean_100_rt_Array_Boolean_100_64, constant=DefaultInitValue_Boolean}, {short-label=DefaultInitValue_rt_Array_Boolean_100_rt_Array_Boolean_100_65, constant=DefaultInitValue_Boolean}, {short-label=DefaultInitValue_rt_Array_Boolean_100_rt_Array_Boolean_100_66, constant=DefaultInitValue_Boolean}, {short-label=DefaultInitValue_rt_Array_Boolean_100_rt_Array_Boolean_100_67, constant=DefaultInitValue_Boolean}, {short-label=DefaultInitValue_rt_Array_Boolean_100_rt_Array_Boolean_100_68, constant=DefaultInitValue_Boolean}, {short-label=DefaultInitValue_rt_Array_Boolean_100_rt_Array_Boolean_100_69, constant=DefaultInitValue_Boolean}, {short-label=DefaultInitValue_rt_Array_Boolean_100_rt_Array_Boolean_100_70, constant=DefaultInitValue_Boolean}, {short-label=DefaultInitValue_rt_Array_Boolean_100_rt_Array_Boolean_100_71, constant=DefaultInitValue_Boolean}, {short-label=DefaultInitValue_rt_Array_Boolean_100_rt_Array_Boolean_100_72, constant=DefaultInitValue_Boolean}, {short-label=DefaultInitValue_rt_Array_Boolean_100_rt_Array_Boolean_100_73, constant=DefaultInitValue_Boolean}, {short-label=DefaultInitValue_rt_Array_Boolean_100_rt_Array_Boolean_100_74, constant=DefaultInitValue_Boolean}, {short-label=DefaultInitValue_rt_Array_Boolean_100_rt_Array_Boolean_100_75, constant=DefaultInitValue_Boolean}, {short-label=DefaultInitValue_rt_Array_Boolean_100_rt_Array_Boolean_100_76, constant=DefaultInitValue_Boolean}, {short-label=DefaultInitValue_rt_Array_Boolean_100_rt_Array_Boolean_100_77, constant=DefaultInitValue_Boolean}, {short-label=DefaultInitValue_rt_Array_Boolean_100_rt_Array_Boolean_100_78, constant=DefaultInitValue_Boolean}, {short-label=DefaultInitValue_rt_Array_Boolean_100_rt_Array_Boolean_100_79, constant=DefaultInitValue_Boolean}, {short-label=DefaultInitValue_rt_Array_Boolean_100_rt_Array_Boolean_100_80, constant=DefaultInitValue_Boolean}, {short-label=DefaultInitValue_rt_Array_Boolean_100_rt_Array_Boolean_100_81, constant=DefaultInitValue_Boolean}, {short-label=DefaultInitValue_rt_Array_Boolean_100_rt_Array_Boolean_100_82, constant=DefaultInitValue_Boolean}, {short-label=DefaultInitValue_rt_Array_Boolean_100_rt_Array_Boolean_100_83, constant=DefaultInitValue_Boolean}, {short-label=DefaultInitValue_rt_Array_Boolean_100_rt_Array_Boolean_100_84, constant=DefaultInitValue_Boolean}, {short-label=DefaultInitValue_rt_Array_Boolean_100_rt_Array_Boolean_100_85, constant=DefaultInitValue_Boolean}, {short-label=DefaultInitValue_rt_Array_Boolean_100_rt_Array_Boolean_100_86, constant=DefaultInitValue_Boolean}, {short-label=DefaultInitValue_rt_Array_Boolean_100_rt_Array_Boolean_100_87, constant=DefaultInitValue_Boolean}, {short-label=DefaultInitValue_rt_Array_Boolean_100_rt_Array_Boolean_100_88, constant=DefaultInitValue_Boolean}, {short-label=DefaultInitValue_rt_Array_Boolean_100_rt_Array_Boolean_100_89, constant=DefaultInitValue_Boolean}, {short-label=DefaultInitValue_rt_Array_Boolean_100_rt_Array_Boolean_100_90, constant=DefaultInitValue_Boolean}, {short-label=DefaultInitValue_rt_Array_Boolean_100_rt_Array_Boolean_100_91, constant=DefaultInitValue_Boolean}, {short-label=DefaultInitValue_rt_Array_Boolean_100_rt_Array_Boolean_100_92, constant=DefaultInitValue_Boolean}, {short-label=DefaultInitValue_rt_Array_Boolean_100_rt_Array_Boolean_100_93, constant=DefaultInitValue_Boolean}, {short-label=DefaultInitValue_rt_Array_Boolean_100_rt_Array_Boolean_100_94, constant=DefaultInitValue_Boolean}, {short-label=DefaultInitValue_rt_Array_Boolean_100_rt_Array_Boolean_100_95, constant=DefaultInitValue_Boolean}, {short-label=DefaultInitValue_rt_Array_Boolean_100_rt_Array_Boolean_100_96, constant=DefaultInitValue_Boolean}, {short-label=DefaultInitValue_rt_Array_Boolean_100_rt_Array_Boolean_100_97, constant=DefaultInitValue_Boolean}, {short-label=DefaultInitValue_rt_Array_Boolean_100_rt_Array_Boolean_100_98, constant=DefaultInitValue_Boolean}, {short-label=DefaultInitValue_rt_Array_Boolean_100_rt_Array_Boolean_100_99, constant=DefaultInitValue_Boolean}, {short-label=DefaultInitValue_rt_Array_Boolean_100_rt_Array_Boolean_100_100, constant=DefaultInitValue_Boolean}]
    DefaultInitValue_rt_Array_Float_100: value-spec=[{short-label=DefaultInitValue_rt_Array_Float_100_rt_Array_Float_100_1, constant=DefaultInitValue_Float}, {short-label=DefaultInitValue_rt_Array_Float_100_rt_Array_Float_100_2, constant=DefaultInitValue_Float}, {short-label=DefaultInitValue_rt_Array_Float_100_rt_Array_Float_100_3, constant=DefaultInitValue_Float}, {short-label=DefaultInitValue_rt_Array_Float_100_rt_Array_Float_100_4, constant=DefaultInitValue_Float}, {short-label=DefaultInitValue_rt_Array_Float_100_rt_Array_Float_100_5, constant=DefaultInitValue_Float}, {short-label=DefaultInitValue_rt_Array_Float_100_rt_Array_Float_100_6, constant=DefaultInitValue_Float}, {short-label=DefaultInitValue_rt_Array_Float_100_rt_Array_Float_100_7, constant=DefaultInitValue_Float}, {short-label=DefaultInitValue_rt_Array_Float_100_rt_Array_Float_100_8, constant=DefaultInitValue_Float}, {short-label=DefaultInitValue_rt_Array_Float_100_rt_Array_Float_100_9, constant=DefaultInitValue_Float}, {short-label=DefaultInitValue_rt_Array_Float_100_rt_Array_Float_100_10, constant=DefaultInitValue_Float}, {short-label=DefaultInitValue_rt_Array_Float_100_rt_Array_Float_100_11, constant=DefaultInitValue_Float}, {short-label=DefaultInitValue_rt_Array_Float_100_rt_Array_Float_100_12, constant=DefaultInitValue_Float}, {short-label=DefaultInitValue_rt_Array_Float_100_rt_Array_Float_100_13, constant=DefaultInitValue_Float}, {short-label=DefaultInitValue_rt_Array_Float_100_rt_Array_Float_100_14, constant=DefaultInitValue_Float}, {short-label=DefaultInitValue_rt_Array_Float_100_rt_Array_Float_100_15, constant=DefaultInitValue_Float}, {short-label=DefaultInitValue_rt_Array_Float_100_rt_Array_Float_100_16, constant=DefaultInitValue_Float}, {short-label=DefaultInitValue_rt_Array_Float_100_rt_Array_Float_100_17, constant=DefaultInitValue_Float}, {short-label=DefaultInitValue_rt_Array_Float_100_rt_Array_Float_100_18, constant=DefaultInitValue_Float}, {short-label=DefaultInitValue_rt_Array_Float_100_rt_Array_Float_100_19, constant=DefaultInitValue_Float}, {short-label=DefaultInitValue_rt_Array_Float_100_rt_Array_Float_100_20, constant=DefaultInitValue_Float}, {short-label=DefaultInitValue_rt_Array_Float_100_rt_Array_Float_100_21, constant=DefaultInitValue_Float}, {short-label=DefaultInitValue_rt_Array_Float_100_rt_Array_Float_100_22, constant=DefaultInitValue_Float}, {short-label=DefaultInitValue_rt_Array_Float_100_rt_Array_Float_100_23, constant=DefaultInitValue_Float}, {short-label=DefaultInitValue_rt_Array_Float_100_rt_Array_Float_100_24, constant=DefaultInitValue_Float}, {short-label=DefaultInitValue_rt_Array_Float_100_rt_Array_Float_100_25, constant=DefaultInitValue_Float}, {short-label=DefaultInitValue_rt_Array_Float_100_rt_Array_Float_100_26, constant=DefaultInitValue_Float}, {short-label=DefaultInitValue_rt_Array_Float_100_rt_Array_Float_100_27, constant=DefaultInitValue_Float}, {short-label=DefaultInitValue_rt_Array_Float_100_rt_Array_Float_100_28, constant=DefaultInitValue_Float}, {short-label=DefaultInitValue_rt_Array_Float_100_rt_Array_Float_100_29, constant=DefaultInitValue_Float}, {short-label=DefaultInitValue_rt_Array_Float_100_rt_Array_Float_100_30, constant=DefaultInitValue_Float}, {short-label=DefaultInitValue_rt_Array_Float_100_rt_Array_Float_100_31, constant=DefaultInitValue_Float}, {short-label=DefaultInitValue_rt_Array_Float_100_rt_Array_Float_100_32, constant=DefaultInitValue_Float}, {short-label=DefaultInitValue_rt_Array_Float_100_rt_Array_Float_100_33, constant=DefaultInitValue_Float}, {short-label=DefaultInitValue_rt_Array_Float_100_rt_Array_Float_100_34, constant=DefaultInitValue_Float}, {short-label=DefaultInitValue_rt_Array_Float_100_rt_Array_Float_100_35, constant=DefaultInitValue_Float}, {short-label=DefaultInitValue_rt_Array_Float_100_rt_Array_Float_100_36, constant=DefaultInitValue_Float}, {short-label=DefaultInitValue_rt_Array_Float_100_rt_Array_Float_100_37, constant=DefaultInitValue_Float}, {short-label=DefaultInitValue_rt_Array_Float_100_rt_Array_Float_100_38, constant=DefaultInitValue_Float}, {short-label=DefaultInitValue_rt_Array_Float_100_rt_Array_Float_100_39, constant=DefaultInitValue_Float}, {short-label=DefaultInitValue_rt_Array_Float_100_rt_Array_Float_100_40, constant=DefaultInitValue_Float}, {short-label=DefaultInitValue_rt_Array_Float_100_rt_Array_Float_100_41, constant=DefaultInitValue_Float}, {short-label=DefaultInitValue_rt_Array_Float_100_rt_Array_Float_100_42, constant=DefaultInitValue_Float}, {short-label=DefaultInitValue_rt_Array_Float_100_rt_Array_Float_100_43, constant=DefaultInitValue_Float}, {short-label=DefaultInitValue_rt_Array_Float_100_rt_Array_Float_100_44, constant=DefaultInitValue_Float}, {short-label=DefaultInitValue_rt_Array_Float_100_rt_Array_Float_100_45, constant=DefaultInitValue_Float}, {short-label=DefaultInitValue_rt_Array_Float_100_rt_Array_Float_100_46, constant=DefaultInitValue_Float}, {short-label=DefaultInitValue_rt_Array_Float_100_rt_Array_Float_100_47, constant=DefaultInitValue_Float}, {short-label=DefaultInitValue_rt_Array_Float_100_rt_Array_Float_100_48, constant=DefaultInitValue_Float}, {short-label=DefaultInitValue_rt_Array_Float_100_rt_Array_Float_100_49, constant=DefaultInitValue_Float}, {short-label=DefaultInitValue_rt_Array_Float_100_rt_Array_Float_100_50, constant=DefaultInitValue_Float}, {short-label=DefaultInitValue_rt_Array_Float_100_rt_Array_Float_100_51, constant=DefaultInitValue_Float}, {short-label=DefaultInitValue_rt_Array_Float_100_rt_Array_Float_100_52, constant=DefaultInitValue_Float}, {short-label=DefaultInitValue_rt_Array_Float_100_rt_Array_Float_100_53, constant=DefaultInitValue_Float}, {short-label=DefaultInitValue_rt_Array_Float_100_rt_Array_Float_100_54, constant=DefaultInitValue_Float}, {short-label=DefaultInitValue_rt_Array_Float_100_rt_Array_Float_100_55, constant=DefaultInitValue_Float}, {short-label=DefaultInitValue_rt_Array_Float_100_rt_Array_Float_100_56, constant=DefaultInitValue_Float}, {short-label=DefaultInitValue_rt_Array_Float_100_rt_Array_Float_100_57, constant=DefaultInitValue_Float}, {short-label=DefaultInitValue_rt_Array_Float_100_rt_Array_Float_100_58, constant=DefaultInitValue_Float}, {short-label=DefaultInitValue_rt_Array_Float_100_rt_Array_Float_100_59, constant=DefaultInitValue_Float}, {short-label=DefaultInitValue_rt_Array_Float_100_rt_Array_Float_100_60, constant=DefaultInitValue_Float}, {short-label=DefaultInitValue_rt_Array_Float_100_rt_Array_Float_100_61, constant=DefaultInitValue_Float}, {short-label=DefaultInitValue_rt_Array_Float_100_rt_Array_Float_100_62, constant=DefaultInitValue_Float}, {short-label=DefaultInitValue_rt_Array_Float_100_rt_Array_Float_100_63, constant=DefaultInitValue_Float}, {short-label=DefaultInitValue_rt_Array_Float_100_rt_Array_Float_100_64, constant=DefaultInitValue_Float}, {short-label=DefaultInitValue_rt_Array_Float_100_rt_Array_Float_100_65, constant=DefaultInitValue_Float}, {short-label=DefaultInitValue_rt_Array_Float_100_rt_Array_Float_100_66, constant=DefaultInitValue_Float}, {short-label=DefaultInitValue_rt_Array_Float_100_rt_Array_Float_100_67, constant=DefaultInitValue_Float}, {short-label=DefaultInitValue_rt_Array_Float_100_rt_Array_Float_100_68, constant=DefaultInitValue_Float}, {short-label=DefaultInitValue_rt_Array_Float_100_rt_Array_Float_100_69, constant=DefaultInitValue_Float}, {short-label=DefaultInitValue_rt_Array_Float_100_rt_Array_Float_100_70, constant=DefaultInitValue_Float}, {short-label=DefaultInitValue_rt_Array_Float_100_rt_Array_Float_100_71, constant=DefaultInitValue_Float}, {short-label=DefaultInitValue_rt_Array_Float_100_rt_Array_Float_100_72, constant=DefaultInitValue_Float}, {short-label=DefaultInitValue_rt_Array_Float_100_rt_Array_Float_100_73, constant=DefaultInitValue_Float}, {short-label=DefaultInitValue_rt_Array_Float_100_rt_Array_Float_100_74, constant=DefaultInitValue_Float}, {short-label=DefaultInitValue_rt_Array_Float_100_rt_Array_Float_100_75, constant=DefaultInitValue_Float}, {short-label=DefaultInitValue_rt_Array_Float_100_rt_Array_Float_100_76, constant=DefaultInitValue_Float}, {short-label=DefaultInitValue_rt_Array_Float_100_rt_Array_Float_100_77, constant=DefaultInitValue_Float}, {short-label=DefaultInitValue_rt_Array_Float_100_rt_Array_Float_100_78, constant=DefaultInitValue_Float}, {short-label=DefaultInitValue_rt_Array_Float_100_rt_Array_Float_100_79, constant=DefaultInitValue_Float}, {short-label=DefaultInitValue_rt_Array_Float_100_rt_Array_Float_100_80, constant=DefaultInitValue_Float}, {short-label=DefaultInitValue_rt_Array_Float_100_rt_Array_Float_100_81, constant=DefaultInitValue_Float}, {short-label=DefaultInitValue_rt_Array_Float_100_rt_Array_Float_100_82, constant=DefaultInitValue_Float}, {short-label=DefaultInitValue_rt_Array_Float_100_rt_Array_Float_100_83, constant=DefaultInitValue_Float}, {short-label=DefaultInitValue_rt_Array_Float_100_rt_Array_Float_100_84, constant=DefaultInitValue_Float}, {short-label=DefaultInitValue_rt_Array_Float_100_rt_Array_Float_100_85, constant=DefaultInitValue_Float}, {short-label=DefaultInitValue_rt_Array_Float_100_rt_Array_Float_100_86, constant=DefaultInitValue_Float}, {short-label=DefaultInitValue_rt_Array_Float_100_rt_Array_Float_100_87, constant=DefaultInitValue_Float}, {short-label=DefaultInitValue_rt_Array_Float_100_rt_Array_Float_100_88, constant=DefaultInitValue_Float}, {short-label=DefaultInitValue_rt_Array_Float_100_rt_Array_Float_100_89, constant=DefaultInitValue_Float}, {short-label=DefaultInitValue_rt_Array_Float_100_rt_Array_Float_100_90, constant=DefaultInitValue_Float}, {short-label=DefaultInitValue_rt_Array_Float_100_rt_Array_Float_100_91, constant=DefaultInitValue_Float}, {short-label=DefaultInitValue_rt_Array_Float_100_rt_Array_Float_100_92, constant=DefaultInitValue_Float}, {short-label=DefaultInitValue_rt_Array_Float_100_rt_Array_Float_100_93, constant=DefaultInitValue_Float}, {short-label=DefaultInitValue_rt_Array_Float_100_rt_Array_Float_100_94, constant=DefaultInitValue_Float}, {short-label=DefaultInitValue_rt_Array_Float_100_rt_Array_Float_100_95, constant=DefaultInitValue_Float}, {short-label=DefaultInitValue_rt_Array_Float_100_rt_Array_Float_100_96, constant=DefaultInitValue_Float}, {short-label=DefaultInitValue_rt_Array_Float_100_rt_Array_Float_100_97, constant=DefaultInitValue_Float}, {short-label=DefaultInitValue_rt_Array_Float_100_rt_Array_Float_100_98, constant=DefaultInitValue_Float}, {short-label=DefaultInitValue_rt_Array_Float_100_rt_Array_Float_100_99, constant=DefaultInitValue_Float}, {short-label=DefaultInitValue_rt_Array_Float_100_rt_Array_Float_100_100, constant=DefaultInitValue_Float}]
    DefaultInitValue_UInt8: value-spec=0
    DefaultInitValue_rt_Array_UInt8_8: value-spec=[{short-label=DefaultInitValue_rt_Array_UInt8_100_rt_Array_UInt8_100_1, constant=DefaultInitValue_UInt8}, {short-label=DefaultInitValue_rt_Array_UInt8_100_rt_Array_UInt8_100_2, constant=DefaultInitValue_UInt8}, {short-label=DefaultInitValue_rt_Array_UInt8_100_rt_Array_UInt8_100_3, constant=DefaultInitValue_UInt8}, {short-label=DefaultInitValue_rt_Array_UInt8_100_rt_Array_UInt8_100_4, constant=DefaultInitValue_UInt8}, {short-label=DefaultInitValue_rt_Array_UInt8_100_rt_Array_UInt8_100_5, constant=DefaultInitValue_UInt8}, {short-label=DefaultInitValue_rt_Array_UInt8_100_rt_Array_UInt8_100_6, constant=DefaultInitValue_UInt8}, {short-label=DefaultInitValue_rt_Array_UInt8_100_rt_Array_UInt8_100_7, constant=DefaultInitValue_UInt8}, {short-label=DefaultInitValue_rt_Array_UInt8_100_rt_Array_UInt8_100_8, constant=DefaultInitValue_UInt8}]
    DefaultInitValue_SInt16: value-spec=0
    DefaultInitValue_SInt32: value-spec=0
    DefaultInitValue_SInt8: value-spec=0
    DefaultInitValue_UInt16: value-spec=0
    DefaultInitValue_UInt32: value-spec=0
    KBal_BalReqCkTo_Sec: value-spec=5
    KBal_CellVoltMaxLowerLmt_V: value-spec=3.38
    KBal_CellVoltMaxUpperLmt_V: value-spec=3.4
    KBal_VoltDiffLmt1_V: value-spec=0.2
    KBal_VoltDiffLmt2_V: value-spec=0.004
    KBal_VoltDiffLmt3_V: value-spec=0.001
    KBal_CellVoltMaxLowerLmtTo_Sec: value-spec=0.3
    KBal_CellVoltMaxUpperLmtTo_Sec: value-spec=0.3
    KBal_VoltDiffLmt{1..3}To_Sec: value-spec=0.5
    KBal_WaitBalTo_Sec: value-spec=0.05
    DefaultInitValue_rt_Array_UInt16_6: value-spec=[{short-label=DefaultInitValue_rt_Array_UInt8_100_rt_Array_UInt8_100_1, constant=DefaultInitValue_UInt16}, {short-label=DefaultInitValue_rt_Array_UInt8_100_rt_Array_UInt8_100_2, constant=DefaultInitValue_UInt16}, {short-label=DefaultInitValue_rt_Array_UInt8_100_rt_Array_UInt8_100_3, constant=DefaultInitValue_UInt16}, {short-label=DefaultInitValue_rt_Array_UInt8_100_rt_Array_UInt8_100_4, constant=DefaultInitValue_UInt16}, {short-label=DefaultInitValue_rt_Array_UInt8_100_rt_Array_UInt8_100_5, constant=DefaultInitValue_UInt16}, {short-label=DefaultInitValue_rt_Array_UInt8_100_rt_Array_UInt8_100_6, constant=DefaultInitValue_UInt16}]
    KBal_VoltDiffLmt4_V: value-spec=0.002
    KBal_VoltDiffLmt4To_Sec: value-spec=0.03
    KBal_CellVoltMaxLmt1_V: value-spec=3.59
    KBal_CellVoltMaxLmt2_V: value-spec=3.6
    KBal_BalDoneCkTo_Sec: value-spec=0.05
    KBal_BalTic_Sec: value-spec=0.01
    KBmm_BmsWakeTimeLmt_Sec: value-spec=2
    KBmm_EepromWipTimeLmt_Sec: value-spec=10
    KBmm_OffLineBalDoneCfmTimeLmt_Sec: value-spec=0.06
    KBmm_OnChgWakeOffTimeLmt_Sec: value-spec=0.04
    KBmm_OpenRlyOnAlarmVehSpdLmt_Kph: value-spec=5
    KBmm_RlyClsCntReleaseTimeLmt_Sec: value-spec=15
    KBmm_RlyClsDurOffChgCycLmt_Cnt: value-spec=5
    KBmm_RlyClsDurOnChgCycLmt_Cnt: value-spec=20
    KBmm_RlyClsIntervalTimeLmt_Sec: value-spec=0.5
    KBmm_RlyClsReqCfmTimeLmt_Sec: value-spec=0.04
    KBmm_RlyOpenOnAlarmCfmTimeLmt_Sec: value-spec=0.06
    KBmm_RlyOpenReqCfmTimeLmt_Sec: value-spec=0.04
    KBmm_TickTime_Sec: value-spec=0.02
    KBmm_WaitReadyTimeLmt_Sec: value-spec=2
    KBmm_WaitRlyOpenTimeLmt_Sec: value-spec=10
    KBmm_WakeLatchTimeLmt_Sec: value-spec=300
    KBmm_WakeOffTimeLmt_Sec: value-spec=0.04
    CBms_CellSeriesNo_Cnt: value-spec=96
    KFpm_TickTime_Sec: value-spec=0.02
    CBms_BatRatedCap_Ah: value-spec=153
    CBms_BatType_Enum: value-spec=1
    CSoc_TicTime_Sec: value-spec=0.02
    KSoc_Av2DspLowerLmt_Pct: value-spec=5
    KSoc_Av2DspUpperLmt_Pct: value-spec=95
    KSoc_CmuIdleCur_A: value-spec=0
    KSoc_CmuWorkCur_A: value-spec=0
    KSoc_CurLowTimeLmt_Sec: value-spec=10
    KSoc_DecRate_Pps: value-spec=100
    KSoc_IncRate_Pps: value-spec=10
    KSoc_KotLmt_Sec: value-spec=3600
    KSoc_OcvLowerLmt_V: value-spec=3.7
    KSoc_OcvUpperLmt_V: value-spec=3.81
    KSoc_OcvX_Array: value-spec=[3.09, 3.22, 3.35, 3.44, 3.5, 3.56, 3.59, 3.61, 3.66, 3.7, 3.72, 3.75, 3.76, 3.78, 3.79, 3.81, 3.84, 3.88, 3.93, 3.99, 4.03, 4.08, 4.1, 4.12, 4.14, 4.16, 4.2]
    KSoc_OcvY_Array: value-spec=[0, 2, 4, 6, 8, 10, 15, 20, 25, 30, 35, 40, 45, 50, 55, 60, 65, 70, 75, 80, 85, 90, 92, 94, 96, 98, 100]
    KSoc_OncModifyCurLowerLmt_A: value-spec=-8
    KSoc_OncModifyCurUpperLmt_A: value-spec=-7
    KSoc_OncModifySocLowerLmt_Pct: value-spec=20
    KSoc_OncModifySocUpperLmt_Pct: value-spec=35
    KSoc_OnlineModifyCurLowerLmt_A: value-spec=-0.5
    KSoc_OnlineModifyCurUpperLmt_A: value-spec=0.5
    KSoc_RstFullCurLmt_A: value-spec=1
    KSoc_RstFullSocLmt_Pct: value-spec=95
    KSoc_RstFullVoltLmt_V: value-spec=4.23
    KSoc_RstZeroCurLmt_A: value-spec=10
    KSoc_RstZeroSocLmt_Pct: value-spec=5
    KSoc_RstZeroVoltLmt_V: value-spec=3.3
    KSoc_TemFactorX_Array: value-spec=[{short-label=DefaultInitValue_rt_Array_Float_100_rt_Array_Float_100_1, constant=KSoc_TemFactorX_Array_1}, {short-label=DefaultInitValue_rt_Array_Float_100_rt_Array_Float_100_2, constant=KSoc_TemFactorX_Array_2}, {short-label=DefaultInitValue_rt_Array_Float_100_rt_Array_Float_100_3, constant=KSoc_TemFactorX_Array_3}, {short-label=DefaultInitValue_rt_Array_Float_100_rt_Array_Float_100_4, constant=KSoc_TemFactorX_Array_4}, {short-label=DefaultInitValue_rt_Array_Float_100_rt_Array_Float_100_5, constant=KSoc_TemFactorX_Array_5}, {short-label=DefaultInitValue_rt_Array_Float_100_rt_Array_Float_100_6, constant=KSoc_TemFactorX_Array_6}, {short-label=DefaultInitValue_rt_Array_Float_100_rt_Array_Float_100_7, constant=KSoc_TemFactorX_Array_7}, {short-label=DefaultInitValue_rt_Array_Float_100_rt_Array_Float_100_8, constant=KSoc_TemFactorX_Array_8}, {short-label=DefaultInitValue_rt_Array_Float_100_rt_Array_Float_100_9, constant=KSoc_TemFactorX_Array_9}, {short-label=DefaultInitValue_rt_Array_Float_100_rt_Array_Float_100_10, constant=KSoc_TemFactorX_Array_10}, {short-label=DefaultInitValue_rt_Array_Float_100_rt_Array_Float_100_11, constant=KSoc_TemFactorX_Array_11}, {short-label=DefaultInitValue_rt_Array_Float_100_rt_Array_Float_100_12, constant=KSoc_TemFactorX_Array_12}, {short-label=DefaultInitValue_rt_Array_Float_100_rt_Array_Float_100_13, constant=KSoc_TemFactorX_Array_13}, {short-label=DefaultInitValue_rt_Array_Float_100_rt_Array_Float_100_14, constant=KSoc_TemFactorX_Array_14}, {short-label=DefaultInitValue_rt_Array_Float_100_rt_Array_Float_100_15, constant=KSoc_TemFactorX_Array_15}, {short-label=DefaultInitValue_rt_Array_Float_100_rt_Array_Float_100_16, constant=KSoc_TemFactorX_Array_16}, {short-label=DefaultInitValue_rt_Array_Float_100_rt_Array_Float_100_17, constant=KSoc_TemFactorX_Array_17}]
    KSoc_TemFactorX_Array_1: value-spec=-30
    KSoc_TemFactorX_Array_2: value-spec=-25
    KSoc_TemFactorX_Array_3: value-spec=-20
    KSoc_TemFactorX_Array_4: value-spec=-15
    KSoc_TemFactorX_Array_5: value-spec=-10
    KSoc_TemFactorX_Array_6: value-spec=-5
    KSoc_TemFactorX_Array_7: value-spec=0
    KSoc_TemFactorX_Array_8: value-spec=5
    KSoc_TemFactorX_Array_9: value-spec=10
    KSoc_TemFactorX_Array_10: value-spec=15
    KSoc_TemFactorX_Array_11: value-spec=20
    KSoc_TemFactorX_Array_12: value-spec=25
    KSoc_TemFactorX_Array_13: value-spec=30
    KSoc_TemFactorX_Array_14: value-spec=35
    KSoc_TemFactorX_Array_15: value-spec=40
    KSoc_TemFactorX_Array_16: value-spec=45
    KSoc_TemFactorX_Array_17: value-spec=50
    KSoc_TemFactorY_Array: value-spec=[{short-label=DefaultInitValue_rt_Array_Float_100_rt_Array_Float_100_1, constant=KSoc_TemFactorY_Array_1}, {short-label=DefaultInitValue_rt_Array_Float_100_rt_Array_Float_100_2, constant=KSoc_TemFactorY_Array_2}, {short-label=DefaultInitValue_rt_Array_Float_100_rt_Array_Float_100_3, constant=KSoc_TemFactorY_Array_3}, {short-label=DefaultInitValue_rt_Array_Float_100_rt_Array_Float_100_4, constant=KSoc_TemFactorY_Array_4}, {short-label=DefaultInitValue_rt_Array_Float_100_rt_Array_Float_100_5, constant=KSoc_TemFactorY_Array_5}, {short-label=DefaultInitValue_rt_Array_Float_100_rt_Array_Float_100_6, constant=KSoc_TemFactorY_Array_6}, {short-label=DefaultInitValue_rt_Array_Float_100_rt_Array_Float_100_7, constant=KSoc_TemFactorY_Array_7}, {short-label=DefaultInitValue_rt_Array_Float_100_rt_Array_Float_100_8, constant=KSoc_TemFactorY_Array_8}, {short-label=DefaultInitValue_rt_Array_Float_100_rt_Array_Float_100_9, constant=KSoc_TemFactorY_Array_9}, {short-label=DefaultInitValue_rt_Array_Float_100_rt_Array_Float_100_10, constant=KSoc_TemFactorY_Array_10}, {short-label=DefaultInitValue_rt_Array_Float_100_rt_Array_Float_100_11, constant=KSoc_TemFactorY_Array_11}, {short-label=DefaultInitValue_rt_Array_Float_100_rt_Array_Float_100_12, constant=KSoc_TemFactorY_Array_12}, {short-label=DefaultInitValue_rt_Array_Float_100_rt_Array_Float_100_13, constant=KSoc_TemFactorY_Array_13}, {short-label=DefaultInitValue_rt_Array_Float_100_rt_Array_Float_100_14, constant=KSoc_TemFactorY_Array_14}, {short-label=DefaultInitValue_rt_Array_Float_100_rt_Array_Float_100_15, constant=KSoc_TemFactorY_Array_15}, {short-label=DefaultInitValue_rt_Array_Float_100_rt_Array_Float_100_16, constant=KSoc_TemFactorY_Array_16}, {short-label=DefaultInitValue_rt_Array_Float_100_rt_Array_Float_100_17, constant=KSoc_TemFactorY_Array_17}]
    KSoc_TemFactorY_Array_1: value-spec=0.5
    KSoc_TemFactorY_Array_2: value-spec=0.5783
    KSoc_TemFactorY_Array_3: value-spec=0.6566
    KSoc_TemFactorY_Array_4: value-spec=0.7172
    KSoc_TemFactorY_Array_5: value-spec=0.7778
    KSoc_TemFactorY_Array_6: value-spec=0.8258
    KSoc_TemFactorY_Array_7: value-spec=0.8737
    KSoc_TemFactorY_Array_8: value-spec=0.8990
    KSoc_TemFactorY_Array_9: value-spec=0.9242
    KSoc_TemFactorY_Array_10: value-spec=0.9495
    KSoc_TemFactorY_Array_11: value-spec=0.9848
    KSoc_TemFactorY_Array_12: value-spec=0.9949
    KSoc_TemFactorY_Array_{13..17}: value-spec=1
    KSoc_TempAhUpperX_Array: value-spec=[{short-label=DefaultInitValue_rt_Array_Float_100_rt_Array_Float_100_1, constant=KSoc_TempAhUpperX_Array_1}, {short-label=DefaultInitValue_rt_Array_Float_100_rt_Array_Float_100_2, constant=KSoc_TempAhUpperX_Array_2}, {short-label=DefaultInitValue_rt_Array_Float_100_rt_Array_Float_100_3, constant=KSoc_TempAhUpperX_Array_3}, {short-label=DefaultInitValue_rt_Array_Float_100_rt_Array_Float_100_4, constant=KSoc_TempAhUpperX_Array_4}, {short-label=DefaultInitValue_rt_Array_Float_100_rt_Array_Float_100_5, constant=KSoc_TempAhUpperX_Array_5}, {short-label=DefaultInitValue_rt_Array_Float_100_rt_Array_Float_100_6, constant=KSoc_TempAhUpperX_Array_6}, {short-label=DefaultInitValue_rt_Array_Float_100_rt_Array_Float_100_7, constant=KSoc_TempAhUpperX_Array_7}, {short-label=DefaultInitValue_rt_Array_Float_100_rt_Array_Float_100_8, constant=KSoc_TempAhUpperX_Array_8}, {short-label=DefaultInitValue_rt_Array_Float_100_rt_Array_Float_100_9, constant=KSoc_TempAhUpperX_Array_9}]
    KSoc_TempAhUpperX_Array_1: value-spec=-30
    KSoc_TempAhUpperX_Array_2: value-spec=-20
    KSoc_TempAhUpperX_Array_3: value-spec=-10
    KSoc_TempAhUpperX_Array_4: value-spec=0
    KSoc_TempAhUpperX_Array_5: value-spec=10
    KSoc_TempAhUpperX_Array_6: value-spec=20
    KSoc_TempAhUpperX_Array_7: value-spec=30
    KSoc_TempAhUpperX_Array_8: value-spec=40
    KSoc_TempAhUpperX_Array_9: value-spec=50
    KSoc_TempAhUpperY_Array: value-spec=[{short-label=DefaultInitValue_rt_Array_Float_100_rt_Array_Float_100_1, constant=KSoc_TempAhUpperY_Array_1}, {short-label=DefaultInitValue_rt_Array_Float_100_rt_Array_Float_100_2, constant=KSoc_TempAhUpperY_Array_2}, {short-label=DefaultInitValue_rt_Array_Float_100_rt_Array_Float_100_3, constant=KSoc_TempAhUpperY_Array_3}, {short-label=DefaultInitValue_rt_Array_Float_100_rt_Array_Float_100_4, constant=KSoc_TempAhUpperY_Array_4}, {short-label=DefaultInitValue_rt_Array_Float_100_rt_Array_Float_100_5, constant=KSoc_TempAhUpperY_Array_5}, {short-label=DefaultInitValue_rt_Array_Float_100_rt_Array_Float_100_6, constant=KSoc_TempAhUpperY_Array_6}, {short-label=DefaultInitValue_rt_Array_Float_100_rt_Array_Float_100_7, constant=KSoc_TempAhUpperY_Array_7}, {short-label=DefaultInitValue_rt_Array_Float_100_rt_Array_Float_100_8, constant=KSoc_TempAhUpperY_Array_8}, {short-label=DefaultInitValue_rt_Array_Float_100_rt_Array_Float_100_9, constant=KSoc_TempAhUpperY_Array_9}]
    KSoc_TempAhUpperY_Array_1: value-spec=23.13
    KSoc_TempAhUpperY_Array_2: value-spec=10.43
    KSoc_TempAhUpperY_Array_3: value-spec=5.25
    KSoc_TempAhUpperY_Array_4: value-spec=2.46
    KSoc_TempAhUpperY_Array_5: value-spec=0.47
    KSoc_TempAhUpperY_Array_{6..8}: value-spec=0
    KSoc_TempAhLowerX_Array: value-spec=[{short-label=DefaultInitValue_rt_Array_Float_100_rt_Array_Float_100_1, constant=KSoc_TempAhUpperX_Array_1}, {short-label=DefaultInitValue_rt_Array_Float_100_rt_Array_Float_100_2, constant=KSoc_TempAhUpperX_Array_2}, {short-label=DefaultInitValue_rt_Array_Float_100_rt_Array_Float_100_3, constant=KSoc_TempAhUpperX_Array_3}, {short-label=DefaultInitValue_rt_Array_Float_100_rt_Array_Float_100_4, constant=KSoc_TempAhUpperX_Array_4}, {short-label=DefaultInitValue_rt_Array_Float_100_rt_Array_Float_100_5, constant=KSoc_TempAhUpperX_Array_5}, {short-label=DefaultInitValue_rt_Array_Float_100_rt_Array_Float_100_6, constant=KSoc_TempAhUpperX_Array_6}, {short-label=DefaultInitValue_rt_Array_Float_100_rt_Array_Float_100_7, constant=KSoc_TempAhUpperX_Array_7}, {short-label=DefaultInitValue_rt_Array_Float_100_rt_Array_Float_100_8, constant=KSoc_TempAhUpperX_Array_8}, {short-label=DefaultInitValue_rt_Array_Float_100_rt_Array_Float_100_9, constant=KSoc_TempAhUpperX_Array_9}]
    KSoc_TempAhLowerY_Array: value-spec=[{short-label=DefaultInitValue_rt_Array_Float_100_rt_Array_Float_100_1, constant=KSoc_TempAhLowerY_Array_1}, {short-label=DefaultInitValue_rt_Array_Float_100_rt_Array_Float_100_2, constant=KSoc_TempAhLowerY_Array_2}, {short-label=DefaultInitValue_rt_Array_Float_100_rt_Array_Float_100_3, constant=KSoc_TempAhLowerY_Array_3}, {short-label=DefaultInitValue_rt_Array_Float_100_rt_Array_Float_100_4, constant=KSoc_TempAhLowerY_Array_4}, {short-label=DefaultInitValue_rt_Array_Float_100_rt_Array_Float_100_5, constant=KSoc_TempAhLowerY_Array_5}, {short-label=DefaultInitValue_rt_Array_Float_100_rt_Array_Float_100_6, constant=KSoc_TempAhLowerY_Array_6}, {short-label=DefaultInitValue_rt_Array_Float_100_rt_Array_Float_100_7, constant=KSoc_TempAhLowerY_Array_7}, {short-label=DefaultInitValue_rt_Array_Float_100_rt_Array_Float_100_8, constant=KSoc_TempAhLowerY_Array_8}, {short-label=DefaultInitValue_rt_Array_Float_100_rt_Array_Float_100_9, constant=KSoc_TempAhLowerY_Array_9}]
    KSoc_TempAhLowerY_Array_1: value-spec=46.99
    KSoc_TempAhLowerY_Array_2: value-spec=29.27
    KSoc_TempAhLowerY_Array_3: value-spec=16.27
    KSoc_TempAhLowerY_Array_4: value-spec=6.44
    KSoc_TempAhLowerY_Array_5: value-spec=4.23
    KSoc_TempAhLowerY_Array_6: value-spec=0.92
    KSoc_TempAhLowerY_Array_{7..9}: value-spec=0
    KSoc_Av2DspMidLmt_Pct: value-spec=50
    KSoc_DrvRangeUpper_Km: value-spec=0
    KSoc_DrvRangeMid_Km: value-spec=0
    KSoc_DrvRangeLower_Km: value-spec=0
    KSoc_TempAhUpperY_Array_9: value-spec=0
    CSof_TicTime_Sec: value-spec=0.02
    KSof_AvgCurHysi_A: value-spec=10
    KSof_BmsCharging_Enum: value-spec=6
    KSof_BmsDriveMode_Enum: value-spec=3
    KSof_BmsDriveReady_Enum: value-spec=1
    KSof_CellOvFallRate_Aps: value-spec=100
    KSof_CellOvLmt_V: value-spec=4.25
    KSof_CellOvLmtHysi_V: value-spec=0.1
    KSof_CellOvRaiseRate_Aps: value-spec=10
    KSof_CellUvFallRate_Aps: value-spec=100
    KSof_CellUvLmt_V: value-spec=2.8
    KSof_CellUvLmtHysi_V: value-spec=0.3
    KSof_CellUvRaiseRate_Aps: value-spec=10
    KSof_ChgConstCurLktGain_Pct: value-spec=1
    KSof_ChgConstCurLktLmt_A: value-spec=250
    KSof_ChgConstCurLktOffset_A: value-spec=0
    KSof_ChgConstCurLktX_Array: value-spec=[{short-label=DefaultInitValue_rt_Array_Float_100_rt_Array_Float_100_1, constant=KSof_ChgConstCurLktX_Array_1}, {short-label=DefaultInitValue_rt_Array_Float_100_rt_Array_Float_100_2, constant=KSof_ChgConstCurLktX_Array_2}, {short-label=DefaultInitValue_rt_Array_Float_100_rt_Array_Float_100_3, constant=KSof_ChgConstCurLktX_Array_3}, {short-label=DefaultInitValue_rt_Array_Float_100_rt_Array_Float_100_4, constant=KSof_ChgConstCurLktX_Array_4}, {short-label=DefaultInitValue_rt_Array_Float_100_rt_Array_Float_100_5, constant=KSof_ChgConstCurLktX_Array_5}, {short-label=DefaultInitValue_rt_Array_Float_100_rt_Array_Float_100_6, constant=KSof_ChgConstCurLktX_Array_6}]
    KSof_ChgConstCurLktX_Array_1: value-spec=-25
    KSof_ChgConstCurLktX_Array_2: value-spec=-10
    KSof_ChgConstCurLktX_Array_3: value-spec=0
    KSof_ChgConstCurLktX_Array_4: value-spec=10
    KSof_ChgConstCurLktX_Array_5: value-spec=25
    KSof_ChgConstCurLktX_Array_6: value-spec=40
    KSof_ChgConstCurLktY_Array: value-spec=[{short-label=DefaultInitValue_rt_Array_Float_100_rt_Array_Float_100_1, constant=KSof_ChgConstCurLktY_Array_1}, {short-label=DefaultInitValue_rt_Array_Float_100_rt_Array_Float_100_2, constant=KSof_ChgConstCurLktY_Array_2}, {short-label=DefaultInitValue_rt_Array_Float_100_rt_Array_Float_100_3, constant=KSof_ChgConstCurLktY_Array_3}, {short-label=DefaultInitValue_rt_Array_Float_100_rt_Array_Float_100_4, constant=KSof_ChgConstCurLktY_Array_4}, {short-label=DefaultInitValue_rt_Array_Float_100_rt_Array_Float_100_5, constant=KSof_ChgConstCurLktY_Array_5}, {short-label=DefaultInitValue_rt_Array_Float_100_rt_Array_Float_100_6, constant=KSof_ChgConstCurLktY_Array_6}, {short-label=DefaultInitValue_rt_Array_Float_100_rt_Array_Float_100_7, constant=KSof_ChgConstCurLktY_Array_7}, {short-label=DefaultInitValue_rt_Array_Float_100_rt_Array_Float_100_8, constant=KSof_ChgConstCurLktY_Array_8}, {short-label=DefaultInitValue_rt_Array_Float_100_rt_Array_Float_100_9, constant=KSof_ChgConstCurLktY_Array_9}, KSof_ChgConstCurLktY_Array_10, KSof_ChgConstCurLktY_Array_11]
    KSof_ChgConstCurLktY_Array_1: value-spec=0
    KSof_ChgConstCurLktY_Array_2: value-spec=10
    KSof_ChgConstCurLktY_Array_3: value-spec=20
    KSof_ChgConstCurLktY_Array_4: value-spec=30
    KSof_ChgConstCurLktY_Array_5: value-spec=40
    KSof_ChgConstCurLktY_Array_6: value-spec=50
    KSof_ChgConstCurLktY_Array_7: value-spec=60
    KSof_ChgConstCurLktY_Array_8: value-spec=70
    KSof_ChgConstCurLktY_Array_9: value-spec=80
    KSof_ChgConstCurLktY_Array_10: value-spec=90
    KSof_ChgConstCurLktY_Array_11: value-spec=100
    KSof_ChgConstCurLktZ_Array: value-spec=[[KSof_ChgConstCurLktZ_Array_1, KSof_ChgConstCurLktZ_Array_2, KSof_ChgConstCurLktZ_Array_3, KSof_ChgConstCurLktZ_Array_4, KSof_ChgConstCurLktZ_Array_5, KSof_ChgConstCurLktZ_Array_6], [KSof_ChgConstCurLktZ_Array_1, KSof_ChgConstCurLktZ_Array_2, KSof_ChgConstCurLktZ_Array_3, KSof_ChgConstCurLktZ_Array_4, KSof_ChgConstCurLktZ_Array_5, KSof_ChgConstCurLktZ_Array_6], [KSof_ChgConstCurLktZ_Array_1, KSof_ChgConstCurLktZ_Array_2, KSof_ChgConstCurLktZ_Array_3, KSof_ChgConstCurLktZ_Array_4, KSof_ChgConstCurLktZ_Array_5, KSof_ChgConstCurLktZ_Array_6], [KSof_ChgConstCurLktZ_Array_1, KSof_ChgConstCurLktZ_Array_2, KSof_ChgConstCurLktZ_Array_3, KSof_ChgConstCurLktZ_Array_4, KSof_ChgConstCurLktZ_Array_5, KSof_ChgConstCurLktZ_Array_6], [KSof_ChgConstCurLktZ_Array_1, KSof_ChgConstCurLktZ_Array_2, KSof_ChgConstCurLktZ_Array_3, KSof_ChgConstCurLktZ_Array_4, KSof_ChgConstCurLktZ_Array_5, KSof_ChgConstCurLktZ_Array_6], [KSof_ChgConstCurLktZ_Array_1, KSof_ChgConstCurLktZ_Array_2, KSof_ChgConstCurLktZ_Array_3, KSof_ChgConstCurLktZ_Array_4, KSof_ChgConstCurLktZ_Array_5, KSof_ChgConstCurLktZ_Array_6], [KSof_ChgConstCurLktZ_Array_1, KSof_ChgConstCurLktZ_Array_2, KSof_ChgConstCurLktZ_Array_3, KSof_ChgConstCurLktZ_Array_4, KSof_ChgConstCurLktZ_Array_5, KSof_ChgConstCurLktZ_Array_6], [KSof_ChgConstCurLktZ_Array_1, KSof_ChgConstCurLktZ_Array_2, KSof_ChgConstCurLktZ_Array_3, KSof_ChgConstCurLktZ_Array_4, KSof_ChgConstCurLktZ_Array_5, KSof_ChgConstCurLktZ_Array_6], [KSof_ChgConstCurLktZ_Array_1, KSof_ChgConstCurLktZ_Array_2, KSof_ChgConstCurLktZ_Array_3, KSof_ChgConstCurLktZ_Array_4, KSof_ChgConstCurLktZ_Array_5, KSof_ChgConstCurLktZ_Array_6], [KSof_ChgConstCurLktZ_Array_1, KSof_ChgConstCurLktZ_Array_2, KSof_ChgConstCurLktZ_Array_3, KSof_ChgConstCurLktZ_Array_4, KSof_ChgConstCurLktZ_Array_5, KSof_ChgConstCurLktZ_Array_6], 6 x KSof_ChgConstCurLktZ_Array_7]
    KSof_ChgConstCurLktZ_Array_1: value-spec=10
    KSof_ChgConstCurLktZ_Array_2: value-spec=17
    KSof_ChgConstCurLktZ_Array_3: value-spec=30
    KSof_ChgConstCurLktZ_Array_4: value-spec=52
    KSof_ChgConstCurLktZ_Array_5: value-spec=88
    KSof_ChgConstCurLktZ_Array_6: value-spec=88
    KSof_ChgConstCurLktZ_Array_7: value-spec=0
    KSof_ChgCurrLatchSocLmt_Pct: value-spec=25
    KSof_ChgCurrLatchSocLmtHysi_Pct: value-spec=10
    KSof_ChgFsCurLmt_A: value-spec=60
    KSof_ChgInstCurLktGain_Pct: value-spec=1
    KSof_ChgInstCurLktLmt_A: value-spec=300
    KSof_ChgInstCurLktOffset_A: value-spec=0
    KSof_ChgInstCurLktY_Array: value-spec=[{short-label=DefaultInitValue_rt_Array_Float_100_rt_Array_Float_100_1, constant=KSof_ChgConstCurLktY_Array_1}, {short-label=DefaultInitValue_rt_Array_Float_100_rt_Array_Float_100_2, constant=KSof_ChgConstCurLktY_Array_2}, {short-label=DefaultInitValue_rt_Array_Float_100_rt_Array_Float_100_3, constant=KSof_ChgConstCurLktY_Array_3}, {short-label=DefaultInitValue_rt_Array_Float_100_rt_Array_Float_100_4, constant=KSof_ChgConstCurLktY_Array_4}, {short-label=DefaultInitValue_rt_Array_Float_100_rt_Array_Float_100_5, constant=KSof_ChgConstCurLktY_Array_5}, {short-label=DefaultInitValue_rt_Array_Float_100_rt_Array_Float_100_6, constant=KSof_ChgConstCurLktY_Array_6}, {short-label=DefaultInitValue_rt_Array_Float_100_rt_Array_Float_100_7, constant=KSof_ChgConstCurLktY_Array_7}, {short-label=DefaultInitValue_rt_Array_Float_100_rt_Array_Float_100_8, constant=KSof_ChgConstCurLktY_Array_8}, {short-label=DefaultInitValue_rt_Array_Float_100_rt_Array_Float_100_9, constant=KSof_ChgConstCurLktY_Array_9}, KSof_ChgConstCurLktY_Array_10, KSof_ChgConstCurLktY_Array_11]
    KSof_ChgInstCurLktZ_Array: value-spec=[[KSof_ChgInstCurLktZ_Array_1, KSof_ChgInstCurLktZ_Array_2, KSof_ChgInstCurLktZ_Array_3, KSof_ChgInstCurLktZ_Array_4, KSof_ChgInstCurLktZ_Array_5, KSof_ChgInstCurLktZ_Array_5], [KSof_ChgInstCurLktZ_Array_1, KSof_ChgInstCurLktZ_Array_2, KSof_ChgInstCurLktZ_Array_3, KSof_ChgInstCurLktZ_Array_4, KSof_ChgInstCurLktZ_Array_5, KSof_ChgInstCurLktZ_Array_5], [KSof_ChgInstCurLktZ_Array_1, KSof_ChgInstCurLktZ_Array_2, KSof_ChgInstCurLktZ_Array_3, KSof_ChgInstCurLktZ_Array_4, KSof_ChgInstCurLktZ_Array_5, KSof_ChgInstCurLktZ_Array_5], [KSof_ChgInstCurLktZ_Array_1, KSof_ChgInstCurLktZ_Array_6, KSof_ChgInstCurLktZ_Array_3, KSof_ChgInstCurLktZ_Array_4, KSof_ChgInstCurLktZ_Array_5, KSof_ChgInstCurLktZ_Array_5], [KSof_ChgInstCurLktZ_Array_7, KSof_ChgInstCurLktZ_Array_8, KSof_ChgInstCurLktZ_Array_3, KSof_ChgInstCurLktZ_Array_4, KSof_ChgInstCurLktZ_Array_5, KSof_ChgInstCurLktZ_Array_5], [KSof_ChgInstCurLktZ_Array_9, KSof_ChgInstCurLktZ_Array_10, KSof_ChgInstCurLktZ_Array_3, KSof_ChgInstCurLktZ_Array_4, KSof_ChgInstCurLktZ_Array_5, KSof_ChgInstCurLktZ_Array_5], [KSof_ChgInstCurLktZ_Array_11, KSof_ChgInstCurLktZ_Array_12, KSof_ChgInstCurLktZ_Array_13, KSof_ChgInstCurLktZ_Array_14, KSof_ChgInstCurLktZ_Array_5, KSof_ChgInstCurLktZ_Array_5], [KSof_ChgInstCurLktZ_Array_15, KSof_ChgInstCurLktZ_Array_16, KSof_ChgInstCurLktZ_Array_17, KSof_ChgInstCurLktZ_Array_18, KSof_ChgInstCurLktZ_Array_5, KSof_ChgInstCurLktZ_Array_5], [KSof_ChgInstCurLktZ_Array_19, KSof_ChgInstCurLktZ_Array_20, KSof_ChgInstCurLktZ_Array_21, KSof_ChgInstCurLktZ_Array_22, KSof_ChgInstCurLktZ_Array_5, KSof_ChgInstCurLktZ_Array_5], [KSof_ChgInstCurLktZ_Array_23, KSof_ChgInstCurLktZ_Array_24, KSof_ChgInstCurLktZ_Array_25, KSof_ChgInstCurLktZ_Array_26, KSof_ChgInstCurLktZ_Array_27, KSof_ChgInstCurLktZ_Array_28], 6 x KSof_ChgInstCurLktZ_Array_29]
    KSof_ChgInstCurLktZ_Array_1: value-spec=17
    KSof_ChgInstCurLktZ_Array_2: value-spec=40
    KSof_ChgInstCurLktZ_Array_3: value-spec=75
    KSof_ChgInstCurLktZ_Array_4: value-spec=100
    KSof_ChgInstCurLktZ_Array_5: value-spec=130
    KSof_ChgInstCurLktZ_Array_6: value-spec=39
    KSof_ChgInstCurLktZ_Array_7: value-spec=16
    KSof_ChgInstCurLktZ_Array_8: value-spec=37
    KSof_ChgInstCurLktZ_Array_9: value-spec=15
    KSof_ChgInstCurLktZ_Array_10: value-spec=34
    KSof_ChgInstCurLktZ_Array_11: value-spec=13
    KSof_ChgInstCurLktZ_Array_12: value-spec=27
    KSof_ChgInstCurLktZ_Array_13: value-spec=67
    KSof_ChgInstCurLktZ_Array_14: value-spec=99
    KSof_ChgInstCurLktZ_Array_15: value-spec=10
    KSof_ChgInstCurLktZ_Array_16: value-spec=21
    KSof_ChgInstCurLktZ_Array_17: value-spec=47
    KSof_ChgInstCurLktZ_Array_18: value-spec=91
    KSof_ChgInstCurLktZ_Array_19: value-spec=6
    KSof_ChgInstCurLktZ_Array_20: value-spec=14
    KSof_ChgInstCurLktZ_Array_21: value-spec=33
    KSof_ChgInstCurLktZ_Array_22: value-spec=61
    KSof_ChgInstCurLktZ_Array_23: value-spec=3
    KSof_ChgInstCurLktZ_Array_24: value-spec=8
    KSof_ChgInstCurLktZ_Array_25: value-spec=22
    KSof_ChgInstCurLktZ_Array_26: value-spec=40
    KSof_ChgInstCurLktZ_Array_27: value-spec=87
    KSof_ChgInstCurLktZ_Array_28: value-spec=101
    KSof_ChgInstCurLktZ_Array_29: value-spec=0
    KSof_ChgPkCurProcessBufLmt_Pct: value-spec=0
    KSof_ChgPkCurProcessCellVoltLmt_V: value-spec=4
    KSof_ChgPkCurProcessSocLmt_Pct: value-spec=90
    KSof_ChgPkCurProcessTempLmt_C: value-spec=0
    KSof_CldCrkCntLmt_Cnt: value-spec=3
    KSof_CldCrkTimeLmt_Sec: value-spec=2
    KSof_CurFallRate_Aps: value-spec=100
    KSof_CurFilterTimeConst_Sec: value-spec=100
    KSof_CurRaiseRate_Aps: value-spec=10
    KSof_DisConstCurLktGain_Pct: value-spec=1
    KSof_DisConstCurLktLmt_A: value-spec=300
    KSof_DisConstCurLktOffset_A: value-spec=0
    KSof_DisConstCurLktX_Array: value-spec=[{short-label=DefaultInitValue_rt_Array_Float_100_rt_Array_Float_100_1, constant=KSof_ChgConstCurLktX_Array_1}, {short-label=DefaultInitValue_rt_Array_Float_100_rt_Array_Float_100_2, constant=KSof_ChgConstCurLktX_Array_2}, {short-label=DefaultInitValue_rt_Array_Float_100_rt_Array_Float_100_3, constant=KSof_ChgConstCurLktX_Array_3}, {short-label=DefaultInitValue_rt_Array_Float_100_rt_Array_Float_100_4, constant=KSof_ChgConstCurLktX_Array_4}, {short-label=DefaultInitValue_rt_Array_Float_100_rt_Array_Float_100_5, constant=KSof_ChgConstCurLktX_Array_5}, {short-label=DefaultInitValue_rt_Array_Float_100_rt_Array_Float_100_6, constant=KSof_ChgConstCurLktX_Array_6}]
    KSof_DisConstCurLktY_Array: value-spec=[{short-label=DefaultInitValue_rt_Array_Float_100_rt_Array_Float_100_1, constant=KSof_ChgConstCurLktY_Array_1}, {short-label=DefaultInitValue_rt_Array_Float_100_rt_Array_Float_100_2, constant=KSof_ChgConstCurLktY_Array_2}, {short-label=DefaultInitValue_rt_Array_Float_100_rt_Array_Float_100_3, constant=KSof_ChgConstCurLktY_Array_3}, {short-label=DefaultInitValue_rt_Array_Float_100_rt_Array_Float_100_4, constant=KSof_ChgConstCurLktY_Array_4}, {short-label=DefaultInitValue_rt_Array_Float_100_rt_Array_Float_100_5, constant=KSof_ChgConstCurLktY_Array_5}, {short-label=DefaultInitValue_rt_Array_Float_100_rt_Array_Float_100_6, constant=KSof_ChgConstCurLktY_Array_6}, {short-label=DefaultInitValue_rt_Array_Float_100_rt_Array_Float_100_7, constant=KSof_ChgConstCurLktY_Array_7}, {short-label=DefaultInitValue_rt_Array_Float_100_rt_Array_Float_100_8, constant=KSof_ChgConstCurLktY_Array_8}, {short-label=DefaultInitValue_rt_Array_Float_100_rt_Array_Float_100_9, constant=KSof_ChgConstCurLktY_Array_9}, KSof_ChgConstCurLktY_Array_10, KSof_ChgConstCurLktY_Array_11]
    KSof_DisConstCurLktZ_Array: value-spec=[6 x KSof_ChgInstCurLktZ_Array_29, [KSof_DisConstCurLktZ_Array_1, KSof_DisConstCurLktZ_Array_2, KSof_DisConstCurLktZ_Array_3, KSof_DisConstCurLktZ_Array_4, KSof_DisConstCurLktZ_Array_5, KSof_DisConstCurLktZ_Array_5], [KSof_DisConstCurLktZ_Array_1, KSof_DisConstCurLktZ_Array_2, KSof_DisConstCurLktZ_Array_3, KSof_DisConstCurLktZ_Array_4, KSof_DisConstCurLktZ_Array_5, KSof_DisConstCurLktZ_Array_5], [KSof_DisConstCurLktZ_Array_1, KSof_DisConstCurLktZ_Array_2, KSof_DisConstCurLktZ_Array_3, KSof_DisConstCurLktZ_Array_4, KSof_DisConstCurLktZ_Array_5, KSof_DisConstCurLktZ_Array_5], [KSof_DisConstCurLktZ_Array_1, KSof_DisConstCurLktZ_Array_2, KSof_DisConstCurLktZ_Array_3, KSof_DisConstCurLktZ_Array_4, KSof_DisConstCurLktZ_Array_5, KSof_DisConstCurLktZ_Array_5], [KSof_DisConstCurLktZ_Array_1, KSof_DisConstCurLktZ_Array_2, KSof_DisConstCurLktZ_Array_3, KSof_DisConstCurLktZ_Array_4, KSof_DisConstCurLktZ_Array_5, KSof_DisConstCurLktZ_Array_5], [KSof_DisConstCurLktZ_Array_1, KSof_DisConstCurLktZ_Array_2, KSof_DisConstCurLktZ_Array_3, KSof_DisConstCurLktZ_Array_4, KSof_DisConstCurLktZ_Array_5, KSof_DisConstCurLktZ_Array_5], [KSof_DisConstCurLktZ_Array_1, KSof_DisConstCurLktZ_Array_2, KSof_DisConstCurLktZ_Array_3, KSof_DisConstCurLktZ_Array_4, KSof_DisConstCurLktZ_Array_5, KSof_DisConstCurLktZ_Array_5], [KSof_DisConstCurLktZ_Array_1, KSof_DisConstCurLktZ_Array_2, KSof_DisConstCurLktZ_Array_3, KSof_DisConstCurLktZ_Array_4, KSof_DisConstCurLktZ_Array_5, KSof_DisConstCurLktZ_Array_5], [KSof_DisConstCurLktZ_Array_1, KSof_DisConstCurLktZ_Array_2, KSof_DisConstCurLktZ_Array_3, KSof_DisConstCurLktZ_Array_4, KSof_DisConstCurLktZ_Array_5, KSof_DisConstCurLktZ_Array_5], [KSof_DisConstCurLktZ_Array_1, KSof_DisConstCurLktZ_Array_2, KSof_DisConstCurLktZ_Array_3, KSof_DisConstCurLktZ_Array_4, KSof_DisConstCurLktZ_Array_5, KSof_DisConstCurLktZ_Array_5]]
    KSof_DisConstCurLktZ_Array_1: value-spec=20
    KSof_DisConstCurLktZ_Array_2: value-spec=30
    KSof_DisConstCurLktZ_Array_3: value-spec=52
    KSof_DisConstCurLktZ_Array_4: value-spec=78
    KSof_DisConstCurLktZ_Array_5: value-spec=130
    KSof_DisInstCurLktGain_Pct: value-spec=1
    KSof_DisInstCurLktLmt_A: value-spec=500
    KSof_DisInstCurLktOffset_A: value-spec=0
    KSof_DisInstCurLktX_Array: value-spec=[{short-label=DefaultInitValue_rt_Array_Float_100_rt_Array_Float_100_1, constant=KSof_ChgConstCurLktX_Array_1}, {short-label=DefaultInitValue_rt_Array_Float_100_rt_Array_Float_100_2, constant=KSof_ChgConstCurLktX_Array_2}, {short-label=DefaultInitValue_rt_Array_Float_100_rt_Array_Float_100_3, constant=KSof_ChgConstCurLktX_Array_3}, {short-label=DefaultInitValue_rt_Array_Float_100_rt_Array_Float_100_4, constant=KSof_ChgConstCurLktX_Array_4}, {short-label=DefaultInitValue_rt_Array_Float_100_rt_Array_Float_100_5, constant=KSof_ChgConstCurLktX_Array_5}, {short-label=DefaultInitValue_rt_Array_Float_100_rt_Array_Float_100_6, constant=KSof_ChgConstCurLktX_Array_6}]
    KSof_DisInstCurLktY_Array: value-spec=[{short-label=DefaultInitValue_rt_Array_Float_100_rt_Array_Float_100_1, constant=KSof_ChgConstCurLktY_Array_1}, {short-label=DefaultInitValue_rt_Array_Float_100_rt_Array_Float_100_2, constant=KSof_ChgConstCurLktY_Array_2}, {short-label=DefaultInitValue_rt_Array_Float_100_rt_Array_Float_100_3, constant=KSof_ChgConstCurLktY_Array_3}, {short-label=DefaultInitValue_rt_Array_Float_100_rt_Array_Float_100_4, constant=KSof_ChgConstCurLktY_Array_4}, {short-label=DefaultInitValue_rt_Array_Float_100_rt_Array_Float_100_5, constant=KSof_ChgConstCurLktY_Array_5}, {short-label=DefaultInitValue_rt_Array_Float_100_rt_Array_Float_100_6, constant=KSof_ChgConstCurLktY_Array_6}, {short-label=DefaultInitValue_rt_Array_Float_100_rt_Array_Float_100_7, constant=KSof_ChgConstCurLktY_Array_7}, {short-label=DefaultInitValue_rt_Array_Float_100_rt_Array_Float_100_8, constant=KSof_ChgConstCurLktY_Array_8}, {short-label=DefaultInitValue_rt_Array_Float_100_rt_Array_Float_100_9, constant=KSof_ChgConstCurLktY_Array_9}, KSof_ChgConstCurLktY_Array_10, KSof_ChgConstCurLktY_Array_11]
    KSof_DisInstCurLktZ_Array: value-spec=[6 x KSof_ChgInstCurLktZ_Array_29, [KSof_DisInstCurLktZ_Array_1, KSof_DisInstCurLktZ_Array_2, KSof_DisInstCurLktZ_Array_3, KSof_DisInstCurLktZ_Array_4, KSof_DisInstCurLktZ_Array_5, KSof_DisInstCurLktZ_Array_6], [KSof_DisInstCurLktZ_Array_7, KSof_DisInstCurLktZ_Array_8, KSof_DisInstCurLktZ_Array_9, KSof_DisInstCurLktZ_Array_10, KSof_DisInstCurLktZ_Array_11, KSof_DisInstCurLktZ_Array_11], [KSof_DisInstCurLktZ_Array_12, KSof_DisInstCurLktZ_Array_13, KSof_DisInstCurLktZ_Array_14, KSof_DisInstCurLktZ_Array_15, KSof_DisInstCurLktZ_Array_11, KSof_DisInstCurLktZ_Array_11], [KSof_DisInstCurLktZ_Array_16, KSof_DisInstCurLktZ_Array_17, KSof_DisInstCurLktZ_Array_18, KSof_DisInstCurLktZ_Array_19, KSof_DisInstCurLktZ_Array_11, KSof_DisInstCurLktZ_Array_11], [KSof_DisInstCurLktZ_Array_20, KSof_DisInstCurLktZ_Array_21, KSof_DisInstCurLktZ_Array_18, KSof_DisInstCurLktZ_Array_22, KSof_DisInstCurLktZ_Array_11, KSof_DisInstCurLktZ_Array_11], [KSof_DisInstCurLktZ_Array_20, KSof_DisInstCurLktZ_Array_23, KSof_DisInstCurLktZ_Array_18, KSof_DisInstCurLktZ_Array_24, KSof_DisInstCurLktZ_Array_11, KSof_DisInstCurLktZ_Array_11], [KSof_DisInstCurLktZ_Array_20, KSof_DisInstCurLktZ_Array_23, KSof_DisInstCurLktZ_Array_18, KSof_DisInstCurLktZ_Array_24, KSof_DisInstCurLktZ_Array_11, KSof_DisInstCurLktZ_Array_11], [KSof_DisInstCurLktZ_Array_20, KSof_DisInstCurLktZ_Array_23, KSof_DisInstCurLktZ_Array_18, KSof_DisInstCurLktZ_Array_24, KSof_DisInstCurLktZ_Array_11, KSof_DisInstCurLktZ_Array_11], [KSof_DisInstCurLktZ_Array_20, KSof_DisInstCurLktZ_Array_23, KSof_DisInstCurLktZ_Array_18, KSof_DisInstCurLktZ_Array_24, KSof_DisInstCurLktZ_Array_11, KSof_DisInstCurLktZ_Array_11], [KSof_DisInstCurLktZ_Array_20, KSof_DisInstCurLktZ_Array_23, KSof_DisInstCurLktZ_Array_18, KSof_DisInstCurLktZ_Array_24, KSof_DisInstCurLktZ_Array_11, KSof_DisInstCurLktZ_Array_11]]
    KSof_DisInstCurLktZ_Array_1: value-spec=32
    KSof_DisInstCurLktZ_Array_2: value-spec=74
    KSof_DisInstCurLktZ_Array_3: value-spec=124
    KSof_DisInstCurLktZ_Array_4: value-spec=118
    KSof_DisInstCurLktZ_Array_5: value-spec=246
    KSof_DisInstCurLktZ_Array_6: value-spec=273
    KSof_DisInstCurLktZ_Array_7: value-spec=44
    KSof_DisInstCurLktZ_Array_8: value-spec=103
    KSof_DisInstCurLktZ_Array_9: value-spec=175
    KSof_DisInstCurLktZ_Array_10: value-spec=174
    KSof_DisInstCurLktZ_Array_11: value-spec=360
    KSof_DisInstCurLktZ_Array_12: value-spec=92
    KSof_DisInstCurLktZ_Array_13: value-spec=149
    KSof_DisInstCurLktZ_Array_14: value-spec=234
    KSof_DisInstCurLktZ_Array_15: value-spec=225
    KSof_DisInstCurLktZ_Array_16: value-spec=98
    KSof_DisInstCurLktZ_Array_17: value-spec=159
    KSof_DisInstCurLktZ_Array_18: value-spec=250
    KSof_DisInstCurLktZ_Array_19: value-spec=246
    KSof_DisInstCurLktZ_Array_20: value-spec=110
    KSof_DisInstCurLktZ_Array_21: value-spec=194
    KSof_DisInstCurLktZ_Array_22: value-spec=282
    KSof_DisInstCurLktZ_Array_23: value-spec=200
    KSof_DisInstCurLktZ_Array_24: value-spec=300
    KSof_EngStartReqPwr_Kw: value-spec=7
    KSof_FltLvlNone_Enum: value-spec=0
    KSof_FsChgCurFallRate_Aps: value-spec=20
    KSof_FsChgCurRaiseRate_Aps: value-spec=20
    KSof_FsCurLmtHysi_A: value-spec=10
    KSof_FsDisCurFallRate_Aps: value-spec=20
    KSof_FsDisCurRaiseRate_Aps: value-spec=20
    KSof_HwAlarm_Enum: value-spec=3
    KSof_HwEpo_Enum: value-spec=5
    KSof_LpHmCurFallRate_Aps: value-spec=100
    KSof_LpHmCurRaiseRate_Aps: value-spec=10
    KSof_LpHmReqPwr_Kw: value-spec=2
    KSof_MainFsCurLmt_A: value-spec=350
    KSof_PackCurLowerLmt_A: value-spec=-300
    KSof_PackCurUpperLmt_A: value-spec=500
    KSof_PackOvFallRate_Aps: value-spec=100
    KSof_PackOvLmt_V: value-spec=408
    KSof_PackOvLmtHysi_V: value-spec=10
    KSof_PackOvRaiseRate_Aps: value-spec=10
    KSof_PackUvFallRate_Aps: value-spec=100
    KSof_PackUvLmt_V: value-spec=269
    KSof_PackUvLmtHysi_V: value-spec=12
    KSof_PackUvRaiseRate_Aps: value-spec=10
    KSof_SwAlarm_Enum: value-spec=2
    KSof_SwEpo_Enum: value-spec=4
    KSof_Warning_Enum: value-spec=1
    KSof_ChgInstCurLktX_Array: value-spec=[{short-label=DefaultInitValue_rt_Array_Float_100_rt_Array_Float_100_1, constant=KSof_ChgConstCurLktX_Array_1}, {short-label=DefaultInitValue_rt_Array_Float_100_rt_Array_Float_100_2, constant=KSof_ChgConstCurLktX_Array_2}, {short-label=DefaultInitValue_rt_Array_Float_100_rt_Array_Float_100_3, constant=KSof_ChgConstCurLktX_Array_3}, {short-label=DefaultInitValue_rt_Array_Float_100_rt_Array_Float_100_4, constant=KSof_ChgConstCurLktX_Array_4}, {short-label=DefaultInitValue_rt_Array_Float_100_rt_Array_Float_100_5, constant=KSof_ChgConstCurLktX_Array_5}, {short-label=DefaultInitValue_rt_Array_Float_100_rt_Array_Float_100_6, constant=KSof_ChgConstCurLktX_Array_6}]
    KFpm_DTCDef_Array: value-spec=250 x 6 x KFpm_DTCDef_Array_1
    KRcm_RlyFltCkTimeLmt_Sec: value-spec=0.5
    KRcm_DTCDef_Array: value-spec=50 x [KFpm_DTCDef_Array_1, KFpm_DTCDef_Array_1, KFpm_DTCDef_Array_1]
    KRcm_PreChgResiEngyLmt_J: value-spec=1800
    CBms_PreChgResi_Ohm: value-spec=25
    KRcm_OffChgRlyCoilOpenLmtUpper_Pct: value-spec=0.25
    KRcm_OffChgRlyCoilOpenLmtLower_Pct: value-spec=0.2
    KRcm_OffChgRlyLsdFailLoLmtUpper_Pct: value-spec=0.2
    KRcm_OffChgRlyLsdFailLoLmtLower_Pct: value-spec=0.1
    KRcm_OffChgRlyLsdFailHiLmtUpper_Pct: value-spec=0.4
    KRcm_OffChgRlyLsdFailHiLmtLower_Pct: value-spec=0.2
    KRcm_OnChgRlyCoilOpenLmtUpper_Pct: value-spec=0.25
    KRcm_OnChgRlyCoilOpenLmtLower_Pct: value-spec=0.2
    KRcm_OnChgRlyLsdFailLoLmtUpper_Pct: value-spec=0.2
    KRcm_OnChgRlyLsdFailLoLmtLower_Pct: value-spec=0.1
    KRcm_OnChgRlyLsdFailHiLmtUpper_Pct: value-spec=0.4
    KRcm_OnChgRlyLsdFailHiLmtLower_Pct: value-spec=0.2
    KRcm_PosRlyCoilOpenLmtUpper_Pct: value-spec=0.25
    KRcm_PosRlyCoilOpenLmtLower_Pct: value-spec=0.2
    KRcm_PosRlyLsdFailLoLmtUpper_Pct: value-spec=0.2
    KRcm_PosRlyLsdFailLoLmtLower_Pct: value-spec=0.1
    KRcm_PosRlyLsdFailHiLmtUpper_Pct: value-spec=0.4
    KRcm_PosRlyLsdFailHiLmtLower_Pct: value-spec=0.2
    KRcm_NegRlyCoilOpenLmtUpper_Pct: value-spec=0.25
    KRcm_NegRlyCoilOpenLmtLower_Pct: value-spec=0.2
    KRcm_NegRlyLsdFailLoLmtUpper_Pct: value-spec=0.2
    KRcm_NegRlyLsdFailLoLmtLower_Pct: value-spec=0.1
    KRcm_NegRlyLsdFailHiLmtUpper_Pct: value-spec=0.4
    KRcm_NegRlyLsdFailHiLmtLower_Pct: value-spec=0.2
    KRcm_PreRlyCoilOpenLmtUpper_Pct: value-spec=0.25
    KRcm_PreRlyCoilOpenLmtLower_Pct: value-spec=0.2
    KRcm_PreRlyLsdFailLoLmtUpper_Pct: value-spec=0.2
    KRcm_PreRlyLsdFailLoLmtLower_Pct: value-spec=0.1
    KRcm_PreRlyLsdFailHiLmtUpper_Pct: value-spec=0.4
    KRcm_PreRlyLsdFailHiLmtLower_Pct: value-spec=0.2
    KRcm_RlyOpenCurLmt_A: value-spec=10
    KRcm_TickTime_Sec: value-spec=0.02
    KFpm_DTCDef_Array_1: value-spec=0
    KIrv_CellTempId_Enum: value-spec=255
    KIrv_CellVoltId_Enum: value-spec=255
package /DataType/DataTypeSemantics
  compu method COMPU_Boolean: 1=TRUE, 0=FALSE

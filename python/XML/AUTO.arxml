AUTOSAR XML
standard types defined: boolean, void, sint8, sint16, sint32, uint8, uint16, uint32, float32, float64
